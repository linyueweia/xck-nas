/dts-v1/;

/ {

	interrupt-parent = <0x1>;
	#address-cells = <0x2>;
	#size-cells = <0x2>;
	compatible = "kickpi,k1", "rockchip,rk3568";
	model = "KickPi K1";
	aliases {
		gpio0 = "/pinctrl/gpio@fdd60000";
		gpio1 = "/pinctrl/gpio@fe740000";
		gpio2 = "/pinctrl/gpio@fe750000";
		gpio3 = "/pinctrl/gpio@fe760000";
		gpio4 = "/pinctrl/gpio@fe770000";
		i2c0 = "/i2c@fdd40000";
		i2c1 = "/i2c@fe5a0000";
		i2c2 = "/i2c@fe5b0000";
		i2c3 = "/i2c@fe5c0000";
		i2c4 = "/i2c@fe5d0000";
		i2c5 = "/i2c@fe5e0000";
		serial0 = "/serial@fdd50000";
		serial1 = "/serial@fe650000";
		serial2 = "/serial@fe660000";
		serial3 = "/serial@fe670000";
		serial4 = "/serial@fe680000";
		serial5 = "/serial@fe690000";
		serial6 = "/serial@fe6a0000";
		serial7 = "/serial@fe6b0000";
		serial8 = "/serial@fe6c0000";
		serial9 = "/serial@fe6d0000";
		spi0 = "/spi@fe610000";
		spi1 = "/spi@fe620000";
		spi2 = "/spi@fe630000";
		spi3 = "/spi@fe640000";
		ethernet0 = "/ethernet@fe010000";
		mmc0 = "/mmc@fe310000";
		mmc1 = "/mmc@fe2b0000";
		mmc2 = "/mmc@fe000000";
	};
	cpus {
		#address-cells = <0x2>;
		#size-cells = <0x0>;
		cpu@0 {
			device_type = "cpu";
			compatible = "arm,cortex-a55";
			reg = <0x0 0x0>;
			clocks = <0x2 0x0>;
			#cooling-cells = <0x2>;
			enable-method = "psci";
			i-cache-size = <0x8000>;
			i-cache-line-size = <0x40>;
			i-cache-sets = <0x80>;
			d-cache-size = <0x8000>;
			d-cache-line-size = <0x40>;
			d-cache-sets = <0x80>;
			next-level-cache = <0x3>;
			operating-points-v2 = <0x4>;
			cpu-supply = <0x5>;
			phandle = <0xd>;
		};
		cpu@100 {
			device_type = "cpu";
			compatible = "arm,cortex-a55";
			reg = <0x0 0x100>;
			#cooling-cells = <0x2>;
			enable-method = "psci";
			i-cache-size = <0x8000>;
			i-cache-line-size = <0x40>;
			i-cache-sets = <0x80>;
			d-cache-size = <0x8000>;
			d-cache-line-size = <0x40>;
			d-cache-sets = <0x80>;
			next-level-cache = <0x3>;
			operating-points-v2 = <0x4>;
			cpu-supply = <0x5>;
			phandle = <0xe>;
		};
		cpu@200 {
			device_type = "cpu";
			compatible = "arm,cortex-a55";
			reg = <0x0 0x200>;
			#cooling-cells = <0x2>;
			enable-method = "psci";
			i-cache-size = <0x8000>;
			i-cache-line-size = <0x40>;
			i-cache-sets = <0x80>;
			d-cache-size = <0x8000>;
			d-cache-line-size = <0x40>;
			d-cache-sets = <0x80>;
			next-level-cache = <0x3>;
			operating-points-v2 = <0x4>;
			cpu-supply = <0x5>;
			phandle = <0xf>;
		};
		cpu@300 {
			device_type = "cpu";
			compatible = "arm,cortex-a55";
			reg = <0x0 0x300>;
			#cooling-cells = <0x2>;
			enable-method = "psci";
			i-cache-size = <0x8000>;
			i-cache-line-size = <0x40>;
			i-cache-sets = <0x80>;
			d-cache-size = <0x8000>;
			d-cache-line-size = <0x40>;
			d-cache-sets = <0x80>;
			next-level-cache = <0x3>;
			operating-points-v2 = <0x4>;
			cpu-supply = <0x5>;
			phandle = <0x10>;
		};
	};
	l3-cache {
		compatible = "cache";
		cache-level = <0x2>;
		cache-unified;
		cache-size = <0x80000>;
		cache-line-size = <0x40>;
		cache-sets = <0x200>;
		phandle = <0x3>;
	};
	cpuinfo {
		compatible = "rockchip,cpuinfo";
		nvmem-cells = <0x6 0x7 0x8>;
		nvmem-cell-names = "id", "cpu-version", "cpu-code";
	};
	display-subsystem {
		compatible = "rockchip,display-subsystem";
		ports = <0x9>;
	};
	firmware {
		scmi {
			compatible = "arm,scmi-smc";
			arm,smc-id = <0x82000010>;
			shmem = <0xa>;
			#address-cells = <0x1>;
			#size-cells = <0x0>;
			protocol@14 {
				reg = <0x14>;
				#clock-cells = <0x1>;
				phandle = <0x2>;
			};
		};
	};
	hdmi-sound {
		compatible = "simple-audio-card";
		simple-audio-card,name = "HDMI";
		simple-audio-card,format = "i2s";
		simple-audio-card,mclk-fs = <0x100>;
		status = "okay";
		simple-audio-card,codec {
			sound-dai = <0xb>;
		};
		simple-audio-card,cpu {
			sound-dai = <0xc>;
		};
	};
	pmu {
		compatible = "arm,cortex-a55-pmu";
		interrupts = <0x0 0xe4 0x4 0x0 0xe5 0x4 0x0 0xe6 0x4 0x0 0xe7 0x4>;
		interrupt-affinity = <0xd 0xe 0xf 0x10>;
	};
	psci {
		compatible = "arm,psci-1.0";
		method = "smc";
	};
	reserved-memory {
		#address-cells = <0x2>;
		#size-cells = <0x2>;
		ranges;
		shmem@10f000 {
			compatible = "arm,scmi-shmem";
			reg = <0x0 0x10f000 0x0 0x100>;
			no-map;
			phandle = <0xa>;
		};
	};
	timer {
		compatible = "arm,armv8-timer";
		interrupts = <0x1 0xd 0x4 0x1 0xe 0x4 0x1 0xb 0x4 0x1 0xa 0x4>;
		arm,no-tick-in-suspend;
	};
	xpcs-gmac1-clock {
		compatible = "fixed-clock";
		clock-frequency = <0x7735940>;
		clock-output-names = "clk_gmac1_xpcs_mii";
		#clock-cells = <0x0>;
	};
	xin24m {
		compatible = "fixed-clock";
		clock-frequency = <0x16e3600>;
		clock-output-names = "xin24m";
		#clock-cells = <0x0>;
		phandle = <0x21>;
	};
	xin32k {
		compatible = "fixed-clock";
		clock-frequency = <0x8000>;
		clock-output-names = "xin32k";
		pinctrl-0 = <0x11>;
		pinctrl-names = "default";
		#clock-cells = <0x0>;
	};
	sata@fc400000 {
		compatible = "rockchip,rk3568-dwc-ahci", "snps,dwc-ahci";
		reg = <0x0 0xfc400000 0x0 0x1000>;
		clocks = <0x12 0x9b 0x12 0x9c 0x12 0x9d>;
		clock-names = "sata", "pmalive", "rxoob";
		interrupts = <0x0 0x5f 0x4>;
		phys = <0x13 0x1>;
		phy-names = "sata-phy";
		ports-implemented = <0x1>;
		power-domains = <0x14 0xf>;
		status = "disabled";
	};
	sata@fc800000 {
		compatible = "rockchip,rk3568-dwc-ahci", "snps,dwc-ahci";
		reg = <0x0 0xfc800000 0x0 0x1000>;
		clocks = <0x12 0xa0 0x12 0xa1 0x12 0xa2>;
		clock-names = "sata", "pmalive", "rxoob";
		interrupts = <0x0 0x60 0x4>;
		phys = <0x15 0x1>;
		phy-names = "sata-phy";
		ports-implemented = <0x1>;
		power-domains = <0x14 0xf>;
		status = "disabled";
	};
	usb@fcc00000 {
		compatible = "rockchip,rk3568-dwc3", "snps,dwc3";
		reg = <0x0 0xfcc00000 0x0 0x400000>;
		interrupts = <0x0 0xa9 0x4>;
		clocks = <0x12 0xa6 0x12 0xa7 0x12 0xa5>;
		clock-names = "ref_clk", "suspend_clk", "bus_clk";
		dr_mode = "otg";
		phy_type = "utmi_wide";
		power-domains = <0x14 0xf>;
		resets = <0x12 0x94>;
		snps,dis_u2_susphy_quirk;
		status = "okay";
		phys = <0x16 0x17 0x4>;
		phy-names = "usb2-phy", "usb3-phy";
		extcon = <0x18>;
	};
	usb@fd000000 {
		compatible = "rockchip,rk3568-dwc3", "snps,dwc3";
		reg = <0x0 0xfd000000 0x0 0x400000>;
		interrupts = <0x0 0xaa 0x4>;
		clocks = <0x12 0xa9 0x12 0xaa 0x12 0xa8>;
		clock-names = "ref_clk", "suspend_clk", "bus_clk";
		dr_mode = "host";
		phys = <0x19 0x13 0x4>;
		phy-names = "usb2-phy", "usb3-phy";
		phy_type = "utmi_wide";
		power-domains = <0x14 0xf>;
		resets = <0x12 0x95>;
		snps,dis_u2_susphy_quirk;
		status = "okay";
	};
	interrupt-controller@fd400000 {
		compatible = "arm,gic-v3";
		reg = <0x0 0xfd400000 0x0 0x10000 0x0 0xfd460000 0x0 0x80000>;
		interrupts = <0x1 0x9 0x4>;
		interrupt-controller;
		#interrupt-cells = <0x3>;
		mbi-alias = <0x0 0xfd410000>;
		mbi-ranges = <0x128 0x18>;
		msi-controller;
		ranges;
		#address-cells = <0x2>;
		#size-cells = <0x2>;
		dma-noncoherent;
		phandle = <0x1>;
		msi-controller@fd440000 {
			compatible = "arm,gic-v3-its";
			reg = <0x0 0xfd440000 0x0 0x20000>;
			dma-noncoherent;
			msi-controller;
			#msi-cells = <0x1>;
			phandle = <0x6c>;
		};
	};
	usb@fd800000 {
		compatible = "generic-ehci";
		reg = <0x0 0xfd800000 0x0 0x40000>;
		interrupts = <0x0 0x82 0x4>;
		clocks = <0x12 0xbd 0x12 0xbe 0x12 0xbc>;
		phys = <0x1a>;
		phy-names = "usb";
		status = "okay";
	};
	usb@fd840000 {
		compatible = "generic-ohci";
		reg = <0x0 0xfd840000 0x0 0x40000>;
		interrupts = <0x0 0x83 0x4>;
		clocks = <0x12 0xbd 0x12 0xbe 0x12 0xbc>;
		phys = <0x1a>;
		phy-names = "usb";
		status = "okay";
	};
	usb@fd880000 {
		compatible = "generic-ehci";
		reg = <0x0 0xfd880000 0x0 0x40000>;
		interrupts = <0x0 0x85 0x4>;
		clocks = <0x12 0xbf 0x12 0xc0 0x12 0xbc>;
		phys = <0x1b>;
		phy-names = "usb";
		status = "okay";
	};
	usb@fd8c0000 {
		compatible = "generic-ohci";
		reg = <0x0 0xfd8c0000 0x0 0x40000>;
		interrupts = <0x0 0x86 0x4>;
		clocks = <0x12 0xbf 0x12 0xc0 0x12 0xbc>;
		phys = <0x1b>;
		phy-names = "usb";
		status = "okay";
	};
	syscon@fda00000 {
		compatible = "rockchip,rk3568-xpcs", "syscon";
		reg = <0x0 0xfda00000 0x0 0x200000>;
		status = "disabled";
	};
	syscon@fdc20000 {
		compatible = "rockchip,rk3568-pmugrf", "syscon", "simple-mfd";
		reg = <0x0 0xfdc20000 0x0 0x10000>;
		phandle = <0x6a>;
		io-domains {
			compatible = "rockchip,rk3568-pmu-io-voltage-domain";
			status = "okay";
			pmuio1-supply = <0x1c>;
			pmuio2-supply = <0x1c>;
			vccio1-supply = <0x1d>;
			vccio2-supply = <0x1e>;
			vccio3-supply = <0x1f>;
			vccio4-supply = <0x1e>;
			vccio5-supply = <0x20>;
			vccio6-supply = <0x1e>;
			vccio7-supply = <0x20>;
		};
	};
	syscon@fdc50000 {
		reg = <0x0 0xfdc50000 0x0 0x1000>;
		compatible = "rockchip,rk3568-pipe-grf", "syscon";
		phandle = <0xb9>;
	};
	syscon@fdc60000 {
		compatible = "rockchip,rk3568-grf", "syscon", "simple-mfd";
		reg = <0x0 0xfdc60000 0x0 0x10000>;
		phandle = <0x23>;
	};
	syscon@fdc80000 {
		compatible = "rockchip,rk3568-pipe-phy-grf", "syscon";
		reg = <0x0 0xfdc80000 0x0 0x1000>;
		phandle = <0xba>;
	};
	syscon@fdc90000 {
		compatible = "rockchip,rk3568-pipe-phy-grf", "syscon";
		reg = <0x0 0xfdc90000 0x0 0x1000>;
		phandle = <0xbb>;
	};
	syscon@fdca0000 {
		compatible = "rockchip,rk3568-usb2phy-grf", "syscon";
		reg = <0x0 0xfdca0000 0x0 0x8000>;
		phandle = <0xbc>;
	};
	syscon@fdca8000 {
		compatible = "rockchip,rk3568-usb2phy-grf", "syscon";
		reg = <0x0 0xfdca8000 0x0 0x8000>;
		phandle = <0xbf>;
	};
	clock-controller@fdd00000 {
		compatible = "rockchip,rk3568-pmucru";
		reg = <0x0 0xfdd00000 0x0 0x1000>;
		#clock-cells = <0x1>;
		#reset-cells = <0x1>;
		phandle = <0x22>;
	};
	clock-controller@fdd20000 {
		compatible = "rockchip,rk3568-cru";
		reg = <0x0 0xfdd20000 0x0 0x1000>;
		clocks = <0x21>;
		clock-names = "xin24m";
		#clock-cells = <0x1>;
		#reset-cells = <0x1>;
		assigned-clocks = <0x22 0x5 0x12 0x4 0x22 0x1>;
		assigned-clock-rates = <0x8000 0x47868c00 0xbebc200>;
		assigned-clock-parents = <0x22 0x8>;
		rockchip,grf = <0x23>;
		phandle = <0x12>;
	};
	i2c@fdd40000 {
		compatible = "rockchip,rk3568-i2c", "rockchip,rk3399-i2c";
		reg = <0x0 0xfdd40000 0x0 0x1000>;
		interrupts = <0x0 0x2e 0x4>;
		clocks = <0x22 0x7 0x22 0x2d>;
		clock-names = "i2c", "pclk";
		pinctrl-0 = <0x24>;
		pinctrl-names = "default";
		#address-cells = <0x1>;
		#size-cells = <0x0>;
		status = "okay";
		regulator@1c {
			compatible = "tcs,tcs4525";
			reg = <0x1c>;
			fcs,suspend-voltage-selector = <0x1>;
			regulator-name = "vdd_cpu";
			regulator-always-on;
			regulator-boot-on;
			regulator-min-microvolt = <0xc3500>;
			regulator-max-microvolt = <0x118c30>;
			regulator-ramp-delay = <0x8fc>;
			vin-supply = <0x25>;
			phandle = <0x5>;
			regulator-state-mem {
				regulator-off-in-suspend;
			};
		};
		pmic@20 {
			compatible = "rockchip,rk809";
			reg = <0x20>;
			interrupt-parent = <0x26>;
			interrupts = <0x3 0x8>;
			assigned-clocks = <0x12 0x48>;
			assigned-clock-parents = <0x12 0x196>;
			#clock-cells = <0x1>;
			clock-names = "mclk";
			clocks = <0x12 0x48>;
			pinctrl-names = "default";
			pinctrl-0 = <0x27 0x28>;
			system-power-controller;
			#sound-dai-cells = <0x0>;
			vcc1-supply = <0x29>;
			vcc2-supply = <0x29>;
			vcc3-supply = <0x29>;
			vcc4-supply = <0x29>;
			vcc5-supply = <0x29>;
			vcc6-supply = <0x29>;
			vcc7-supply = <0x29>;
			vcc8-supply = <0x29>;
			vcc9-supply = <0x29>;
			wakeup-source;
			phandle = <0xe1>;
			regulators {
				DCDC_REG1 {
					regulator-name = "vdd_logic";
					regulator-always-on;
					regulator-boot-on;
					regulator-initial-mode = <0x2>;
					regulator-min-microvolt = <0x7a120>;
					regulator-max-microvolt = <0x149970>;
					regulator-ramp-delay = <0x1771>;
					phandle = <0xf1>;
					regulator-state-mem {
						regulator-off-in-suspend;
					};
				};
				DCDC_REG2 {
					regulator-name = "vdd_gpu";
					regulator-always-on;
					regulator-initial-mode = <0x2>;
					regulator-min-microvolt = <0x7a120>;
					regulator-max-microvolt = <0x149970>;
					regulator-ramp-delay = <0x1771>;
					phandle = <0x4c>;
					regulator-state-mem {
						regulator-off-in-suspend;
					};
				};
				DCDC_REG3 {
					regulator-name = "vcc_ddr";
					regulator-always-on;
					regulator-boot-on;
					regulator-initial-mode = <0x2>;
					regulator-state-mem {
						regulator-on-in-suspend;
					};
				};
				DCDC_REG4 {
					regulator-name = "vdd_npu";
					regulator-initial-mode = <0x2>;
					regulator-min-microvolt = <0x7a120>;
					regulator-max-microvolt = <0x149970>;
					regulator-ramp-delay = <0x1771>;
					regulator-init-microvolt = <0xdbba0>;
					regulator-always-on;
					regulator-boot-on;
					phandle = <0xf7>;
					regulator-state-mem {
						regulator-off-in-suspend;
					};
				};
				DCDC_REG5 {
					regulator-name = "vcc_1v8";
					regulator-always-on;
					regulator-boot-on;
					regulator-min-microvolt = <0x1b7740>;
					regulator-max-microvolt = <0x1b7740>;
					phandle = <0x1e>;
					regulator-state-mem {
						regulator-off-in-suspend;
					};
				};
				LDO_REG1 {
					regulator-name = "vdda0v9_image";
					regulator-min-microvolt = <0xdbba0>;
					regulator-max-microvolt = <0xdbba0>;
					phandle = <0x66>;
					regulator-state-mem {
						regulator-off-in-suspend;
					};
				};
				LDO_REG2 {
					regulator-name = "vdda_0v9";
					regulator-always-on;
					regulator-boot-on;
					regulator-min-microvolt = <0xdbba0>;
					regulator-max-microvolt = <0xdbba0>;
					regulator-state-mem {
						regulator-off-in-suspend;
					};
				};
				LDO_REG3 {
					regulator-name = "vdda0v9_pmu";
					regulator-always-on;
					regulator-boot-on;
					regulator-min-microvolt = <0xdbba0>;
					regulator-max-microvolt = <0xdbba0>;
					regulator-state-mem {
						regulator-on-in-suspend;
						regulator-suspend-microvolt = <0xdbba0>;
					};
				};
				LDO_REG4 {
					regulator-name = "vccio_acodec";
					regulator-always-on;
					regulator-min-microvolt = <0x325aa0>;
					regulator-max-microvolt = <0x325aa0>;
					phandle = <0x1d>;
					regulator-state-mem {
						regulator-off-in-suspend;
					};
				};
				LDO_REG5 {
					regulator-name = "vccio_sd";
					regulator-min-microvolt = <0x1b7740>;
					regulator-max-microvolt = <0x325aa0>;
					phandle = <0x1f>;
					regulator-state-mem {
						regulator-off-in-suspend;
					};
				};
				LDO_REG6 {
					regulator-name = "vcc3v3_pmu";
					regulator-always-on;
					regulator-boot-on;
					regulator-min-microvolt = <0x325aa0>;
					regulator-max-microvolt = <0x325aa0>;
					phandle = <0x1c>;
					regulator-state-mem {
						regulator-on-in-suspend;
						regulator-suspend-microvolt = <0x325aa0>;
					};
				};
				LDO_REG7 {
					regulator-name = "vcca_1v8";
					regulator-always-on;
					regulator-boot-on;
					regulator-min-microvolt = <0x1b7740>;
					regulator-max-microvolt = <0x1b7740>;
					phandle = <0xac>;
					regulator-state-mem {
						regulator-off-in-suspend;
					};
				};
				LDO_REG8 {
					regulator-name = "vcca1v8_pmu";
					regulator-always-on;
					regulator-boot-on;
					regulator-min-microvolt = <0x1b7740>;
					regulator-max-microvolt = <0x1b7740>;
					regulator-state-mem {
						regulator-on-in-suspend;
						regulator-suspend-microvolt = <0x1b7740>;
					};
				};
				LDO_REG9 {
					regulator-name = "vcca1v8_image";
					regulator-min-microvolt = <0x1b7740>;
					regulator-max-microvolt = <0x1b7740>;
					phandle = <0x67>;
					regulator-state-mem {
						regulator-off-in-suspend;
					};
				};
				SWITCH_REG1 {
					regulator-name = "vcc_3v3";
					regulator-always-on;
					regulator-boot-on;
					phandle = <0x20>;
					regulator-state-mem {
						regulator-off-in-suspend;
					};
				};
				SWITCH_REG2 {
					regulator-name = "vcc3v3_sd";
					phandle = <0x73>;
					regulator-state-mem {
						regulator-off-in-suspend;
					};
				};
			};
		};
	};
	serial@fdd50000 {
		compatible = "rockchip,rk3568-uart", "snps,dw-apb-uart";
		reg = <0x0 0xfdd50000 0x0 0x100>;
		interrupts = <0x0 0x74 0x4>;
		clocks = <0x22 0xb 0x22 0x2c>;
		clock-names = "baudclk", "apb_pclk";
		dmas = <0x2a 0x0 0x2a 0x1>;
		pinctrl-0 = <0x2b>;
		pinctrl-names = "default";
		reg-io-width = <0x4>;
		reg-shift = <0x2>;
		status = "disabled";
	};
	pwm@fdd70000 {
		compatible = "rockchip,rk3568-pwm", "rockchip,rk3328-pwm";
		reg = <0x0 0xfdd70000 0x0 0x10>;
		clocks = <0x22 0xd 0x22 0x30>;
		clock-names = "pwm", "pclk";
		pinctrl-0 = <0x2c>;
		pinctrl-names = "default";
		#pwm-cells = <0x3>;
		status = "disabled";
	};
	pwm@fdd70010 {
		compatible = "rockchip,rk3568-pwm", "rockchip,rk3328-pwm";
		reg = <0x0 0xfdd70010 0x0 0x10>;
		clocks = <0x22 0xd 0x22 0x30>;
		clock-names = "pwm", "pclk";
		pinctrl-0 = <0x2d>;
		pinctrl-names = "default";
		#pwm-cells = <0x3>;
		status = "disabled";
	};
	pwm@fdd70020 {
		compatible = "rockchip,rk3568-pwm", "rockchip,rk3328-pwm";
		reg = <0x0 0xfdd70020 0x0 0x10>;
		clocks = <0x22 0xd 0x22 0x30>;
		clock-names = "pwm", "pclk";
		pinctrl-0 = <0x2e>;
		pinctrl-names = "default";
		#pwm-cells = <0x3>;
		status = "disabled";
	};
	pwm@fdd70030 {
		compatible = "rockchip,rk3568-pwm", "rockchip,rk3328-pwm";
		reg = <0x0 0xfdd70030 0x0 0x10>;
		clocks = <0x22 0xd 0x22 0x30>;
		clock-names = "pwm", "pclk";
		pinctrl-0 = <0x2f>;
		pinctrl-names = "default";
		#pwm-cells = <0x3>;
		status = "disabled";
	};
	power-management@fdd90000 {
		compatible = "rockchip,rk3568-pmu", "syscon", "simple-mfd";
		reg = <0x0 0xfdd90000 0x0 0x1000>;
		power-controller {
			compatible = "rockchip,rk3568-power-controller";
			#power-domain-cells = <0x1>;
			#address-cells = <0x1>;
			#size-cells = <0x0>;
			phandle = <0x14>;
			power-domain@7 {
				reg = <0x7>;
				clocks = <0x12 0x19 0x12 0x1a>;
				pm_qos = <0x30>;
				#power-domain-cells = <0x0>;
			};
			power-domain@8 {
				reg = <0x8>;
				clocks = <0x12 0xcc 0x12 0xcd>;
				pm_qos = <0x31 0x32 0x33>;
				#power-domain-cells = <0x0>;
			};
			power-domain@9 {
				reg = <0x9>;
				clocks = <0x12 0xda 0x12 0xdb 0x12 0xdc>;
				pm_qos = <0x34 0x35 0x36>;
				#power-domain-cells = <0x0>;
			};
			power-domain@10 {
				reg = <0xa>;
				clocks = <0x12 0xf1 0x12 0xf2>;
				pm_qos = <0x37 0x38 0x39 0x3a 0x3b 0x3c>;
				#power-domain-cells = <0x0>;
			};
			power-domain@11 {
				reg = <0xb>;
				clocks = <0x12 0xed>;
				pm_qos = <0x3d>;
				#power-domain-cells = <0x0>;
			};
			power-domain@13 {
				clocks = <0x12 0x107>;
				reg = <0xd>;
				pm_qos = <0x3e>;
				#power-domain-cells = <0x0>;
			};
			power-domain@14 {
				reg = <0xe>;
				clocks = <0x12 0x102>;
				pm_qos = <0x3f 0x40 0x41>;
				#power-domain-cells = <0x0>;
			};
			power-domain@15 {
				reg = <0xf>;
				clocks = <0x12 0x7f>;
				pm_qos = <0x42 0x43 0x44 0x45 0x46 0x47 0x48 0x49>;
				#power-domain-cells = <0x0>;
			};
			power-domain@6 {
				reg = <0x6>;
				clocks = <0x12 0x27 0x12 0x25 0x12 0x26>;
				pm_qos = <0x4a>;
				#power-domain-cells = <0x0>;
			};
		};
	};
	gpu@fde60000 {
		compatible = "arm,mali-bifrost";
		reg = <0x0 0xfde60000 0x0 0x4000>;
		interrupts = <0x0 0x27 0x4 0x0 0x29 0x4 0x0 0x28 0x4>;
		interrupt-names = "gpu", "mmu", "job";
		clocks = <0x2 0x1 0x12 0x1b>;
		clock-names = "gpu", "bus";
		#cooling-cells = <0x2>;
		power-domains = <0x14 0x7>;
		status = "okay";
		operating-points-v2 = <0x4b>;
		mali-supply = <0x4c>;
		upthreshold = <0x28>;
		downdifferential = <0xa>;
		phandle = <0xa9>;
		power-model {
			compatible = "simple-power-model";
			leakage-range = <0x5 0xf>;
			ls = <0xffffa23e 0x5927 0x0>;
			static-coefficient = <0x186a0>;
			dynamic-coefficient = <0x3b9>;
			ts = <0xfffe56a6 0xf87a 0xfffffab5 0x14>;
			thermal-zone = "gpu-thermal";
		};
	};
	video-codec@fdea0400 {
		compatible = "rockchip,rk3568-vpu";
		reg = <0x0 0xfdea0000 0x0 0x800>;
		interrupts = <0x0 0x8b 0x4>;
		interrupt-names = "vdpu";
		clocks = <0x12 0xee 0x12 0xef>;
		clock-names = "aclk", "hclk";
		iommus = <0x4d>;
		power-domains = <0x14 0xb>;
	};
	iommu@fdea0800 {
		compatible = "rockchip,rk3568-iommu", "rockchip,iommu-v2";
		reg = <0x0 0xfdea0800 0x0 0x40>;
		interrupts = <0x0 0x8a 0x4>;
		clock-names = "aclk", "iface";
		clocks = <0x12 0xee 0x12 0xef>;
		power-domains = <0x14 0xb>;
		#iommu-cells = <0x0>;
		interrupt-names = "vdpu_mmu";
		status = "okay";
		phandle = <0x4d>;
	};
	rga@fdeb0000 {
		compatible = "rockchip,rk3568-rga", "rockchip,rk3288-rga";
		reg = <0x0 0xfdeb0000 0x0 0x180>;
		interrupts = <0x0 0x5a 0x4>;
		clocks = <0x12 0xf3 0x12 0xf4 0x12 0xf5>;
		clock-names = "aclk", "hclk", "sclk";
		resets = <0x12 0x126 0x12 0x124 0x12 0x125>;
		reset-names = "core", "axi", "ahb";
		power-domains = <0x14 0xa>;
	};
	iommu@fdee0800 {
		compatible = "rockchip,rk3568-iommu", "rockchip,iommu-v2";
		reg = <0x0 0xfdee0800 0x0 0x40>;
		interrupts = <0x0 0x3f 0x4>;
		clocks = <0x12 0xfd 0x12 0xfe>;
		clock-names = "aclk", "iface";
		power-domains = <0x14 0xa>;
		#iommu-cells = <0x0>;
		interrupt-names = "vepu_mmu";
		status = "okay";
		phandle = <0xee>;
	};
	mmc@fe000000 {
		compatible = "rockchip,rk3568-dw-mshc", "rockchip,rk3288-dw-mshc";
		reg = <0x0 0xfe000000 0x0 0x4000>;
		interrupts = <0x0 0x64 0x4>;
		clocks = <0x12 0xc1 0x12 0xc2 0x12 0x18e 0x12 0x18f>;
		clock-names = "biu", "ciu", "ciu-drive", "ciu-sample";
		fifo-depth = <0x100>;
		max-frequency = <0x8f0d180>;
		resets = <0x12 0xeb>;
		reset-names = "reset";
		status = "okay";
		bus-width = <0x4>;
		disable-wp;
		cap-sd-highspeed;
		cap-sdio-irq;
		keep-power-in-suspend;
		mmc-pwrseq = <0x4e>;
		non-removable;
		pinctrl-names = "default";
		pinctrl-0 = <0x4f 0x50 0x51>;
		sd-uhs-sdr12;
		sd-uhs-sdr25;
		sd-uhs-sdr50;
		sd-uhs-sdr104;
		vmmc-supply = <0x29>;
		vqmmc-supply = <0x1e>;
	};
		ethernet@fe010000 {
		compatible = "rockchip,rk3568-gmac", "snps,dwmac-4.20a";
		reg = <0x0 0xfe010000 0x0 0x10000>;
		interrupts = <0x0 0x20 0x4 0x0 0x1d 0x4>;
		interrupt-names = "macirq", "eth_wake_irq";
		rockchip,grf = <0x23>;
		clocks = <0x12 0x186 0x12 0x189 0x12 0x189 0x12 0xc7 0x12 0xc3 0x12 0xc4 0x12 0x189 0x12 0xc8 0x12 0xac 0x12 0xab>;
		clock-names = "stmmaceth", "mac_clk_rx", "mac_clk_tx", "clk_mac_refout", "aclk_mac", "pclk_mac", "clk_mac_speed", "ptp_ref", "pclk_xpcs", "clk_xpcs_eee";
		resets = <0x12 0xec>;
		reset-names = "stmmaceth";
		snps,mixed-burst;
		snps,tso;
		snps,axi-config = <0x320>;
		snps,mtl-rx-config = <0x321>;
		snps,mtl-tx-config = <0x322>;
		status = "okay";
		phy-mode = "rgmii";
		clock_in_out = "output";
		snps,reset-gpio = <0x5e 0x7 0x1>;
		snps,reset-active-low;
		snps,reset-delays-us = <0x0 0x4e20 0x186a0>;
		assigned-clocks = <0x12 0x189 0x12 0x186>;
		assigned-clock-parents = <0x12 0x187 0x12 0xc5>;
		assigned-clock-rates = <0x0 0x7735940>;
		pinctrl-names = "default";
		pinctrl-0 = <0x57 0x58 0x59 0x5a 0x5c>;
		tx_delay = <0x2f>;
		rx_delay = <0x39>;
		phy-handle = <0x330>;
		mdio {
			compatible = "snps,dwmac-mdio";
			#address-cells = <0x1>;
			#size-cells = <0x0>;
			phy@0 {
				compatible = "ethernet-phy-ieee802.3-c22";
				reg = <0x0>;
				phandle = <0x330>;
			};
		};
		stmmac-axi-config {
			snps,blen = <0x0 0x0 0x0 0x0 0x10 0x8 0x4>;
			snps,rd_osr_lmt = <0x8>;
			snps,wr_osr_lmt = <0x4>;
			phandle = <0x320>;
		};
		rx-queues-config {
			snps,rx-queues-to-use = <0x1>;
			phandle = <0x321>;
			queue0 {
			};
		};
		tx-queues-config {
			snps,tx-queues-to-use = <0x1>;
			phandle = <0x322>;
			queue0 {
			};
		};
	};	vop@fe040000 {
		reg = <0x0 0xfe040000 0x0 0x3000 0x0 0xfe044000 0x0 0x1000>;
		reg-names = "vop", "gamma-lut";
		interrupts = <0x0 0x94 0x4>;
		clocks = <0x12 0xdd 0x12 0xde 0x12 0xdf 0x12 0xe0 0x12 0xe1>;
		clock-names = "aclk", "hclk", "dclk_vp0", "dclk_vp1", "dclk_vp2";
		iommus = <0x5f>;
		power-domains = <0x14 0x9>;
		rockchip,grf = <0x23>;
		status = "okay";
		compatible = "rockchip,rk3568-vop";
		assigned-clocks = <0x12 0xdf 0x12 0xe0>;
		assigned-clock-parents = <0x22 0x2 0x12 0x5>;
		ports {
			#address-cells = <0x1>;
			#size-cells = <0x0>;
			phandle = <0x9>;
			port@0 {
				reg = <0x0>;
				#address-cells = <0x1>;
				#size-cells = <0x0>;
				endpoint@2 {
					reg = <0x2>;
					remote-endpoint = <0x60>;
					phandle = <0x68>;
				};
			};
			port@1 {
				reg = <0x1>;
				#address-cells = <0x1>;
				#size-cells = <0x0>;
			};
			port@2 {
				reg = <0x2>;
				#address-cells = <0x1>;
				#size-cells = <0x0>;
			};
		};
	};
	iommu@fe043e00 {
		compatible = "rockchip,rk3568-iommu";
		reg = <0x0 0xfe043e00 0x0 0x100 0x0 0xfe043f00 0x0 0x100>;
		interrupts = <0x0 0x94 0x4>;
		clocks = <0x12 0xdd 0x12 0xde>;
		clock-names = "aclk", "iface";
		#iommu-cells = <0x0>;
		power-domains = <0x14 0x9>;
		status = "okay";
		phandle = <0x5f>;
	};
	dsi@fe060000 {
		compatible = "rockchip,rk3568-mipi-dsi", "snps,dw-mipi-dsi";
		reg = <0x0 0xfe060000 0x0 0x10000>;
		interrupts = <0x0 0x44 0x4>;
		clock-names = "pclk";
		clocks = <0x12 0xe8>;
		phy-names = "dphy";
		phys = <0x61>;
		power-domains = <0x14 0x9>;
		reset-names = "apb";
		resets = <0x12 0x110>;
		rockchip,grf = <0x23>;
		status = "disabled";
		ports {
			#address-cells = <0x1>;
			#size-cells = <0x0>;
			port@0 {
				reg = <0x0>;
			};
			port@1 {
				reg = <0x1>;
			};
		};
	};
	dsi@fe070000 {
		compatible = "rockchip,rk3568-mipi-dsi", "snps,dw-mipi-dsi";
		reg = <0x0 0xfe070000 0x0 0x10000>;
		interrupts = <0x0 0x45 0x4>;
		clock-names = "pclk";
		clocks = <0x12 0xe9>;
		phy-names = "dphy";
		phys = <0x62>;
		power-domains = <0x14 0x9>;
		reset-names = "apb";
		resets = <0x12 0x111>;
		rockchip,grf = <0x23>;
		status = "disabled";
		ports {
			#address-cells = <0x1>;
			#size-cells = <0x0>;
			port@0 {
				reg = <0x0>;
			};
			port@1 {
				reg = <0x1>;
			};
		};
	};
	hdmi@fe0a0000 {
		compatible = "rockchip,rk3568-dw-hdmi";
		reg = <0x0 0xfe0a0000 0x0 0x20000>;
		interrupts = <0x0 0x2d 0x4>;
		clocks = <0x12 0xe6 0x12 0xe7 0x12 0x193 0x22 0x28 0x12 0xda>;
		clock-names = "iahb", "isfr", "cec", "ref";
		pinctrl-names = "default";
		pinctrl-0 = <0x63 0x64 0x65>;
		power-domains = <0x14 0x9>;
		reg-io-width = <0x4>;
		rockchip,grf = <0x23>;
		#sound-dai-cells = <0x0>;
		status = "okay";
		avdd-0v9-supply = <0x66>;
		avdd-1v8-supply = <0x67>;
		phandle = <0xb>;
		ports {
			#address-cells = <0x1>;
			#size-cells = <0x0>;
			port@0 {
				reg = <0x0>;
				endpoint {
					remote-endpoint = <0x68>;
					phandle = <0x60>;
				};
			};
			port@1 {
				reg = <0x1>;
				endpoint {
					remote-endpoint = <0x69>;
					phandle = <0xde>;
				};
			};
		};
	};
	qos@fe128000 {
		compatible = "rockchip,rk3568-qos", "syscon";
		reg = <0x0 0xfe128000 0x0 0x20>;
		phandle = <0x30>;
	};
	qos@fe138080 {
		compatible = "rockchip,rk3568-qos", "syscon";
		reg = <0x0 0xfe138080 0x0 0x20>;
		phandle = <0x3f>;
	};
	qos@fe138100 {
		compatible = "rockchip,rk3568-qos", "syscon";
		reg = <0x0 0xfe138100 0x0 0x20>;
		phandle = <0x40>;
	};
	qos@fe138180 {
		compatible = "rockchip,rk3568-qos", "syscon";
		reg = <0x0 0xfe138180 0x0 0x20>;
		phandle = <0x41>;
	};
	qos@fe148000 {
		compatible = "rockchip,rk3568-qos", "syscon";
		reg = <0x0 0xfe148000 0x0 0x20>;
		phandle = <0x31>;
	};
	qos@fe148080 {
		compatible = "rockchip,rk3568-qos", "syscon";
		reg = <0x0 0xfe148080 0x0 0x20>;
		phandle = <0x32>;
	};
	qos@fe148100 {
		compatible = "rockchip,rk3568-qos", "syscon";
		reg = <0x0 0xfe148100 0x0 0x20>;
		phandle = <0x33>;
	};
	qos@fe150000 {
		compatible = "rockchip,rk3568-qos", "syscon";
		reg = <0x0 0xfe150000 0x0 0x20>;
		phandle = <0x3d>;
	};
	qos@fe158000 {
		compatible = "rockchip,rk3568-qos", "syscon";
		reg = <0x0 0xfe158000 0x0 0x20>;
		phandle = <0x37>;
	};
	qos@fe158100 {
		compatible = "rockchip,rk3568-qos", "syscon";
		reg = <0x0 0xfe158100 0x0 0x20>;
		phandle = <0x38>;
	};
	qos@fe158180 {
		compatible = "rockchip,rk3568-qos", "syscon";
		reg = <0x0 0xfe158180 0x0 0x20>;
		phandle = <0x39>;
	};
	qos@fe158200 {
		compatible = "rockchip,rk3568-qos", "syscon";
		reg = <0x0 0xfe158200 0x0 0x20>;
		phandle = <0x3a>;
	};
	qos@fe158280 {
		compatible = "rockchip,rk3568-qos", "syscon";
		reg = <0x0 0xfe158280 0x0 0x20>;
		phandle = <0x3b>;
	};
	qos@fe158300 {
		compatible = "rockchip,rk3568-qos", "syscon";
		reg = <0x0 0xfe158300 0x0 0x20>;
		phandle = <0x3c>;
	};
	qos@fe180000 {
		compatible = "rockchip,rk3568-qos", "syscon";
		reg = <0x0 0xfe180000 0x0 0x20>;
		phandle = <0x4a>;
	};
	qos@fe190000 {
		compatible = "rockchip,rk3568-qos", "syscon";
		reg = <0x0 0xfe190000 0x0 0x20>;
		phandle = <0x42>;
	};
	qos@fe190280 {
		compatible = "rockchip,rk3568-qos", "syscon";
		reg = <0x0 0xfe190280 0x0 0x20>;
		phandle = <0x46>;
	};
	qos@fe190300 {
		compatible = "rockchip,rk3568-qos", "syscon";
		reg = <0x0 0xfe190300 0x0 0x20>;
		phandle = <0x47>;
	};
	qos@fe190380 {
		compatible = "rockchip,rk3568-qos", "syscon";
		reg = <0x0 0xfe190380 0x0 0x20>;
		phandle = <0x48>;
	};
	qos@fe190400 {
		compatible = "rockchip,rk3568-qos", "syscon";
		reg = <0x0 0xfe190400 0x0 0x20>;
		phandle = <0x49>;
	};
	qos@fe198000 {
		compatible = "rockchip,rk3568-qos", "syscon";
		reg = <0x0 0xfe198000 0x0 0x20>;
		phandle = <0x3e>;
	};
	qos@fe1a8000 {
		compatible = "rockchip,rk3568-qos", "syscon";
		reg = <0x0 0xfe1a8000 0x0 0x20>;
		phandle = <0x34>;
	};
	qos@fe1a8080 {
		compatible = "rockchip,rk3568-qos", "syscon";
		reg = <0x0 0xfe1a8080 0x0 0x20>;
		phandle = <0x35>;
	};
	qos@fe1a8100 {
		compatible = "rockchip,rk3568-qos", "syscon";
		reg = <0x0 0xfe1a8100 0x0 0x20>;
		phandle = <0x36>;
	};
	dfi@fe230000 {
		compatible = "rockchip,rk3568-dfi";
		reg = <0x0 0xfe230000 0x0 0x400>;
		interrupts = <0x0 0xb 0x4>;
		rockchip,pmu = <0x6a>;
	};
	pcie@fe260000 {
		compatible = "rockchip,rk3568-pcie";
		reg = <0x3 0xc0000000 0x0 0x400000 0x0 0xfe260000 0x0 0x10000 0x0 0xf4000000 0x0 0x100000>;
		reg-names = "dbi", "apb", "config";
		interrupts = <0x0 0x4b 0x4 0x0 0x4a 0x4 0x0 0x49 0x4 0x0 0x48 0x4 0x0 0x47 0x4>;
		interrupt-names = "sys", "pmc", "msg", "legacy", "err";
		bus-range = <0x0 0xf>;
		clocks = <0x12 0x81 0x12 0x82 0x12 0x83 0x12 0x84 0x12 0x85>;
		clock-names = "aclk_mst", "aclk_slv", "aclk_dbi", "pclk", "aux";
		device_type = "pci";
		#interrupt-cells = <0x1>;
		interrupt-map-mask = <0x0 0x0 0x0 0x7>;
		interrupt-map = <0x0 0x0 0x0 0x1 0x6b 0x0 0x0 0x0 0x0 0x2 0x6b 0x1 0x0 0x0 0x0 0x3 0x6b 0x2 0x0 0x0 0x0 0x4 0x6b 0x3>;
		linux,pci-domain = <0x0>;
		num-ib-windows = <0x6>;
		num-ob-windows = <0x2>;
		max-link-speed = <0x2>;
		msi-map = <0x0 0x6c 0x0 0x1000>;
		num-lanes = <0x1>;
		phys = <0x15 0x2>;
		phy-names = "pcie-phy";
		power-domains = <0x14 0xf>;
		ranges = <0x1000000 0x0 0xf4100000 0x0 0xf4100000 0x0 0x100000 0x2000000 0x0 0xf4200000 0x0 0xf4200000 0x0 0xc10000 0x3000000 0x3 0x0 0x3 0x0 0x0 0x40000000>;
		resets = <0x12 0xa1>;
		reset-names = "pipe";
		#address-cells = <0x3>;
		#size-cells = <0x2>;
		status = "okay";
		pinctrl-names = "default";
		pinctrl-0 = <0x6d>;
		reset-gpios = <0x5e 0x11 0x0>;
		vpcie3v3-supply = <0x6e>;
		legacy-interrupt-controller {
			#address-cells = <0x0>;
			#interrupt-cells = <0x1>;
			interrupt-controller;
			interrupt-parent = <0x1>;
			interrupts = <0x0 0x48 0x1>;
			phandle = <0x6b>;
		};
	};
	mmc@fe2b0000 {
		compatible = "rockchip,rk3568-dw-mshc", "rockchip,rk3288-dw-mshc";
		reg = <0x0 0xfe2b0000 0x0 0x4000>;
		interrupts = <0x0 0x62 0x4>;
		clocks = <0x12 0xb0 0x12 0xb1 0x12 0x18a 0x12 0x18b>;
		clock-names = "biu", "ciu", "ciu-drive", "ciu-sample";
		fifo-depth = <0x100>;
		max-frequency = <0x8f0d180>;
		resets = <0x12 0xd4>;
		reset-names = "reset";
		status = "okay";
		bus-width = <0x4>;
		cap-sd-highspeed;
		cd-gpios = <0x26 0x4 0x1>;
		disable-wp;
		pinctrl-names = "default";
		pinctrl-0 = <0x6f 0x70 0x71 0x72>;
		sd-uhs-sdr50;
		vmmc-supply = <0x73>;
		vqmmc-supply = <0x1f>;
	};
	mmc@fe2c0000 {
		compatible = "rockchip,rk3568-dw-mshc", "rockchip,rk3288-dw-mshc";
		reg = <0x0 0xfe2c0000 0x0 0x4000>;
		interrupts = <0x0 0x63 0x4>;
		clocks = <0x12 0xb2 0x12 0xb3 0x12 0x18c 0x12 0x18d>;
		clock-names = "biu", "ciu", "ciu-drive", "ciu-sample";
		fifo-depth = <0x100>;
		max-frequency = <0x8f0d180>;
		resets = <0x12 0xd6>;
		reset-names = "reset";
		status = "disabled";
	};
	spi@fe300000 {
		compatible = "rockchip,sfc";
		reg = <0x0 0xfe300000 0x0 0x4000>;
		interrupts = <0x0 0x65 0x4>;
		clocks = <0x12 0x78 0x12 0x76>;
		clock-names = "clk_sfc", "hclk_sfc";
		pinctrl-0 = <0x74>;
		pinctrl-names = "default";
		status = "okay";
		#address-cells = <0x1>;
		#size-cells = <0x0>;
		flash@0 {
			compatible = "jedec,spi-nor";
			reg = <0x0>;
			spi-max-frequency = <0x632ea00>;
			spi-rx-bus-width = <0x4>;
			spi-tx-bus-width = <0x1>;
		};
	};
	mmc@fe310000 {
		compatible = "rockchip,rk3568-dwcmshc";
		reg = <0x0 0xfe310000 0x0 0x10000>;
		interrupts = <0x0 0x13 0x4>;
		assigned-clocks = <0x12 0x7b 0x12 0x7d>;
		assigned-clock-rates = <0xbebc200 0x16e3600>;
		clocks = <0x12 0x7c 0x12 0x7a 0x12 0x79 0x12 0x7b 0x12 0x7d>;
		clock-names = "core", "bus", "axi", "block", "timer";
		status = "okay";
		bus-width = <0x8>;
		max-frequency = <0xbebc200>;
		non-removable;
		pinctrl-names = "default";
		pinctrl-0 = <0x75 0x76 0x77 0x78>;
		vmmc-supply = <0x20>;
		vqmmc-supply = <0x1e>;
	};
	rng@fe388000 {
		compatible = "rockchip,cryptov2-rng", "rockchip,rk3568-rng";
		reg = <0x0 0xfe388000 0x0 0x2000>;
		clocks = <0x12 0x70 0x12 0x6f>;
		clock-names = "clk_trng", "hclk_trng";
		resets = <0x12 0x6d>;
		status = "okay";
		reset-names = "reset";
	};
	efuse@fe38c000 {
		compatible = "rockchip,rk3568-otp";
		reg = <0x0 0xfe38c000 0x0 0x4000>;
		clocks = <0x12 0x73 0x12 0x71 0x12 0x181 0x12 0x72>;
		clock-names = "otp", "apb_pclk", "phy", "sbpi";
		resets = <0x12 0x16e 0x12 0x16c 0x12 0x1cf 0x12 0x16d>;
		reset-names = "otp", "apb", "phy", "sbpi";
		nvmem-layout {
			compatible = "fixed-layout";
			#address-cells = <0x1>;
			#size-cells = <0x1>;
			cpu-code@2 {
				reg = <0x2 0x2>;
				phandle = <0x8>;
			};
			cpu-version@8 {
				reg = <0x8 0x1>;
				bits = <0x3 0x3>;
				phandle = <0x7>;
			};
			id@a {
				reg = <0xa 0x10>;
				phandle = <0x6>;
			};
			cpu-leakage@1a {
				reg = <0x1a 0x1>;
			};
			log-leakage@1b {
				reg = <0x1b 0x1>;
				phandle = <0xf4>;
			};
			npu-leakage@1c {
				reg = <0x1c 0x1>;
				phandle = <0xf8>;
			};
			gpu-leakage@1d {
				reg = <0x1d 0x1>;
				phandle = <0xca>;
			};
			specification-serial-number@7 {
				reg = <0x7 0x1>;
				bits = <0x0 0x5>;
				phandle = <0xce>;
			};
			mbist-vmin@9 {
				reg = <0x9 0x1>;
				bits = <0x0 0x4>;
				phandle = <0xcc>;
			};
			core-pvtm@2a {
				reg = <0x2a 0x2>;
				phandle = <0xcb>;
			};
			remark-spec-serial-number@56 {
				reg = <0x56 0x1>;
				bits = <0x0 0x5>;
				phandle = <0xcf>;
			};
			gpu-opp-info@3c {
				reg = <0x3c 0x6>;
				phandle = <0xcd>;
			};
			npu-opp-info@42 {
				reg = <0x42 0x6>;
				phandle = <0xf9>;
			};
		};
	};
	i2s@fe400000 {
		compatible = "rockchip,rk3568-i2s-tdm";
		reg = <0x0 0xfe400000 0x0 0x1000>;
		interrupts = <0x0 0x34 0x4>;
		assigned-clocks = <0x12 0x3d 0x12 0x41>;
		assigned-clock-rates = <0x46cf7100 0x46cf7100>;
		clocks = <0x12 0x3f 0x12 0x43 0x12 0x39>;
		clock-names = "mclk_tx", "mclk_rx", "hclk";
		dmas = <0x79 0x0>;
		dma-names = "tx";
		resets = <0x12 0x50 0x12 0x51>;
		reset-names = "tx-m", "rx-m";
		rockchip,grf = <0x23>;
		#sound-dai-cells = <0x0>;
		status = "okay";
		phandle = <0xc>;
	};
	i2s@fe410000 {
		compatible = "rockchip,rk3568-i2s-tdm";
		reg = <0x0 0xfe410000 0x0 0x1000>;
		interrupts = <0x0 0x35 0x4>;
		assigned-clocks = <0x12 0x45 0x12 0x49>;
		assigned-clock-rates = <0x46cf7100 0x46cf7100>;
		clocks = <0x12 0x47 0x12 0x4b 0x12 0x3a>;
		clock-names = "mclk_tx", "mclk_rx", "hclk";
		dmas = <0x79 0x3 0x79 0x2>;
		dma-names = "rx", "tx";
		resets = <0x12 0x52 0x12 0x53>;
		reset-names = "tx-m", "rx-m";
		rockchip,grf = <0x23>;
		pinctrl-names = "default";
		pinctrl-0 = <0x7a 0x7b 0x7c 0x7d>;
		#sound-dai-cells = <0x0>;
		status = "okay";
		rockchip,trcm-sync-tx-only;
		phandle = <0xe0>;
	};
	i2s@fe420000 {
		compatible = "rockchip,rk3568-i2s-tdm";
		reg = <0x0 0xfe420000 0x0 0x1000>;
		interrupts = <0x0 0x36 0x4>;
		assigned-clocks = <0x12 0x4d>;
		assigned-clock-rates = <0x46cf7100>;
		clocks = <0x12 0x4f 0x12 0x4f 0x12 0x3b>;
		clock-names = "mclk_tx", "mclk_rx", "hclk";
		dmas = <0x79 0x4 0x79 0x5>;
		dma-names = "tx", "rx";
		resets = <0x12 0x54>;
		reset-names = "tx-m";
		rockchip,grf = <0x23>;
		pinctrl-names = "default";
		pinctrl-0 = <0x7e 0x7f 0x80 0x81>;
		#sound-dai-cells = <0x0>;
		status = "okay";
		rockchip,trcm-sync-tx-only;
	};
	i2s@fe430000 {
		compatible = "rockchip,rk3568-i2s-tdm";
		reg = <0x0 0xfe430000 0x0 0x1000>;
		interrupts = <0x0 0x37 0x4>;
		clocks = <0x12 0x53 0x12 0x57 0x12 0x3c>;
		clock-names = "mclk_tx", "mclk_rx", "hclk";
		dmas = <0x79 0x6 0x79 0x7>;
		dma-names = "tx", "rx";
		resets = <0x12 0x55 0x12 0x56>;
		reset-names = "tx-m", "rx-m";
		rockchip,grf = <0x23>;
		#sound-dai-cells = <0x0>;
		status = "disabled";
	};
	pdm@fe440000 {
		compatible = "rockchip,rk3568-pdm";
		reg = <0x0 0xfe440000 0x0 0x1000>;
		interrupts = <0x0 0x4c 0x4>;
		clocks = <0x12 0x5a 0x12 0x59>;
		clock-names = "pdm_clk", "pdm_hclk";
		dmas = <0x79 0x9>;
		dma-names = "rx";
		pinctrl-0 = <0x82 0x83 0x84 0x85 0x86 0x87>;
		pinctrl-names = "default";
		resets = <0x12 0x58>;
		reset-names = "pdm-m";
		#sound-dai-cells = <0x0>;
		status = "disabled";
	};
	spdif@fe460000 {
		compatible = "rockchip,rk3568-spdif";
		reg = <0x0 0xfe460000 0x0 0x1000>;
		interrupts = <0x0 0x66 0x4>;
		clock-names = "mclk", "hclk";
		clocks = <0x12 0x5f 0x12 0x5c>;
		dmas = <0x79 0x1>;
		dma-names = "tx";
		pinctrl-names = "default";
		pinctrl-0 = <0x88>;
		#sound-dai-cells = <0x0>;
		status = "disabled";
	};
	dma-controller@fe530000 {
		compatible = "arm,pl330", "arm,primecell";
		reg = <0x0 0xfe530000 0x0 0x4000>;
		interrupts = <0x0 0xe 0x4 0x0 0xd 0x4>;
		arm,pl330-periph-burst;
		clocks = <0x12 0x10d>;
		clock-names = "apb_pclk";
		#dma-cells = <0x1>;
		phandle = <0x2a>;
	};
	dma-controller@fe550000 {
		compatible = "arm,pl330", "arm,primecell";
		reg = <0x0 0xfe550000 0x0 0x4000>;
		interrupts = <0x0 0x10 0x4 0x0 0xf 0x4>;
		arm,pl330-periph-burst;
		clocks = <0x12 0x10d>;
		clock-names = "apb_pclk";
		#dma-cells = <0x1>;
		phandle = <0x79>;
	};
	i2c@fe5a0000 {
		compatible = "rockchip,rk3568-i2c", "rockchip,rk3399-i2c";
		reg = <0x0 0xfe5a0000 0x0 0x1000>;
		interrupts = <0x0 0x2f 0x4>;
		clocks = <0x12 0x148 0x12 0x147>;
		clock-names = "i2c", "pclk";
		pinctrl-0 = <0x89>;
		pinctrl-names = "default";
		#address-cells = <0x1>;
		#size-cells = <0x0>;
		status = "disabled";
	};
	i2c@fe5b0000 {
		compatible = "rockchip,rk3568-i2c", "rockchip,rk3399-i2c";
		reg = <0x0 0xfe5b0000 0x0 0x1000>;
		interrupts = <0x0 0x30 0x4>;
		clocks = <0x12 0x14a 0x12 0x149>;
		clock-names = "i2c", "pclk";
		pinctrl-0 = <0x8a>;
		pinctrl-names = "default";
		#address-cells = <0x1>;
		#size-cells = <0x0>;
		status = "disabled";
	};
	i2c@fe5c0000 {
		compatible = "rockchip,rk3568-i2c", "rockchip,rk3399-i2c";
		reg = <0x0 0xfe5c0000 0x0 0x1000>;
		interrupts = <0x0 0x31 0x4>;
		clocks = <0x12 0x14c 0x12 0x14b>;
		clock-names = "i2c", "pclk";
		pinctrl-0 = <0x8b>;
		pinctrl-names = "default";
		#address-cells = <0x1>;
		#size-cells = <0x0>;
		status = "disabled";
	};
	i2c@fe5d0000 {
		compatible = "rockchip,rk3568-i2c", "rockchip,rk3399-i2c";
		reg = <0x0 0xfe5d0000 0x0 0x1000>;
		interrupts = <0x0 0x32 0x4>;
		clocks = <0x12 0x14e 0x12 0x14d>;
		clock-names = "i2c", "pclk";
		pinctrl-0 = <0x8c>;
		pinctrl-names = "default";
		#address-cells = <0x1>;
		#size-cells = <0x0>;
		status = "disabled";
	};
	i2c@fe5e0000 {
		compatible = "rockchip,rk3568-i2c", "rockchip,rk3399-i2c";
		reg = <0x0 0xfe5e0000 0x0 0x1000>;
		interrupts = <0x0 0x33 0x4>;
		clocks = <0x12 0x150 0x12 0x14f>;
		clock-names = "i2c", "pclk";
		pinctrl-0 = <0x8d>;
		pinctrl-names = "default";
		#address-cells = <0x1>;
		#size-cells = <0x0>;
		status = "okay";
		rtc@51 {
			compatible = "haoyu,hym8563";
			reg = <0x51>;
			interrupt-parent = <0x26>;
			interrupts = <0x1b 0x8>;
			#clock-cells = <0x0>;
			clock-output-names = "rtcic_32kout";
			pinctrl-names = "default";
			pinctrl-0 = <0x8e>;
			wakeup-source;
		};
	};
	watchdog@fe600000 {
		compatible = "rockchip,rk3568-wdt", "snps,dw-wdt";
		reg = <0x0 0xfe600000 0x0 0x100>;
		interrupts = <0x0 0x95 0x4>;
		clocks = <0x12 0x116 0x12 0x115>;
		clock-names = "tclk", "pclk";
	};
	spi@fe610000 {
		compatible = "rockchip,rk3568-spi", "rockchip,rk3066-spi";
		reg = <0x0 0xfe610000 0x0 0x1000>;
		interrupts = <0x0 0x67 0x4>;
		clocks = <0x12 0x152 0x12 0x151>;
		clock-names = "spiclk", "apb_pclk";
		dmas = <0x2a 0x14 0x2a 0x15>;
		dma-names = "tx", "rx";
		pinctrl-names = "default";
		pinctrl-0 = <0x8f 0x90 0x91>;
		#address-cells = <0x1>;
		#size-cells = <0x0>;
		status = "disabled";
	};
	spi@fe620000 {
		compatible = "rockchip,rk3568-spi", "rockchip,rk3066-spi";
		reg = <0x0 0xfe620000 0x0 0x1000>;
		interrupts = <0x0 0x68 0x4>;
		clocks = <0x12 0x154 0x12 0x153>;
		clock-names = "spiclk", "apb_pclk";
		dmas = <0x2a 0x16 0x2a 0x17>;
		dma-names = "tx", "rx";
		pinctrl-names = "default";
		pinctrl-0 = <0x92 0x93 0x94>;
		#address-cells = <0x1>;
		#size-cells = <0x0>;
		status = "disabled";
	};
	spi@fe630000 {
		compatible = "rockchip,rk3568-spi", "rockchip,rk3066-spi";
		reg = <0x0 0xfe630000 0x0 0x1000>;
		interrupts = <0x0 0x69 0x4>;
		clocks = <0x12 0x156 0x12 0x155>;
		clock-names = "spiclk", "apb_pclk";
		dmas = <0x2a 0x18 0x2a 0x19>;
		dma-names = "tx", "rx";
		pinctrl-names = "default";
		pinctrl-0 = <0x95 0x96 0x97>;
		#address-cells = <0x1>;
		#size-cells = <0x0>;
		status = "disabled";
	};
	spi@fe640000 {
		compatible = "rockchip,rk3568-spi", "rockchip,rk3066-spi";
		reg = <0x0 0xfe640000 0x0 0x1000>;
		interrupts = <0x0 0x6a 0x4>;
		clocks = <0x12 0x158 0x12 0x157>;
		clock-names = "spiclk", "apb_pclk";
		dmas = <0x2a 0x1a 0x2a 0x1b>;
		dma-names = "tx", "rx";
		pinctrl-names = "default";
		pinctrl-0 = <0x98 0x99 0x9a>;
		#address-cells = <0x1>;
		#size-cells = <0x0>;
		status = "disabled";
	};
	serial@fe650000 {
		compatible = "rockchip,rk3568-uart", "snps,dw-apb-uart";
		reg = <0x0 0xfe650000 0x0 0x100>;
		interrupts = <0x0 0x75 0x4>;
		clocks = <0x12 0x11f 0x12 0x11c>;
		clock-names = "baudclk", "apb_pclk";
		dmas = <0x2a 0x2 0x2a 0x3>;
		pinctrl-0 = <0x9b 0x9c 0x9d>;
		pinctrl-names = "default";
		reg-io-width = <0x4>;
		reg-shift = <0x2>;
		status = "okay";
		uart-has-rtscts;
	};
	serial@fe660000 {
		compatible = "rockchip,rk3568-uart", "snps,dw-apb-uart";
		reg = <0x0 0xfe660000 0x0 0x100>;
		interrupts = <0x0 0x76 0x4>;
		clocks = <0x12 0x123 0x12 0x120>;
		clock-names = "baudclk", "apb_pclk";
		dmas = <0x2a 0x4 0x2a 0x5>;
		pinctrl-0 = <0x9e>;
		pinctrl-names = "default";
		reg-io-width = <0x4>;
		reg-shift = <0x2>;
		status = "okay";
	};
	serial@fe670000 {
		compatible = "rockchip,rk3568-uart", "snps,dw-apb-uart";
		reg = <0x0 0xfe670000 0x0 0x100>;
		interrupts = <0x0 0x77 0x4>;
		clocks = <0x12 0x127 0x12 0x124>;
		clock-names = "baudclk", "apb_pclk";
		dmas = <0x2a 0x6 0x2a 0x7>;
		pinctrl-0 = <0x9f>;
		pinctrl-names = "default";
		reg-io-width = <0x4>;
		reg-shift = <0x2>;
		status = "disabled";
	};
	serial@fe680000 {
		compatible = "rockchip,rk3568-uart", "snps,dw-apb-uart";
		reg = <0x0 0xfe680000 0x0 0x100>;
		interrupts = <0x0 0x78 0x4>;
		clocks = <0x12 0x12b 0x12 0x128>;
		clock-names = "baudclk", "apb_pclk";
		dmas = <0x2a 0x8 0x2a 0x9>;
		pinctrl-0 = <0xa0>;
		pinctrl-names = "default";
		reg-io-width = <0x4>;
		reg-shift = <0x2>;
		status = "disabled";
	};
	serial@fe690000 {
		compatible = "rockchip,rk3568-uart", "snps,dw-apb-uart";
		reg = <0x0 0xfe690000 0x0 0x100>;
		interrupts = <0x0 0x79 0x4>;
		clocks = <0x12 0x12f 0x12 0x12c>;
		clock-names = "baudclk", "apb_pclk";
		dmas = <0x2a 0xa 0x2a 0xb>;
		pinctrl-0 = <0xa1>;
		pinctrl-names = "default";
		reg-io-width = <0x4>;
		reg-shift = <0x2>;
		status = "disabled";
	};
	serial@fe6a0000 {
		compatible = "rockchip,rk3568-uart", "snps,dw-apb-uart";
		reg = <0x0 0xfe6a0000 0x0 0x100>;
		interrupts = <0x0 0x7a 0x4>;
		clocks = <0x12 0x133 0x12 0x130>;
		clock-names = "baudclk", "apb_pclk";
		dmas = <0x2a 0xc 0x2a 0xd>;
		pinctrl-0 = <0xa2>;
		pinctrl-names = "default";
		reg-io-width = <0x4>;
		reg-shift = <0x2>;
		status = "disabled";
	};
	serial@fe6b0000 {
		compatible = "rockchip,rk3568-uart", "snps,dw-apb-uart";
		reg = <0x0 0xfe6b0000 0x0 0x100>;
		interrupts = <0x0 0x7b 0x4>;
		clocks = <0x12 0x137 0x12 0x134>;
		clock-names = "baudclk", "apb_pclk";
		dmas = <0x2a 0xe 0x2a 0xf>;
		pinctrl-0 = <0xa3>;
		pinctrl-names = "default";
		reg-io-width = <0x4>;
		reg-shift = <0x2>;
		status = "disabled";
	};
	serial@fe6c0000 {
		compatible = "rockchip,rk3568-uart", "snps,dw-apb-uart";
		reg = <0x0 0xfe6c0000 0x0 0x100>;
		interrupts = <0x0 0x7c 0x4>;
		clocks = <0x12 0x13b 0x12 0x138>;
		clock-names = "baudclk", "apb_pclk";
		dmas = <0x2a 0x10 0x2a 0x11>;
		pinctrl-0 = <0xa4>;
		pinctrl-names = "default";
		reg-io-width = <0x4>;
		reg-shift = <0x2>;
		status = "disabled";
	};
	serial@fe6d0000 {
		compatible = "rockchip,rk3568-uart", "snps,dw-apb-uart";
		reg = <0x0 0xfe6d0000 0x0 0x100>;
		interrupts = <0x0 0x7d 0x4>;
		clocks = <0x12 0x13f 0x12 0x13c>;
		clock-names = "baudclk", "apb_pclk";
		dmas = <0x2a 0x12 0x2a 0x13>;
		pinctrl-0 = <0xa5>;
		pinctrl-names = "default";
		reg-io-width = <0x4>;
		reg-shift = <0x2>;
		status = "disabled";
	};
	thermal-zones {
		cpu-thermal {
			polling-delay-passive = <0x64>;
			polling-delay = <0x3e8>;
			thermal-sensors = <0xa6 0x0>;
			trips {
				cpu_alert0 {
					temperature = <0x11170>;
					hysteresis = <0x7d0>;
					type = "passive";
					phandle = <0xa7>;
				};
				cpu_alert1 {
					temperature = <0x124f8>;
					hysteresis = <0x7d0>;
					type = "passive";
				};
				cpu_crit {
					temperature = <0x17318>;
					hysteresis = <0x7d0>;
					type = "critical";
				};
			};
			cooling-maps {
				map0 {
					trip = <0xa7>;
					cooling-device = <0xd 0xffffffff 0xffffffff 0xe 0xffffffff 0xffffffff 0xf 0xffffffff 0xffffffff 0x10 0xffffffff 0xffffffff>;
				};
			};
		};
		gpu-thermal {
			polling-delay-passive = <0x14>;
			polling-delay = <0x3e8>;
			thermal-sensors = <0xa6 0x1>;
			trips {
				gpu-threshold {
					temperature = <0x11170>;
					hysteresis = <0x7d0>;
					type = "passive";
				};
				gpu-target {
					temperature = <0x124f8>;
					hysteresis = <0x7d0>;
					type = "passive";
					phandle = <0xa8>;
				};
				gpu-crit {
					temperature = <0x17318>;
					hysteresis = <0x7d0>;
					type = "critical";
				};
			};
			cooling-maps {
				map0 {
					trip = <0xa8>;
					cooling-device = <0xa9 0xffffffff 0xffffffff>;
				};
			};
		};
	};
	tsadc@fe710000 {
		compatible = "rockchip,rk3568-tsadc";
		reg = <0x0 0xfe710000 0x0 0x100>;
		interrupts = <0x0 0x73 0x4>;
		assigned-clocks = <0x12 0x110 0x12 0x111>;
		assigned-clock-rates = <0x1036640 0xaae60>;
		clocks = <0x12 0x111 0x12 0x10f>;
		clock-names = "tsadc", "apb_pclk";
		resets = <0x12 0x181 0x12 0x182 0x12 0x1d7>;
		rockchip,grf = <0x23>;
		rockchip,hw-tshut-temp = <0x17318>;
		pinctrl-names = "default", "sleep";
		pinctrl-0 = <0xaa>;
		pinctrl-1 = <0xab>;
		#thermal-sensor-cells = <0x1>;
		status = "okay";
		rockchip,hw-tshut-mode = <0x1>;
		rockchip,hw-tshut-polarity = <0x0>;
		phandle = <0xa6>;
	};
	saradc@fe720000 {
		compatible = "rockchip,rk3568-saradc", "rockchip,rk3399-saradc";
		reg = <0x0 0xfe720000 0x0 0x100>;
		interrupts = <0x0 0x5d 0x4>;
		clocks = <0x12 0x113 0x12 0x112>;
		clock-names = "saradc", "apb_pclk";
		resets = <0x12 0x180>;
		reset-names = "saradc-apb";
		#io-channel-cells = <0x1>;
		status = "okay";
		vref-supply = <0xac>;
	};
	pwm@fe6e0000 {
		compatible = "rockchip,rk3568-pwm", "rockchip,rk3328-pwm";
		reg = <0x0 0xfe6e0000 0x0 0x10>;
		clocks = <0x12 0x15a 0x12 0x159>;
		clock-names = "pwm", "pclk";
		pinctrl-0 = <0xad>;
		pinctrl-names = "default";
		#pwm-cells = <0x3>;
		status = "disabled";
	};
	pwm@fe6e0010 {
		compatible = "rockchip,rk3568-pwm", "rockchip,rk3328-pwm";
		reg = <0x0 0xfe6e0010 0x0 0x10>;
		clocks = <0x12 0x15a 0x12 0x159>;
		clock-names = "pwm", "pclk";
		pinctrl-0 = <0xae>;
		pinctrl-names = "default";
		#pwm-cells = <0x3>;
		status = "disabled";
	};
	pwm@fe6e0020 {
		compatible = "rockchip,rk3568-pwm", "rockchip,rk3328-pwm";
		reg = <0x0 0xfe6e0020 0x0 0x10>;
		clocks = <0x12 0x15a 0x12 0x159>;
		clock-names = "pwm", "pclk";
		pinctrl-0 = <0xaf>;
		pinctrl-names = "default";
		#pwm-cells = <0x3>;
		status = "disabled";
	};
	pwm@fe6e0030 {
		compatible = "rockchip,rk3568-pwm", "rockchip,rk3328-pwm";
		reg = <0x0 0xfe6e0030 0x0 0x10>;
		clocks = <0x12 0x15a 0x12 0x159>;
		clock-names = "pwm", "pclk";
		pinctrl-0 = <0xb0>;
		pinctrl-names = "default";
		#pwm-cells = <0x3>;
		status = "disabled";
	};
	pwm@fe6f0000 {
		compatible = "rockchip,rk3568-pwm", "rockchip,rk3328-pwm";
		reg = <0x0 0xfe6f0000 0x0 0x10>;
		clocks = <0x12 0x15d 0x12 0x15c>;
		clock-names = "pwm", "pclk";
		pinctrl-0 = <0xb1>;
		pinctrl-names = "default";
		#pwm-cells = <0x3>;
		status = "disabled";
	};
	pwm@fe6f0010 {
		compatible = "rockchip,rk3568-pwm", "rockchip,rk3328-pwm";
		reg = <0x0 0xfe6f0010 0x0 0x10>;
		clocks = <0x12 0x15d 0x12 0x15c>;
		clock-names = "pwm", "pclk";
		pinctrl-0 = <0xb2>;
		pinctrl-names = "default";
		#pwm-cells = <0x3>;
		status = "disabled";
	};
	pwm@fe6f0020 {
		compatible = "rockchip,rk3568-pwm", "rockchip,rk3328-pwm";
		reg = <0x0 0xfe6f0020 0x0 0x10>;
		clocks = <0x12 0x15d 0x12 0x15c>;
		clock-names = "pwm", "pclk";
		pinctrl-0 = <0xb3>;
		pinctrl-names = "default";
		#pwm-cells = <0x3>;
		status = "disabled";
	};
	pwm@fe6f0030 {
		compatible = "rockchip,rk3568-pwm", "rockchip,rk3328-pwm";
		reg = <0x0 0xfe6f0030 0x0 0x10>;
		clocks = <0x12 0x15d 0x12 0x15c>;
		clock-names = "pwm", "pclk";
		pinctrl-0 = <0xb4>;
		pinctrl-names = "default";
		#pwm-cells = <0x3>;
		status = "disabled";
	};
	pwm@fe700000 {
		compatible = "rockchip,rk3568-pwm", "rockchip,rk3328-pwm";
		reg = <0x0 0xfe700000 0x0 0x10>;
		clocks = <0x12 0x160 0x12 0x15f>;
		clock-names = "pwm", "pclk";
		pinctrl-0 = <0xb5>;
		pinctrl-names = "default";
		#pwm-cells = <0x3>;
		status = "disabled";
	};
	pwm@fe700010 {
		compatible = "rockchip,rk3568-pwm", "rockchip,rk3328-pwm";
		reg = <0x0 0xfe700010 0x0 0x10>;
		clocks = <0x12 0x160 0x12 0x15f>;
		clock-names = "pwm", "pclk";
		pinctrl-0 = <0xb6>;
		pinctrl-names = "default";
		#pwm-cells = <0x3>;
		status = "disabled";
	};
	pwm@fe700020 {
		compatible = "rockchip,rk3568-pwm", "rockchip,rk3328-pwm";
		reg = <0x0 0xfe700020 0x0 0x10>;
		clocks = <0x12 0x160 0x12 0x15f>;
		clock-names = "pwm", "pclk";
		pinctrl-0 = <0xb7>;
		pinctrl-names = "default";
		#pwm-cells = <0x3>;
		status = "disabled";
	};
	pwm@fe700030 {
		compatible = "rockchip,rk3568-pwm", "rockchip,rk3328-pwm";
		reg = <0x0 0xfe700030 0x0 0x10>;
		clocks = <0x12 0x160 0x12 0x15f>;
		clock-names = "pwm", "pclk";
		pinctrl-0 = <0xb8>;
		pinctrl-names = "default";
		#pwm-cells = <0x3>;
		status = "disabled";
	};
	phy@fe830000 {
		compatible = "rockchip,rk3568-naneng-combphy";
		reg = <0x0 0xfe830000 0x0 0x100>;
		clocks = <0x22 0x22 0x12 0x17d 0x12 0x7f>;
		clock-names = "ref", "apb", "pipe";
		assigned-clocks = <0x22 0x22>;
		assigned-clock-rates = <0x5f5e100>;
		resets = <0x12 0x1c7>;
		reset-names = "phy";
		rockchip,pipe-grf = <0xb9>;
		rockchip,pipe-phy-grf = <0xba>;
		#phy-cells = <0x1>;
		status = "okay";
		phandle = <0x13>;
	};
	phy@fe840000 {
		compatible = "rockchip,rk3568-naneng-combphy";
		reg = <0x0 0xfe840000 0x0 0x100>;
		clocks = <0x22 0x25 0x12 0x17e 0x12 0x7f>;
		clock-names = "ref", "apb", "pipe";
		assigned-clocks = <0x22 0x25>;
		assigned-clock-rates = <0x5f5e100>;
		resets = <0x12 0x1c9>;
		reset-names = "phy";
		rockchip,pipe-grf = <0xb9>;
		rockchip,pipe-phy-grf = <0xbb>;
		#phy-cells = <0x1>;
		status = "okay";
		phandle = <0x15>;
	};
	phy@fe870000 {
		compatible = "rockchip,rk3568-csi-dphy";
		reg = <0x0 0xfe870000 0x0 0x10000>;
		clocks = <0x12 0x179>;
		clock-names = "pclk";
		#phy-cells = <0x0>;
		resets = <0x12 0x1ba>;
		reset-names = "apb";
		rockchip,grf = <0x23>;
		status = "disabled";
	};
	mipi-dphy@fe850000 {
		compatible = "rockchip,rk3568-dsi-dphy";
		reg = <0x0 0xfe850000 0x0 0x10000>;
		clock-names = "ref", "pclk";
		clocks = <0x22 0x17 0x12 0x17a>;
		#phy-cells = <0x0>;
		power-domains = <0x14 0x9>;
		reset-names = "apb";
		resets = <0x12 0x1bb>;
		status = "disabled";
		phandle = <0x61>;
	};
	mipi-dphy@fe860000 {
		compatible = "rockchip,rk3568-dsi-dphy";
		reg = <0x0 0xfe860000 0x0 0x10000>;
		clock-names = "ref", "pclk";
		clocks = <0x22 0x19 0x12 0x17b>;
		#phy-cells = <0x0>;
		power-domains = <0x14 0x9>;
		reset-names = "apb";
		resets = <0x12 0x1bc>;
		status = "disabled";
		phandle = <0x62>;
	};
	usb2phy@fe8a0000 {
		compatible = "rockchip,rk3568-usb2phy";
		reg = <0x0 0xfe8a0000 0x0 0x10000>;
		clocks = <0x22 0x13>;
		clock-names = "phyclk";
		clock-output-names = "clk_usbphy0_480m";
		interrupts = <0x0 0x87 0x4>;
		rockchip,usbgrf = <0xbc>;
		#clock-cells = <0x0>;
		status = "okay";
		phandle = <0x18>;
		host-port {
			#phy-cells = <0x0>;
			status = "okay";
			phy-supply = <0xbd>;
			phandle = <0x19>;
		};
		otg-port {
			#phy-cells = <0x0>;
			status = "okay";
			phy-supply = <0xbe>;
			phandle = <0x16>;
		};
	};
	usb2phy@fe8b0000 {
		compatible = "rockchip,rk3568-usb2phy";
		reg = <0x0 0xfe8b0000 0x0 0x10000>;
		clocks = <0x22 0x15>;
		clock-names = "phyclk";
		clock-output-names = "clk_usbphy1_480m";
		interrupts = <0x0 0x88 0x4>;
		rockchip,usbgrf = <0xbf>;
		#clock-cells = <0x0>;
		status = "okay";
		host-port {
			#phy-cells = <0x0>;
			status = "okay";
			phy-supply = <0xbd>;
			phandle = <0x1b>;
		};
		otg-port {
			#phy-cells = <0x0>;
			status = "okay";
			phy-supply = <0xbd>;
			phandle = <0x1a>;
		};
	};
	pinctrl {
		compatible = "rockchip,rk3568-pinctrl";
		rockchip,grf = <0x23>;
		rockchip,pmu = <0x6a>;
		#address-cells = <0x2>;
		#size-cells = <0x2>;
		ranges;
		phandle = <0xc0>;
		gpio@fdd60000 {
			compatible = "rockchip,gpio-bank";
			reg = <0x0 0xfdd60000 0x0 0x100>;
			interrupts = <0x0 0x21 0x4>;
			clocks = <0x22 0x2e 0x22 0xc>;
			gpio-controller;
			gpio-ranges = <0xc0 0x0 0x0 0x20>;
			#gpio-cells = <0x2>;
			interrupt-controller;
			#interrupt-cells = <0x2>;
			phandle = <0x26>;
		};
		gpio@fe740000 {
			compatible = "rockchip,gpio-bank";
			reg = <0x0 0xfe740000 0x0 0x100>;
			interrupts = <0x0 0x22 0x4>;
			clocks = <0x12 0x163 0x12 0x164>;
			gpio-controller;
			gpio-ranges = <0xc0 0x0 0x20 0x20>;
			#gpio-cells = <0x2>;
			interrupt-controller;
			#interrupt-cells = <0x2>;
			phandle = <0xe9>;
		};
		gpio@fe750000 {
			compatible = "rockchip,gpio-bank";
			reg = <0x0 0xfe750000 0x0 0x100>;
			interrupts = <0x0 0x23 0x4>;
			clocks = <0x12 0x165 0x12 0x166>;
			gpio-controller;
			gpio-ranges = <0xc0 0x0 0x40 0x20>;
			#gpio-cells = <0x2>;
			interrupt-controller;
			#interrupt-cells = <0x2>;
			phandle = <0xd6>;
		};
		gpio@fe760000 {
			compatible = "rockchip,gpio-bank";
			reg = <0x0 0xfe760000 0x0 0x100>;
			interrupts = <0x0 0x24 0x4>;
			clocks = <0x12 0x167 0x12 0x168>;
			gpio-controller;
			gpio-ranges = <0xc0 0x0 0x60 0x20>;
			#gpio-cells = <0x2>;
			interrupt-controller;
			#interrupt-cells = <0x2>;
			phandle = <0x5e>;
		};
		gpio@fe770000 {
			compatible = "rockchip,gpio-bank";
			reg = <0x0 0xfe770000 0x0 0x100>;
			interrupts = <0x0 0x25 0x4>;
			clocks = <0x12 0x169 0x12 0x16a>;
			gpio-controller;
			gpio-ranges = <0xc0 0x0 0x80 0x20>;
			#gpio-cells = <0x2>;
			interrupt-controller;
			#interrupt-cells = <0x2>;
		};
		pcfg-pull-up {
			bias-pull-up;
			phandle = <0xc3>;
		};
		pcfg-pull-down {
			bias-pull-down;
			phandle = <0xc9>;
		};
		pcfg-pull-none {
			bias-disable;
			phandle = <0xc1>;
		};
		pcfg-pull-none-drv-level-1 {
			bias-disable;
			drive-strength = <0x1>;
			phandle = <0xc5>;
		};
		pcfg-pull-none-drv-level-2 {
			bias-disable;
			drive-strength = <0x2>;
			phandle = <0xc4>;
		};
		pcfg-pull-none-drv-level-3 {
			bias-disable;
			drive-strength = <0x3>;
			phandle = <0xc8>;
		};
		pcfg-pull-up-drv-level-1 {
			bias-pull-up;
			drive-strength = <0x1>;
			phandle = <0xc7>;
		};
		pcfg-pull-up-drv-level-2 {
			bias-pull-up;
			drive-strength = <0x2>;
			phandle = <0xc2>;
		};
		pcfg-pull-none-smt {
			bias-disable;
			input-schmitt-enable;
			phandle = <0xc6>;
		};
		acodec {
		};
		audiopwm {
		};
		bt656 {
		};
		bt1120 {
		};
		cam {
			vcc_cam_en {
				rockchip,pins = <0x1 0x9 0x0 0xc1>;
				phandle = <0xea>;
			};
		};
		can0 {
			can0m0-pins {
				rockchip,pins = <0x0 0xc 0x2 0xc1 0x0 0xb 0x2 0xc1>;
				phandle = <0xda>;
			};
		};
		can1 {
			can1m0-pins {
				rockchip,pins = <0x1 0x0 0x3 0xc1 0x1 0x1 0x3 0xc1>;
				phandle = <0xdb>;
			};
		};
		can2 {
			can2m0-pins {
				rockchip,pins = <0x4 0xc 0x3 0xc1 0x4 0xd 0x3 0xc1>;
				phandle = <0xdc>;
			};
		};
		cif {
		};
		clk32k {
			clk32k-out0 {
				rockchip,pins = <0x0 0x8 0x2 0xc1>;
				phandle = <0x11>;
			};
		};
		cpu {
		};
		ebc {
		};
		edpdp {
		};
		emmc {
			emmc-bus8 {
				rockchip,pins = <0x1 0xc 0x1 0xc2 0x1 0xd 0x1 0xc2 0x1 0xe 0x1 0xc2 0x1 0xf 0x1 0xc2 0x1 0x10 0x1 0xc2 0x1 0x11 0x1 0xc2 0x1 0x12 0x1 0xc2 0x1 0x13 0x1 0xc2>;
				phandle = <0x75>;
			};
			emmc-clk {
				rockchip,pins = <0x1 0x15 0x1 0xc2>;
				phandle = <0x76>;
			};
			emmc-cmd {
				rockchip,pins = <0x1 0x14 0x1 0xc2>;
				phandle = <0x77>;
			};
			emmc-datastrobe {
				rockchip,pins = <0x1 0x16 0x1 0xc1>;
				phandle = <0x78>;
			};
		};
		eth0 {
		};
		eth1 {
		};
		flash {
		};
		fspi {
			fspi-pins {
				rockchip,pins = <0x1 0x18 0x1 0xc1 0x1 0x1b 0x1 0xc1 0x1 0x19 0x1 0xc1 0x1 0x1a 0x1 0xc1 0x1 0x17 0x2 0xc1 0x1 0x1c 0x1 0xc1>;
				phandle = <0x74>;
			};
		};
		gmac0 {
			/omit-if-no-ref/
			gmac0-miim {
				rockchip,pins = <0x2 0x13 0x2 0xc1>, <0x2 0x14 0x2 0xc1>;
				phandle = <0x301>;
			};
			/omit-if-no-ref/
			gmac0-tx-bus2 {
				rockchip,pins = <0x2 0xb 0x1 0xc4>, <0x2 0xc 0x1 0xc4>, <0x2 0xd 0x1 0xc1>;
				phandle = <0x302>;
			};
			/omit-if-no-ref/
			gmac0-rx-bus2 {
				rockchip,pins = <0x2 0xe 0x1 0xc1>, <0x2 0xf 0x2 0xc1>, <0x2 0x10 0x2 0xc1>;
				phandle = <0x303>;
			};
			/omit-if-no-ref/
			gmac0-rgmii-clk {
				rockchip,pins = <0x2 0x5 0x2 0xc1>, <0x2 0x8 0x2 0xc5>;
				phandle = <0x304>;
			};
			/omit-if-no-ref/
			gmac0-clkinout {
				rockchip,pins = <0x2 0x2 0x2 0xc1>;
				phandle = <0x305>;
			};
			/omit-if-no-ref/
			gmac0-rgmii-bus {
				rockchip,pins = <0x2 0x3 0x2 0xc1>, <0x2 0x4 0x2 0xc1>, <0x2 0x6 0x2 0xc4>, <0x2 0x7 0x2 0xc4>;
				phandle = <0x306>;
			};
		};
		gmac1 {
			gmac1m1-miim {
				rockchip,pins = <0x4 0xe 0x3 0xc1 0x4 0xf 0x3 0xc1>;
				phandle = <0x57>;
			};
			gmac1m1-clkinout {
				rockchip,pins = <0x4 0x11 0x3 0xc1>;
				phandle = <0x5b>;
			};
			gmac1m1-rx-bus2 {
				rockchip,pins = <0x4 0x7 0x3 0xc1 0x4 0x8 0x3 0xc1 0x4 0x9 0x3 0xc1>;
				phandle = <0x59>;
			};
			gmac1m1-tx-bus2 {
				rockchip,pins = <0x4 0x4 0x3 0xc4 0x4 0x5 0x3 0xc4 0x4 0x6 0x3 0xc1>;
				phandle = <0x58>;
			};
			gmac1m1-rgmii-clk {
				rockchip,pins = <0x4 0x3 0x3 0xc1 0x4 0x0 0x3 0xc5>;
				phandle = <0x5a>;
			};
			gmac1m1-rgmii-bus {
				rockchip,pins = <0x4 0x1 0x3 0xc1 0x4 0x2 0x3 0xc1 0x3 0x1e 0x3 0xc4 0x3 0x1f 0x3 0xc4>;
				phandle = <0x5c>;
			};
		};
		gpu {
		};
		hdmitx {
			hdmitxm1-cec {
				rockchip,pins = <0x0 0x17 0x1 0xc1>;
				phandle = <0x65>;
			};
			hdmitx-scl {
				rockchip,pins = <0x4 0x17 0x1 0xc1>;
				phandle = <0x63>;
			};
			hdmitx-sda {
				rockchip,pins = <0x4 0x18 0x1 0xc1>;
				phandle = <0x64>;
			};
		};
		i2c0 {
			i2c0-xfer {
				rockchip,pins = <0x0 0x9 0x1 0xc6 0x0 0xa 0x1 0xc6>;
				phandle = <0x24>;
			};
		};
		i2c1 {
			i2c1-xfer {
				rockchip,pins = <0x0 0xb 0x1 0xc6 0x0 0xc 0x1 0xc6>;
				phandle = <0x89>;
			};
		};
		i2c2 {
			i2c2m0-xfer {
				rockchip,pins = <0x0 0xd 0x1 0xc6 0x0 0xe 0x1 0xc6>;
				phandle = <0x8a>;
			};
		};
		i2c3 {
			i2c3m1-xfer {
				rockchip,pins = <0x3 0xd 0x4 0xc6 0x3 0xe 0x4 0xc6>;
				phandle = <0x8b>;
			};
		};
		i2c4 {
			i2c4m1-xfer {
				rockchip,pins = <0x2 0xa 0x2 0xc6 0x2 0x9 0x2 0xc6>;
				phandle = <0x8c>;
			};
		};
		i2c5 {
			i2c5m0-xfer {
				rockchip,pins = <0x3 0xb 0x4 0xc6 0x3 0xc 0x4 0xc6>;
				phandle = <0x8d>;
			};
		};
		i2s1 {
			i2s1m0-lrcktx {
				rockchip,pins = <0x1 0x5 0x1 0xc1>;
				phandle = <0x7b>;
			};
			i2s1m0-mclk {
				rockchip,pins = <0x1 0x2 0x1 0xc1>;
				phandle = <0x28>;
			};
			i2s1m0-sclktx {
				rockchip,pins = <0x1 0x3 0x1 0xc1>;
				phandle = <0x7a>;
			};
			i2s1m0-sdi0 {
				rockchip,pins = <0x1 0xb 0x1 0xc1>;
				phandle = <0x7c>;
			};
			i2s1m0-sdo0 {
				rockchip,pins = <0x1 0x7 0x1 0xc1>;
				phandle = <0x7d>;
			};
		};
		i2s2 {
			i2s2m0-lrcktx {
				rockchip,pins = <0x2 0x13 0x1 0xc1>;
				phandle = <0x7f>;
			};
			i2s2m0-sclktx {
				rockchip,pins = <0x2 0x12 0x1 0xc1>;
				phandle = <0x7e>;
			};
			i2s2m0-sdi {
				rockchip,pins = <0x2 0x15 0x1 0xc1>;
				phandle = <0x80>;
			};
			i2s2m0-sdo {
				rockchip,pins = <0x2 0x14 0x1 0xc1>;
				phandle = <0x81>;
			};
		};
		i2s3 {
		};
		isp {
		};
		jtag {
		};
		lcdc {
		};
		mcu {
		};
		npu {
		};
		pcie20 {
		};
		pcie30x1 {
		};
		pcie30x2 {
			pcie30x2m1-pins {
				rockchip,pins = <0x2 0x1c 0x4 0xc1 0x2 0x1e 0x4 0xc1 0x2 0x1d 0x4 0xc1>;
				phandle = <0xd5>;
			};
		};
		pdm {
			pdmm0-clk {
				rockchip,pins = <0x1 0x6 0x3 0xc1>;
				phandle = <0x82>;
			};
			pdmm0-clk1 {
				rockchip,pins = <0x1 0x4 0x3 0xc1>;
				phandle = <0x83>;
			};
			pdmm0-sdi0 {
				rockchip,pins = <0x1 0xb 0x2 0xc1>;
				phandle = <0x84>;
			};
			pdmm0-sdi1 {
				rockchip,pins = <0x1 0xa 0x3 0xc1>;
				phandle = <0x85>;
			};
			pdmm0-sdi2 {
				rockchip,pins = <0x1 0x9 0x3 0xc1>;
				phandle = <0x86>;
			};
			pdmm0-sdi3 {
				rockchip,pins = <0x1 0x8 0x3 0xc1>;
				phandle = <0x87>;
			};
		};
		pmic {
			pmic_int {
				rockchip,pins = <0x0 0x3 0x0 0xc3>;
				phandle = <0x27>;
			};
		};
		pmu {
		};
		pwm0 {
			pwm0m0-pins {
				rockchip,pins = <0x0 0xf 0x1 0xc1>;
				phandle = <0x2c>;
			};
		};
		pwm1 {
			pwm1m0-pins {
				rockchip,pins = <0x0 0x10 0x1 0xc1>;
				phandle = <0x2d>;
			};
		};
		pwm2 {
			pwm2m0-pins {
				rockchip,pins = <0x0 0x11 0x1 0xc1>;
				phandle = <0x2e>;
			};
		};
		pwm3 {
			pwm3-pins {
				rockchip,pins = <0x0 0x12 0x1 0xc1>;
				phandle = <0x2f>;
			};
		};
		pwm4 {
			pwm4-pins {
				rockchip,pins = <0x0 0x13 0x1 0xc1>;
				phandle = <0xad>;
			};
		};
		pwm5 {
			pwm5-pins {
				rockchip,pins = <0x0 0x14 0x1 0xc1>;
				phandle = <0xae>;
			};
		};
		pwm6 {
			pwm6-pins {
				rockchip,pins = <0x0 0x15 0x1 0xc1>;
				phandle = <0xaf>;
			};
		};
		pwm7 {
			pwm7-pins {
				rockchip,pins = <0x0 0x16 0x1 0xc1>;
				phandle = <0xb0>;
			};
		};
		pwm8 {
			pwm8m0-pins {
				rockchip,pins = <0x3 0x9 0x5 0xc1>;
				phandle = <0xb1>;
			};
		};
		pwm9 {
			pwm9m0-pins {
				rockchip,pins = <0x3 0xa 0x5 0xc1>;
				phandle = <0xb2>;
			};
		};
		pwm10 {
			pwm10m0-pins {
				rockchip,pins = <0x3 0xd 0x5 0xc1>;
				phandle = <0xb3>;
			};
		};
		pwm11 {
			pwm11m0-pins {
				rockchip,pins = <0x3 0xe 0x5 0xc1>;
				phandle = <0xb4>;
			};
		};
		pwm12 {
			pwm12m0-pins {
				rockchip,pins = <0x3 0xf 0x2 0xc1>;
				phandle = <0xb5>;
			};
		};
		pwm13 {
			pwm13m0-pins {
				rockchip,pins = <0x3 0x10 0x2 0xc1>;
				phandle = <0xb6>;
			};
		};
		pwm14 {
			pwm14m0-pins {
				rockchip,pins = <0x3 0x14 0x1 0xc1>;
				phandle = <0xb7>;
			};
		};
		pwm15 {
			pwm15m0-pins {
				rockchip,pins = <0x3 0x15 0x1 0xc1>;
				phandle = <0xb8>;
			};
		};
		refclk {
		};
		sata {
		};
		sata0 {
		};
		sata1 {
		};
		sata2 {
		};
		scr {
		};
		sdmmc0 {
			sdmmc0-bus4 {
				rockchip,pins = <0x1 0x1d 0x1 0xc2 0x1 0x1e 0x1 0xc2 0x1 0x1f 0x1 0xc2 0x2 0x0 0x1 0xc2>;
				phandle = <0x6f>;
			};
			sdmmc0-clk {
				rockchip,pins = <0x2 0x2 0x1 0xc2>;
				phandle = <0x70>;
			};
			sdmmc0-cmd {
				rockchip,pins = <0x2 0x1 0x1 0xc2>;
				phandle = <0x71>;
			};
			sdmmc0-det {
				rockchip,pins = <0x0 0x4 0x1 0xc3>;
				phandle = <0x72>;
			};
		};
		sdmmc1 {
		};
		sdmmc2 {
			sdmmc2m0-bus4 {
				rockchip,pins = <0x3 0x16 0x3 0xc2 0x3 0x17 0x3 0xc2 0x3 0x18 0x3 0xc2 0x3 0x19 0x3 0xc2>;
				phandle = <0x4f>;
			};
			sdmmc2m0-clk {
				rockchip,pins = <0x3 0x1b 0x3 0xc2>;
				phandle = <0x51>;
			};
			sdmmc2m0-cmd {
				rockchip,pins = <0x3 0x1a 0x3 0xc2>;
				phandle = <0x50>;
			};
		};
		spdif {
			spdifm0-tx {
				rockchip,pins = <0x1 0x4 0x4 0xc1>;
				phandle = <0x88>;
			};
		};
		spi0 {
			spi0m0-pins {
				rockchip,pins = <0x0 0xd 0x2 0xc1 0x0 0x15 0x2 0xc1 0x0 0xe 0x2 0xc1>;
				phandle = <0x91>;
			};
			spi0m0-cs0 {
				rockchip,pins = <0x0 0x16 0x2 0xc1>;
				phandle = <0x8f>;
			};
			spi0m0-cs1 {
				rockchip,pins = <0x0 0x14 0x2 0xc1>;
				phandle = <0x90>;
			};
		};
		spi1 {
			spi1m0-pins {
				rockchip,pins = <0x2 0xd 0x3 0xc1 0x2 0xe 0x3 0xc1 0x2 0xf 0x4 0xc1>;
				phandle = <0x94>;
			};
			spi1m0-cs0 {
				rockchip,pins = <0x2 0x10 0x4 0xc1>;
				phandle = <0x92>;
			};
			spi1m0-cs1 {
				rockchip,pins = <0x2 0x16 0x3 0xc1>;
				phandle = <0x93>;
			};
		};
		spi2 {
			spi2m0-pins {
				rockchip,pins = <0x2 0x11 0x4 0xc1 0x2 0x12 0x4 0xc1 0x2 0x13 0x4 0xc1>;
				phandle = <0x97>;
			};
			spi2m0-cs0 {
				rockchip,pins = <0x2 0x14 0x4 0xc1>;
				phandle = <0x95>;
			};
			spi2m0-cs1 {
				rockchip,pins = <0x2 0x15 0x4 0xc1>;
				phandle = <0x96>;
			};
		};
		spi3 {
			spi3m0-pins {
				rockchip,pins = <0x4 0xb 0x4 0xc1 0x4 0x8 0x4 0xc1 0x4 0xa 0x4 0xc1>;
				phandle = <0x9a>;
			};
			spi3m0-cs0 {
				rockchip,pins = <0x4 0x6 0x4 0xc1>;
				phandle = <0x98>;
			};
			spi3m0-cs1 {
				rockchip,pins = <0x4 0x7 0x4 0xc1>;
				phandle = <0x99>;
			};
		};
		tsadc {
			tsadc-shutorg {
				rockchip,pins = <0x0 0x1 0x2 0xc1>;
				phandle = <0xaa>;
			};
			tsadc-pin {
				rockchip,pins = <0x0 0x1 0x0 0xc1>;
				phandle = <0xab>;
			};
		};
		uart0 {
			uart0-xfer {
				rockchip,pins = <0x0 0x10 0x3 0xc3 0x0 0x11 0x3 0xc3>;
				phandle = <0x2b>;
			};
		};
		uart1 {
			uart1m0-xfer {
				rockchip,pins = <0x2 0xb 0x2 0xc3 0x2 0xc 0x2 0xc3>;
				phandle = <0x9b>;
			};
			uart1m0-ctsn {
				rockchip,pins = <0x2 0xe 0x2 0xc1>;
				phandle = <0x9c>;
			};
			uart1m0-rtsn {
				rockchip,pins = <0x2 0xd 0x2 0xc1>;
				phandle = <0x9d>;
			};
		};
		uart2 {
			uart2m0-xfer {
				rockchip,pins = <0x0 0x18 0x1 0xc3 0x0 0x19 0x1 0xc3>;
				phandle = <0x9e>;
			};
		};
		uart3 {
			uart3m0-xfer {
				rockchip,pins = <0x1 0x0 0x2 0xc3 0x1 0x1 0x2 0xc3>;
				phandle = <0x9f>;
			};
		};
		uart4 {
			uart4m0-xfer {
				rockchip,pins = <0x1 0x4 0x2 0xc3 0x1 0x6 0x2 0xc3>;
				phandle = <0xa0>;
			};
		};
		uart5 {
			uart5m0-xfer {
				rockchip,pins = <0x2 0x1 0x3 0xc3 0x2 0x2 0x3 0xc3>;
				phandle = <0xa1>;
			};
		};
		uart6 {
			uart6m0-xfer {
				rockchip,pins = <0x2 0x3 0x3 0xc3 0x2 0x4 0x3 0xc3>;
				phandle = <0xa2>;
			};
		};
		uart7 {
			uart7m0-xfer {
				rockchip,pins = <0x2 0x5 0x3 0xc3 0x2 0x6 0x3 0xc3>;
				phandle = <0xa3>;
			};
		};
		uart8 {
			uart8m0-xfer {
				rockchip,pins = <0x2 0x16 0x2 0xc3 0x2 0x15 0x3 0xc3>;
				phandle = <0xa4>;
			};
		};
		uart9 {
			uart9m0-xfer {
				rockchip,pins = <0x2 0x7 0x3 0xc3 0x2 0x8 0x3 0xc3>;
				phandle = <0xa5>;
			};
		};
		vop {
		};
		spi0-hs {
		};
		spi1-hs {
		};
		spi2-hs {
		};
		spi3-hs {
		};
		gmac-txd-level3 {
		};
		gmac-txc-level2 {
		};
		display {
			vcc_mipi_en {
				rockchip,pins = <0x3 0x10 0x0 0xc1>;
				phandle = <0xeb>;
			};
		};
		ethernet {
			eth_phy_rst {
				rockchip,pins = <0x3 0x8 0x0 0xc1>;
				phandle = <0x5d>;
			};
			/omit-if-no-ref/
			eth_phy0_rst {
				rockchip,pins = <0x2 0x1b 0x0 0xc1>;
				phandle = <0x307>;
			};
		};
		hym8563 {
			hym8563-int {
				rockchip,pins = <0x0 0x1b 0x0 0xc3>;
				phandle = <0x8e>;
			};
		};
		leds {
			led_user_en {
				rockchip,pins = <0x0 0xf 0x0 0xc1>;
				phandle = <0xdf>;
			};
		};
		pcie {
			pcie-enable-h {
				rockchip,pins = <0x0 0x1c 0x0 0xc1>;
				phandle = <0xe3>;
			};
			pcie-reset-h {
				rockchip,pins = <0x3 0x11 0x0 0xc1>;
				phandle = <0x6d>;
			};
		};
		usb {
			vcc5v0_usb_host_en {
				rockchip,pins = <0x0 0x6 0x0 0xc1>;
				phandle = <0xe5>;
			};
			vcc5v0_usb_hub_en {
				rockchip,pins = <0x0 0x1d 0x0 0xc1>;
				phandle = <0xe7>;
			};
			vcc5v0_usb_otg_en {
				rockchip,pins = <0x0 0x5 0x0 0xc1>;
				phandle = <0xe8>;
			};
		};
		bt {
			bt-enable {
				rockchip,pins = <0x4 0xa 0x0 0xc1>;
			};
			bt-host-wake {
				rockchip,pins = <0x4 0xc 0x0 0xc9>;
			};
			bt-wake {
				rockchip,pins = <0x4 0xd 0x0 0xc1>;
			};
		};
		sdio-pwrseq {
			wifi-enable {
				rockchip,pins = <0x3 0x1c 0x0 0xc1>;
				phandle = <0xe2>;
			};
		};
	};
	opp-table-0 {
		compatible = "operating-points-v2";
		opp-shared;
		phandle = <0x4>;
		opp-408000000 {
			opp-hz = <0x0 0x18519600>;
			opp-microvolt = <0xcf850 0xcf850 0x118c30>;
			clock-latency-ns = <0x9c40>;
		};
		opp-600000000 {
			opp-hz = <0x0 0x23c34600>;
			opp-microvolt = <0xcf850 0xcf850 0x118c30>;
			clock-latency-ns = <0x9c40>;
		};
		opp-816000000 {
			opp-hz = <0x0 0x30a32c00>;
			opp-microvolt = <0xcf850 0xcf850 0x118c30>;
			clock-latency-ns = <0x9c40>;
			opp-suspend;
		};
		opp-1104000000 {
			opp-hz = <0x0 0x41cdb400>;
			opp-microvolt = <0xdbba0 0xdbba0 0x118c30>;
			clock-latency-ns = <0x9c40>;
		};
		opp-1416000000 {
			opp-hz = <0x0 0x54667200>;
			opp-microvolt = <0xfa3e8 0xfa3e8 0x118c30>;
			clock-latency-ns = <0x9c40>;
		};
		opp-1608000000 {
			opp-hz = <0x0 0x5fd82200>;
			opp-microvolt = <0x10c8e0 0x10c8e0 0x118c30>;
			clock-latency-ns = <0x9c40>;
		};
		opp-1800000000 {
			opp-hz = <0x0 0x6b49d200>;
			opp-microvolt = <0x118c30 0x118c30 0x118c30>;
			clock-latency-ns = <0x9c40>;
		};
		opp-1992000000 {
			opp-hz = <0x0 0x76bb8200>;
			opp-microvolt = <0x118c30 0x118c30 0x118c30>;
			clock-latency-ns = <0x9c40>;
		};
	};
	opp-table-1 {
		compatible = "operating-points-v2";
		mbist-vmin = <0xc96a8 0xdbba0 0xe7ef0>;
		nvmem-cells = <0xca 0xcb 0xcc 0xcd 0xce 0xcf>;
		nvmem-cell-names = "leakage", "pvtm", "mbist-vmin", "opp-info", "specification_serial_number", "remark_spec_serial_number";
		rockchip,supported-hw;
		rockchip,max-volt = <0xf4240>;
		rockchip,temp-hysteresis = <0x1388>;
		rockchip,low-temp = <0x0>;
		rockchip,low-temp-adjust-volt = <0x0 0x320 0xc350>;
		rockchip,pvtm-voltage-sel = <0x0 0x14820 0x0 0x14821 0x153d8 0x1 0x153d9 0x16378 0x2 0x16379 0x186a0 0x3>;
		rockchip,pvtm-ch = <0x0 0x5>;
		phandle = <0x4b>;
		opp-200000000 {
			opp-hz = <0x0 0xbebc200>;
			opp-microvolt = <0xcf850 0xcf850 0xf4240>;
			opp-supported-hw = <0xfb 0xffff>;
		};
		opp-300000000 {
			opp-hz = <0x0 0x11e1a300>;
			opp-microvolt = <0xcf850 0xcf850 0xf4240>;
			opp-supported-hw = <0xfb 0xffff>;
		};
		opp-400000000 {
			opp-hz = <0x0 0x17d78400>;
			opp-microvolt = <0xcf850 0xcf850 0xf4240>;
			opp-supported-hw = <0xfb 0xffff>;
		};
		opp-600000000 {
			opp-hz = <0x0 0x23c34600>;
			opp-microvolt = <0xdbba0 0xdbba0 0xf4240>;
			opp-supported-hw = <0xfb 0xffff>;
			opp-microvolt-L0 = <0xdbba0 0xdbba0 0xf4240>;
			opp-microvolt-L1 = <0xd59f8 0xd59f8 0xf4240>;
			opp-microvolt-L2 = <0xcf850 0xcf850 0xf4240>;
			opp-microvolt-L3 = <0xcf850 0xcf850 0xf4240>;
		};
		opp-700000000 {
			opp-hz = <0x0 0x29b92700>;
			opp-microvolt = <0xe7ef0 0xe7ef0 0xf4240>;
			opp-supported-hw = <0xfb 0xffff>;
			opp-microvolt-L0 = <0xe7ef0 0xe7ef0 0xf4240>;
			opp-microvolt-L1 = <0xe1d48 0xe1d48 0xf4240>;
			opp-microvolt-L2 = <0xdbba0 0xdbba0 0xf4240>;
			opp-microvolt-L3 = <0xd59f8 0xd59f8 0xf4240>;
		};
		opp-800000000 {
			opp-hz = <0x0 0x2faf0800>;
			opp-microvolt = <0xf4240 0xf4240 0xf4240>;
			opp-supported-hw = <0xf9 0xffff>;
			opp-microvolt-L0 = <0xf4240 0xf4240 0xf4240>;
			opp-microvolt-L1 = <0xee098 0xee098 0xf4240>;
			opp-microvolt-L2 = <0xe7ef0 0xe7ef0 0xf4240>;
			opp-microvolt-L3 = <0xe1d48 0xe1d48 0xf4240>;
		};
	};
	xpcs-gmac0-clock {
		compatible = "fixed-clock";
		clock-frequency = <0x7735940>;
		clock-output-names = "clk_gmac0_xpcs_mii";
		#clock-cells = <0x0>;
	};
	sata@fc000000 {
		compatible = "rockchip,rk3568-dwc-ahci", "snps,dwc-ahci";
		reg = <0x0 0xfc000000 0x0 0x1000>;
		clocks = <0x12 0x96 0x12 0x97 0x12 0x98>;
		clock-names = "sata", "pmalive", "rxoob";
		interrupts = <0x0 0x5e 0x4>;
		phys = <0x17 0x1>;
		phy-names = "sata-phy";
		ports-implemented = <0x1>;
		power-domains = <0x14 0xf>;
		status = "disabled";
	};
	syscon@fdc70000 {
		compatible = "rockchip,rk3568-pipe-phy-grf", "syscon";
		reg = <0x0 0xfdc70000 0x0 0x1000>;
		phandle = <0xdd>;
	};
	qos@fe190080 {
		compatible = "rockchip,rk3568-qos", "syscon";
		reg = <0x0 0xfe190080 0x0 0x20>;
		phandle = <0x43>;
	};
	qos@fe190100 {
		compatible = "rockchip,rk3568-qos", "syscon";
		reg = <0x0 0xfe190100 0x0 0x20>;
		phandle = <0x44>;
	};
	qos@fe190200 {
		compatible = "rockchip,rk3568-qos", "syscon";
		reg = <0x0 0xfe190200 0x0 0x20>;
		phandle = <0x45>;
	};
	syscon@fdcb8000 {
		compatible = "rockchip,rk3568-pcie3-phy-grf", "syscon";
		reg = <0x0 0xfdcb8000 0x0 0x10000>;
		phandle = <0xd0>;
	};
	phy@fe8c0000 {
		compatible = "rockchip,rk3568-pcie3-phy";
		reg = <0x0 0xfe8c0000 0x0 0x20000>;
		#phy-cells = <0x0>;
		clocks = <0x22 0x26 0x22 0x27 0x12 0x177>;
		clock-names = "refclk_m", "refclk_n", "pclk";
		resets = <0x12 0x1be>;
		reset-names = "phy";
		rockchip,phy-grf = <0xd0>;
		status = "okay";
		phy-supply = <0xd1>;
		phandle = <0xd3>;
	};
	pcie@fe270000 {
		compatible = "rockchip,rk3568-pcie";
		#address-cells = <0x3>;
		#size-cells = <0x2>;
		bus-range = <0x10 0x1f>;
		clocks = <0x12 0x88 0x12 0x89 0x12 0x8a 0x12 0x8b 0x12 0x8c>;
		clock-names = "aclk_mst", "aclk_slv", "aclk_dbi", "pclk", "aux";
		device_type = "pci";
		interrupts = <0x0 0xa0 0x4 0x0 0x9f 0x4 0x0 0x9e 0x4 0x0 0x9d 0x4 0x0 0x9c 0x4>;
		interrupt-names = "sys", "pmc", "msg", "legacy", "err";
		#interrupt-cells = <0x1>;
		interrupt-map-mask = <0x0 0x0 0x0 0x7>;
		interrupt-map = <0x0 0x0 0x0 0x1 0xd2 0x0 0x0 0x0 0x0 0x2 0xd2 0x1 0x0 0x0 0x0 0x3 0xd2 0x2 0x0 0x0 0x0 0x4 0xd2 0x3>;
		linux,pci-domain = <0x1>;
		num-ib-windows = <0x6>;
		num-ob-windows = <0x2>;
		max-link-speed = <0x3>;
		msi-map = <0x1000 0x6c 0x1000 0x1000>;
		num-lanes = <0x1>;
		phys = <0xd3>;
		phy-names = "pcie-phy";
		power-domains = <0x14 0xf>;
		reg = <0x3 0xc0400000 0x0 0x400000 0x0 0xfe270000 0x0 0x10000 0x0 0xf2000000 0x0 0x100000>;
		ranges = <0x1000000 0x0 0xf2100000 0x0 0xf2100000 0x0 0x100000 0x2000000 0x0 0xf2200000 0x0 0xf2200000 0x0 0xc10000 0x3000000 0x3 0x40000000 0x3 0x40000000 0x0 0x40000000>;
		reg-names = "dbi", "apb", "config";
		resets = <0x12 0xb1>;
		reset-names = "pipe";
		status = "disabled";
		legacy-interrupt-controller {
			interrupt-controller;
			#address-cells = <0x0>;
			#interrupt-cells = <0x1>;
			interrupt-parent = <0x1>;
			interrupts = <0x0 0x9d 0x1>;
			phandle = <0xd2>;
		};
	};
	pcie@fe280000 {
		compatible = "rockchip,rk3568-pcie";
		#address-cells = <0x3>;
		#size-cells = <0x2>;
		bus-range = <0x20 0x2f>;
		clocks = <0x12 0x8f 0x12 0x90 0x12 0x91 0x12 0x92 0x12 0x93>;
		clock-names = "aclk_mst", "aclk_slv", "aclk_dbi", "pclk", "aux";
		device_type = "pci";
		interrupts = <0x0 0xa5 0x4 0x0 0xa4 0x4 0x0 0xa3 0x4 0x0 0xa2 0x4 0x0 0xa1 0x4>;
		interrupt-names = "sys", "pmc", "msg", "legacy", "err";
		#interrupt-cells = <0x1>;
		interrupt-map-mask = <0x0 0x0 0x0 0x7>;
		interrupt-map = <0x0 0x0 0x0 0x1 0xd4 0x0 0x0 0x0 0x0 0x2 0xd4 0x1 0x0 0x0 0x0 0x3 0xd4 0x2 0x0 0x0 0x0 0x4 0xd4 0x3>;
		linux,pci-domain = <0x2>;
		num-ib-windows = <0x6>;
		num-ob-windows = <0x2>;
		max-link-speed = <0x3>;
		msi-map = <0x2000 0x6c 0x2000 0x1000>;
		num-lanes = <0x2>;
		phys = <0xd3>;
		phy-names = "pcie-phy";
		power-domains = <0x14 0xf>;
		reg = <0x3 0xc0800000 0x0 0x400000 0x0 0xfe280000 0x0 0x10000 0x0 0xf0000000 0x0 0x100000>;
		ranges = <0x1000000 0x0 0xf0100000 0x0 0xf0100000 0x0 0x100000 0x2000000 0x0 0xf0200000 0x0 0xf0200000 0x0 0xc10000 0x3000000 0x3 0x80000000 0x3 0x80000000 0x0 0x40000000>;
		reg-names = "dbi", "apb", "config";
		resets = <0x12 0xc1>;
		reset-names = "pipe";
		status = "okay";
		pinctrl-names = "default";
		pinctrl-0 = <0xd5>;
		reset-gpios = <0xd6 0x1e 0x0>;
		vpcie3v3-supply = <0x6e>;
		legacy-interrupt-controller {
			interrupt-controller;
			#address-cells = <0x0>;
			#interrupt-cells = <0x1>;
			interrupt-parent = <0x1>;
			interrupts = <0x0 0xa2 0x1>;
			phandle = <0xd4>;
		};
	};
		ethernet@fe2a0000 {
		compatible = "rockchip,rk3568-gmac", "snps,dwmac-4.20a";
		reg = <0x0 0xfe2a0000 0x0 0x10000>;
		interrupts = <0x0 0x1b 0x4 0x0 0x18 0x4>;
		interrupt-names = "macirq", "eth_wake_irq";
		rockchip,grf = <0x23>;
		clocks = <0x12 0x182 0x12 0x185 0x12 0x185 0x12 0xb8 0x12 0xb4 0x12 0xb5 0x12 0x185 0x12 0xb9 0x12 0xac 0x12 0xab>;
		clock-names = "stmmaceth", "mac_clk_rx", "mac_clk_tx", "clk_mac_refout", "aclk_mac", "pclk_mac", "clk_mac_speed", "ptp_ref", "pclk_xpcs", "clk_xpcs_eee";
		resets = <0x12 0xd7>;
		reset-names = "stmmaceth";
		snps,mixed-burst;
		snps,tso;
		snps,axi-config = <0x310>;
		snps,mtl-rx-config = <0x311>;
		snps,mtl-tx-config = <0x312>;
		status = "okay";
		phy-mode = "rgmii";
		clock_in_out = "output";
		snps,reset-gpio = <0xd6 0x1b 0x1>;
		snps,reset-active-low;
		snps,reset-delays-us = <0x0 0x4e20 0x186a0>;
		assigned-clocks = <0x12 0x185 0x12 0x182>;
		assigned-clock-parents = <0x12 0x183 0x12 0xb6>;
		assigned-clock-rates = <0x0 0x7735940>;
		pinctrl-names = "default";
		pinctrl-0 = <0x301 0x302 0x303 0x304 0x306>;
		tx_delay = <0x21>;
		rx_delay = <0x3c>;
		phy-handle = <0x300>;
		mdio {
			compatible = "snps,dwmac-mdio";
			#address-cells = <0x1>;
			#size-cells = <0x0>;
			phy@0 {
				compatible = "ethernet-phy-ieee802.3-c22";
				reg = <0x0>;
				phandle = <0x300>;
			};
		};
		stmmac-axi-config {
			snps,blen = <0x0 0x0 0x0 0x0 0x10 0x8 0x4>;
			snps,rd_osr_lmt = <0x8>;
			snps,wr_osr_lmt = <0x4>;
			phandle = <0x310>;
		};
		rx-queues-config {
			snps,rx-queues-to-use = <0x1>;
			phandle = <0x311>;
			queue0 {
			};
		};
		tx-queues-config {
			snps,tx-queues-to-use = <0x1>;
			phandle = <0x312>;
			queue0 {
			};
		};
	};	can@fe570000 {
		compatible = "rockchip,rk3568v2-canfd";
		reg = <0x0 0xfe570000 0x0 0x1000>;
		interrupts = <0x0 0x1 0x4>;
		clocks = <0x12 0x141 0x12 0x140>;
		clock-names = "baud", "pclk";
		resets = <0x12 0x155 0x12 0x154>;
		reset-names = "core", "apb";
		pinctrl-names = "default";
		pinctrl-0 = <0xda>;
		status = "disabled";
	};
	can@fe580000 {
		compatible = "rockchip,rk3568v2-canfd";
		reg = <0x0 0xfe580000 0x0 0x1000>;
		interrupts = <0x0 0x2 0x4>;
		clocks = <0x12 0x143 0x12 0x142>;
		clock-names = "baud", "pclk";
		resets = <0x12 0x157 0x12 0x156>;
		reset-names = "core", "apb";
		pinctrl-names = "default";
		pinctrl-0 = <0xdb>;
		status = "disabled";
	};
	can@fe590000 {
		compatible = "rockchip,rk3568v2-canfd";
		reg = <0x0 0xfe590000 0x0 0x1000>;
		interrupts = <0x0 0x3 0x4>;
		clocks = <0x12 0x145 0x12 0x144>;
		clock-names = "baud", "pclk";
		resets = <0x12 0x159 0x12 0x158>;
		reset-names = "core", "apb";
		pinctrl-names = "default";
		pinctrl-0 = <0xdc>;
		status = "disabled";
	};
	phy@fe820000 {
		compatible = "rockchip,rk3568-naneng-combphy";
		reg = <0x0 0xfe820000 0x0 0x100>;
		clocks = <0x22 0x1f 0x12 0x17c 0x12 0x7f>;
		clock-names = "ref", "apb", "pipe";
		assigned-clocks = <0x22 0x1f>;
		assigned-clock-rates = <0x5f5e100>;
		resets = <0x12 0x1c5>;
		reset-names = "phy";
		rockchip,pipe-grf = <0xb9>;
		rockchip,pipe-phy-grf = <0xdd>;
		#phy-cells = <0x1>;
		status = "okay";
		phandle = <0x17>;
	};
	chosen {
		stdout-path = "serial2:1500000n8";
	};
	hdmi-con {
		compatible = "hdmi-connector";
		type = "a";
		port {
			endpoint {
				remote-endpoint = <0xde>;
				phandle = <0x69>;
			};
		};
	};
	external-gmac1-clock {
		compatible = "fixed-clock";
		clock-frequency = <0x7735940>;
		clock-output-names = "gmac1_clkin";
		#clock-cells = <0x0>;
		phandle = <0x55>;
	};
	leds {
		compatible = "gpio-leds";
		led-0 {
			gpios = <0x26 0xf 0x0>;
			function = "heartbeat";
			color = <0x3>;
			linux,default-trigger = "heartbeat";
			pinctrl-names = "default";
			pinctrl-0 = <0xdf>;
		};
	};
	rk809-sound {
		compatible = "simple-audio-card";
		simple-audio-card,format = "i2s";
		simple-audio-card,name = "Analog RK809";
		simple-audio-card,mclk-fs = <0x100>;
		simple-audio-card,cpu {
			sound-dai = <0xe0>;
		};
		simple-audio-card,codec {
			sound-dai = <0xe1>;
		};
	};
	sdio-pwrseq {
		compatible = "mmc-pwrseq-simple";
		clocks = <0xe1 0x1>;
		clock-names = "ext_clock";
		pinctrl-names = "default";
		pinctrl-0 = <0xe2>;
		post-power-on-delay-ms = <0x64>;
		power-off-delay-us = <0x4c4b40>;
		reset-gpios = <0x5e 0x1c 0x1>;
		phandle = <0x4e>;
	};
	regulator-vcc12v-dcin {
		compatible = "regulator-fixed";
		regulator-name = "vcc12v_dcin";
		regulator-always-on;
		regulator-boot-on;
		phandle = <0xe4>;
	};
	regulator-pcie30-avdd0v9 {
		compatible = "regulator-fixed";
		regulator-name = "pcie30_avdd0v9";
		regulator-always-on;
		regulator-boot-on;
		regulator-min-microvolt = <0xdbba0>;
		regulator-max-microvolt = <0xdbba0>;
		vin-supply = <0x29>;
	};
	regulator-pcie30-avdd1v8 {
		compatible = "regulator-fixed";
		regulator-name = "pcie30_avdd1v8";
		regulator-always-on;
		regulator-boot-on;
		regulator-min-microvolt = <0x1b7740>;
		regulator-max-microvolt = <0x1b7740>;
		vin-supply = <0x29>;
	};
	regulator-vcc3v3-pi6c-03 {
		compatible = "regulator-fixed";
		regulator-name = "vcc3v3_pi6c_03";
		regulator-always-on;
		regulator-boot-on;
		regulator-min-microvolt = <0x325aa0>;
		regulator-max-microvolt = <0x325aa0>;
		vin-supply = <0x25>;
		phandle = <0xd1>;
	};
	regulator-vcc3v3-pcie {
		compatible = "regulator-fixed";
		enable-active-high;
		gpios = <0x26 0x1c 0x0>;
		pinctrl-names = "default";
		pinctrl-0 = <0xe3>;
		regulator-name = "vcc3v3_pcie";
		regulator-min-microvolt = <0x325aa0>;
		regulator-max-microvolt = <0x325aa0>;
		vin-supply = <0x25>;
		phandle = <0x6e>;
	};
	regulator-vcc3v3-sys {
		compatible = "regulator-fixed";
		regulator-name = "vcc3v3_sys";
		regulator-always-on;
		regulator-boot-on;
		regulator-min-microvolt = <0x325aa0>;
		regulator-max-microvolt = <0x325aa0>;
		vin-supply = <0xe4>;
		phandle = <0x29>;
	};
	regulator-vcc5v0-sys {
		compatible = "regulator-fixed";
		regulator-name = "vcc5v0_sys";
		regulator-always-on;
		regulator-boot-on;
		regulator-min-microvolt = <0x4c4b40>;
		regulator-max-microvolt = <0x4c4b40>;
		vin-supply = <0xe4>;
		phandle = <0x25>;
	};
	regulator-vcc5v0-usb {
		compatible = "regulator-fixed";
		regulator-name = "vcc5v0_usb";
		regulator-always-on;
		regulator-boot-on;
		regulator-min-microvolt = <0x4c4b40>;
		regulator-max-microvolt = <0x4c4b40>;
		vin-supply = <0xe4>;
		phandle = <0xe6>;
	};
	regulator-vcc5v0-usb-host {
		compatible = "regulator-fixed";
		enable-active-high;
		gpio = <0x26 0x6 0x0>;
		pinctrl-names = "default";
		pinctrl-0 = <0xe5>;
		regulator-name = "vcc5v0_usb_host";
		regulator-min-microvolt = <0x4c4b40>;
		regulator-max-microvolt = <0x4c4b40>;
		vin-supply = <0xe6>;
		phandle = <0xbd>;
	};
	regulator-vcc5v0-usb-hub {
		compatible = "regulator-fixed";
		enable-active-high;
		gpio = <0x26 0x1d 0x0>;
		pinctrl-names = "default";
		pinctrl-0 = <0xe7>;
		regulator-name = "vcc5v0_usb_hub";
		regulator-always-on;
		vin-supply = <0xe6>;
	};
	regulator-vcc5v0-usb-otg {
		compatible = "regulator-fixed";
		enable-active-high;
		gpio = <0x26 0x5 0x0>;
		pinctrl-names = "default";
		pinctrl-0 = <0xe8>;
		regulator-name = "vcc5v0_usb_otg";
		regulator-min-microvolt = <0x4c4b40>;
		regulator-max-microvolt = <0x4c4b40>;
		vin-supply = <0xe6>;
		phandle = <0xbe>;
	};
	regulator-vcc-cam {
		compatible = "regulator-fixed";
		enable-active-high;
		gpio = <0xe9 0x9 0x0>;
		pinctrl-names = "default";
		pinctrl-0 = <0xea>;
		regulator-name = "vcc_cam";
		regulator-min-microvolt = <0x325aa0>;
		regulator-max-microvolt = <0x325aa0>;
		vin-supply = <0x29>;
		regulator-state-mem {
			regulator-off-in-suspend;
		};
	};
	regulator-vcc-mipi {
		compatible = "regulator-fixed";
		enable-active-high;
		gpio = <0x5e 0x10 0x0>;
		pinctrl-names = "default";
		pinctrl-0 = <0xeb>;
		regulator-name = "vcc_mipi";
		regulator-min-microvolt = <0x325aa0>;
		regulator-max-microvolt = <0x325aa0>;
		vin-supply = <0x29>;
		regulator-state-mem {
			regulator-off-in-suspend;
		};
	};
	rockchip-system-monitor {
		compatible = "rockchip,system-monitor";
		rockchip,thermal-zone = "cpu-thermal";
		status = "disabled";
	};
	sram@fdcc0000 {
		compatible = "mmio-sram";
		reg = <0x0 0xfdcc0000 0x0 0xb000>;
		#address-cells = <0x1>;
		#size-cells = <0x1>;
		ranges = <0x0 0x0 0xfdcc0000 0xb000>;
		rkvdec-sram@0 {
			reg = <0x0 0xb000>;
			phandle = <0xf3>;
		};
	};
	mpp-srv {
		compatible = "rockchip,mpp-service";
		rockchip,taskqueue-count = <0x6>;
		rockchip,resetgroup-count = <0x6>;
		status = "okay";
		phandle = <0xec>;
	};
	vdpu@fdea0400 {
		compatible = "rockchip,vpu-decoder-v2";
		reg = <0x0 0xfdea0400 0x0 0x400>;
		interrupts = <0x0 0x8b 0x4>;
		interrupt-names = "irq_dec";
		clocks = <0x12 0xee 0x12 0xef>;
		clock-names = "aclk_vcodec", "hclk_vcodec";
		resets = <0x12 0x11a 0x12 0x11b>;
		reset-names = "video_a", "video_h";
		iommus = <0x4d>;
		power-domains = <0x14 0xb>;
		rockchip,srv = <0xec>;
		rockchip,taskqueue-node = <0x0>;
		rockchip,resetgroup-node = <0x0>;
		status = "okay";
	};
	rk_rga@fdeb0000 {
		compatible = "rockchip,rga2";
		reg = <0x0 0xfdeb0000 0x0 0x1000>;
		interrupts = <0x0 0x5a 0x4>;
		clocks = <0x12 0xf3 0x12 0xf4 0x12 0xf5>;
		clock-names = "aclk_rga", "hclk_rga", "clk_rga";
		power-domains = <0x14 0xa>;
		status = "okay";
	};
	jpegd@fded0000 {
		compatible = "rockchip,rkv-jpeg-decoder-v1";
		reg = <0x0 0xfded0000 0x0 0x400>;
		interrupts = <0x0 0x3e 0x4>;
		clocks = <0x12 0xfb 0x12 0xfc>;
		clock-names = "aclk_vcodec", "hclk_vcodec";
		rockchip,disable-auto-freq;
		resets = <0x12 0x12c 0x12 0x12d>;
		reset-names = "video_a", "video_h";
		iommus = <0xed>;
		rockchip,srv = <0xec>;
		rockchip,taskqueue-node = <0x1>;
		rockchip,resetgroup-node = <0x1>;
		power-domains = <0x14 0xa>;
		status = "okay";
	};
	iommu@fded0480 {
		compatible = "rockchip,rk3568-iommu", "rockchip,iommu-v2";
		reg = <0x0 0xfded0480 0x0 0x40>;
		interrupts = <0x0 0x3d 0x4>;
		interrupt-names = "jpegd_mmu";
		clock-names = "aclk", "iface";
		clocks = <0x12 0xfb 0x12 0xfc>;
		power-domains = <0x14 0xa>;
		#iommu-cells = <0x0>;
		status = "okay";
		phandle = <0xed>;
	};
	vepu@fdee0000 {
		compatible = "rockchip,vpu-encoder-v2";
		reg = <0x0 0xfdee0000 0x0 0x400>;
		interrupts = <0x0 0x40 0x4>;
		clocks = <0x12 0xfd 0x12 0xfe>;
		clock-names = "aclk_vcodec", "hclk_vcodec";
		rockchip,disable-auto-freq;
		resets = <0x12 0x12e 0x12 0x12f>;
		reset-names = "video_a", "video_h";
		iommus = <0xee>;
		rockchip,srv = <0xec>;
		rockchip,taskqueue-node = <0x2>;
		rockchip,resetgroup-node = <0x2>;
		power-domains = <0x14 0xa>;
		status = "okay";
	};
	iep@fdef0000 {
		compatible = "rockchip,iep-v2";
		reg = <0x0 0xfdef0000 0x0 0x500>;
		interrupts = <0x0 0x38 0x4>;
		clocks = <0x12 0xf6 0x12 0xf7 0x12 0xf8>;
		clock-names = "aclk", "hclk", "sclk";
		resets = <0x12 0x127 0x12 0x128 0x12 0x129>;
		reset-names = "rst_a", "rst_h", "rst_s";
		power-domains = <0x14 0xa>;
		rockchip,srv = <0xec>;
		rockchip,taskqueue-node = <0x5>;
		rockchip,resetgroup-node = <0x5>;
		iommus = <0xef>;
		status = "okay";
	};
	iommu@fdef0800 {
		compatible = "rockchip,rk3568-iommu", "rockchip,iommu-v2";
		reg = <0x0 0xfdef0800 0x0 0x100>;
		interrupts = <0x0 0x38 0x4>;
		interrupt-names = "iep_mmu";
		clocks = <0x12 0xf6 0x12 0xf7>;
		clock-names = "aclk", "iface";
		#iommu-cells = <0x0>;
		power-domains = <0x14 0xa>;
		status = "okay";
		phandle = <0xef>;
	};
	rkvenc@fdf40000 {
		compatible = "rockchip,rkv-encoder-v1";
		reg = <0x0 0xfdf40000 0x0 0x400>;
		interrupts = <0x0 0x8c 0x4>;
		interrupt-names = "irq_enc";
		clocks = <0x12 0x103 0x12 0x104 0x12 0x105>;
		clock-names = "aclk_vcodec", "hclk_vcodec", "clk_core";
		rockchip,normal-rates = <0x11b3dc40 0x0 0x11b3dc40>;
		resets = <0x12 0x133 0x12 0x134 0x12 0x135>;
		reset-names = "video_a", "video_h", "video_core";
		assigned-clocks = <0x12 0x103 0x12 0x105>;
		assigned-clock-rates = <0x11b3dc40 0x11b3dc40>;
		iommus = <0xf0>;
		node-name = "rkvenc";
		rockchip,srv = <0xec>;
		rockchip,taskqueue-node = <0x3>;
		rockchip,resetgroup-node = <0x3>;
		power-domains = <0x14 0xe>;
		status = "okay";
		venc-supply = <0xf1>;
	};
	rkvenc-opp-table {
		compatible = "operating-points-v2";
		nvmem-cells = <0xcb>;
		nvmem-cell-names = "pvtm";
		rockchip,pvtm-voltage-sel = <0x0 0x14820 0x0 0x14821 0x16378 0x1 0x16379 0x186a0 0x2>;
		rockchip,pvtm-ch = <0x0 0x5>;
		opp-297000000 {
			opp-hz = <0x0 0x11b3dc40>;
			opp-microvolt = <0xdbba0>;
			opp-microvolt-L0 = <0xdbba0>;
			opp-microvolt-L1 = <0xd59f8>;
			opp-microvolt-L2 = <0xd59f8>;
		};
		opp-400000000 {
			opp-hz = <0x0 0x17d78400>;
			opp-microvolt = <0xe7ef0>;
			opp-microvolt-L0 = <0xe7ef0>;
			opp-microvolt-L1 = <0xe1d48>;
			opp-microvolt-L2 = <0xdbba0>;
		};
	};
	iommu@fdf40f00 {
		compatible = "rockchip,rk3568-iommu", "rockchip,iommu-v2";
		reg = <0x0 0xfdf40f00 0x0 0x40 0x0 0xfdf40f40 0x0 0x40>;
		interrupts = <0x0 0x8d 0x4 0x0 0x8e 0x4>;
		interrupt-names = "rkvenc_mmu0", "rkvenc_mmu1";
		clocks = <0x12 0x103 0x12 0x104>;
		clock-names = "aclk", "iface";
		rockchip,disable-mmu-reset;
		rockchip,enable-cmd-retry;
		#iommu-cells = <0x0>;
		power-domains = <0x14 0xe>;
		status = "okay";
		phandle = <0xf0>;
	};
	rkvdec@fdf80200 {
		compatible = "rockchip,rkv-decoder-rk3568", "rockchip,rkv-decoder-v2";
		reg = <0x0 0xfdf80200 0x0 0x400 0x0 0xfdf80100 0x0 0x100>;
		reg-names = "regs", "link";
		interrupts = <0x0 0x5b 0x4>;
		interrupt-names = "irq_dec";
		clocks = <0x12 0x108 0x12 0x109 0x12 0x10a 0x12 0x10b 0x12 0x10c>;
		clock-names = "aclk_vcodec", "hclk_vcodec", "clk_cabac", "clk_core", "clk_hevc_cabac";
		rockchip,normal-rates = <0x11b3dc40 0x0 0x11b3dc40 0x11b3dc40 0x23c34600>;
		rockchip,advanced-rates = <0x179a7b00 0x0 0x179a7b00 0x179a7b00 0x23c34600>;
		rockchip,default-max-load = <0x1fe000>;
		resets = <0x12 0x142 0x12 0x143 0x12 0x144 0x12 0x145 0x12 0x146>;
		assigned-clocks = <0x12 0x108 0x12 0x10a 0x12 0x10b 0x12 0x10c>;
		assigned-clock-rates = <0x179a7b00 0x179a7b00 0x179a7b00 0x23c34600>;
		reset-names = "video_a", "video_h", "video_cabac", "video_core", "video_hevc_cabac";
		power-domains = <0x14 0xd>;
		vdec-supply = <0xf1>;
		iommus = <0xf2>;
		rockchip,srv = <0xec>;
		rockchip,taskqueue-node = <0x4>;
		rockchip,resetgroup-node = <0x4>;
		rockchip,sram = <0xf3>;
		rockchip,rcb-iova = <0x10000000 0x10000>;
		rockchip,rcb-min-width = <0x200>;
		rockchip,task-capacity = <0x10>;
		status = "okay";
		rockchip,disable-auto-freq;
	};
	rkvdec-opp-table {
		compatible = "operating-points-v2";
		nvmem-cells = <0xf4 0xcb>;
		nvmem-cell-names = "leakage", "pvtm";
		rockchip,leakage-voltage-sel = <0x1 0x50 0x0 0x51 0xfe 0x1>;
		rockchip,pvtm-voltage-sel = <0x0 0x14820 0x0 0x14821 0x186a0 0x1>;
		rockchip,pvtm-ch = <0x0 0x5>;
		opp-297000000 {
			opp-hz = <0x0 0x11b3dc40>;
			opp-microvolt = <0xdbba0>;
			opp-microvolt-L0 = <0xdbba0>;
			opp-microvolt-L1 = <0xd59f8>;
		};
		opp-400000000 {
			opp-hz = <0x0 0x17d78400>;
			opp-microvolt = <0xdbba0>;
		};
	};
	iommu@fdf80800 {
		compatible = "rockchip,rk3568-iommu", "rockchip,iommu-v2";
		reg = <0x0 0xfdf80800 0x0 0x40 0x0 0xfdf80840 0x0 0x40>;
		interrupts = <0x0 0x5c 0x4>;
		interrupt-names = "rkvdec_mmu";
		clocks = <0x12 0x108 0x12 0x109>;
		clock-names = "aclk", "iface";
		power-domains = <0x14 0xd>;
		#iommu-cells = <0x0>;
		status = "okay";
		phandle = <0xf2>;
	};
	npu@fde40000 {
		compatible = "rockchip,rk3568-rknpu", "rockchip,rknpu";
		reg = <0x0 0xfde40000 0x0 0x10000>;
		interrupts = <0x0 0x97 0x4>;
		interrupt-names = "npu_irq";
		clocks = <0x2 0x2 0x12 0x23 0x12 0x28 0x12 0x29>;
		clock-names = "scmi_clk", "clk", "aclk", "hclk";
		assigned-clocks = <0x12 0x23>;
		assigned-clock-rates = <0x23c34600>;
		resets = <0x12 0x2b 0x12 0x2c>;
		reset-names = "srst_a", "srst_h";
		power-domains = <0x14 0x6>;
		operating-points-v2 = <0xf5>;
		iommus = <0xf6>;
		status = "okay";
		rknpu-supply = <0xf7>;
	};
	npu-opp-table {
		compatible = "operating-points-v2";
		mbist-vmin = <0xc96a8 0xdbba0 0xe7ef0>;
		nvmem-cells = <0xf8 0xcb 0xcc 0xf9 0xce 0xcf>;
		nvmem-cell-names = "leakage", "pvtm", "mbist-vmin", "opp-info", "specification_serial_number", "remark_spec_serial_number";
		rockchip,supported-hw;
		rockchip,max-volt = <0xf4240>;
		rockchip,temp-hysteresis = <0x1388>;
		rockchip,low-temp = <0x0>;
		rockchip,low-temp-adjust-volt = <0x0 0x3e8 0xc350>;
		rockchip,pvtm-voltage-sel = <0x0 0x14820 0x0 0x14821 0x153d8 0x1 0x153d9 0x16378 0x2 0x16379 0x186a0 0x3>;
		rockchip,pvtm-ch = <0x0 0x5>;
		rockchip,init-freq = <0xdbba0>;
		phandle = <0xf5>;
		opp-200000000 {
			opp-supported-hw = <0xfb 0xffff>;
			opp-hz = <0x0 0xbebc200>;
			opp-microvolt = <0xcf850 0xcf850 0xf4240>;
		};
		opp-300000000 {
			opp-supported-hw = <0xfb 0xffff>;
			opp-hz = <0x0 0x11b3dc40>;
			opp-microvolt = <0xcf850 0xcf850 0xf4240>;
		};
		opp-400000000 {
			opp-supported-hw = <0xfb 0xffff>;
			opp-hz = <0x0 0x17d78400>;
			opp-microvolt = <0xcf850 0xcf850 0xf4240>;
		};
		opp-600000000 {
			opp-supported-hw = <0xfb 0xffff>;
			opp-hz = <0x0 0x23c34600>;
			opp-microvolt = <0xcf850 0xcf850 0xf4240>;
		};
		opp-700000000 {
			opp-supported-hw = <0xfb 0xffff>;
			opp-hz = <0x0 0x29b92700>;
			opp-microvolt = <0xd59f8 0xd59f8 0xf4240>;
			opp-microvolt-L0 = <0xd59f8 0xd59f8 0xf4240>;
			opp-microvolt-L1 = <0xcf850 0xcf850 0xf4240>;
			opp-microvolt-L2 = <0xcf850 0xcf850 0xf4240>;
			opp-microvolt-L3 = <0xcf850 0xcf850 0xf4240>;
		};
		opp-800000000 {
			opp-supported-hw = <0xfb 0xffff>;
			opp-hz = <0x0 0x2faf0800>;
			opp-microvolt = <0xe1d48 0xe1d48 0xf4240>;
			opp-microvolt-L0 = <0xe1d48 0xe1d48 0xf4240>;
			opp-microvolt-L1 = <0xdbba0 0xdbba0 0xf4240>;
			opp-microvolt-L2 = <0xd59f8 0xd59f8 0xf4240>;
			opp-microvolt-L3 = <0xd59f8 0xd59f8 0xf4240>;
		};
		opp-900000000 {
			opp-supported-hw = <0xf9 0xffff>;
			opp-hz = <0x0 0x35a4e900>;
			opp-microvolt = <0xee098 0xee098 0xf4240>;
			opp-microvolt-L0 = <0xee098 0xee098 0xf4240>;
			opp-microvolt-L1 = <0xe7ef0 0xe7ef0 0xf4240>;
			opp-microvolt-L2 = <0xe1d48 0xe1d48 0xf4240>;
			opp-microvolt-L3 = <0xdbba0 0xdbba0 0xf4240>;
		};
		opp-1000000000 {
			opp-supported-hw = <0xf9 0xffff>;
			opp-hz = <0x0 0x3b9aca00>;
			opp-microvolt = <0xf4240 0xf4240 0xf4240>;
			opp-microvolt-L0 = <0xf4240 0xf4240 0xf4240>;
			opp-microvolt-L1 = <0xee098 0xee098 0xf4240>;
			opp-microvolt-L2 = <0xe7ef0 0xe7ef0 0xf4240>;
			opp-microvolt-L3 = <0xe1d48 0xe1d48 0xf4240>;
			status = "disabled";
		};
	};
	bus-npu {
		compatible = "rockchip,rk3568-bus";
		rockchip,busfreq-policy = "clkfreq";
		clocks = <0x2 0x2>;
		clock-names = "bus";
		operating-points-v2 = <0xfa>;
		status = "okay";
		bus-supply = <0xf1>;
		pvtm-supply = <0x5>;
	};
	bus-npu-opp-table {
		compatible = "operating-points-v2";
		opp-shared;
		nvmem-cells = <0xcb>;
		nvmem-cell-names = "pvtm";
		rockchip,pvtm-voltage-sel = <0x0 0x14820 0x0 0x14821 0x16378 0x1 0x16379 0x186a0 0x2>;
		rockchip,pvtm-ch = <0x0 0x5>;
		phandle = <0xfa>;
		opp-700000000 {
			opp-hz = <0x0 0x29b92700>;
			opp-microvolt = <0xdbba0>;
			opp-microvolt-L0 = <0xdbba0>;
			opp-microvolt-L1 = <0xd59f8>;
			opp-microvolt-L2 = <0xd59f8>;
		};
		opp-900000000 {
			opp-hz = <0x0 0x35a4e900>;
			opp-microvolt = <0xdbba0>;
		};
		opp-1000000000 {
			opp-hz = <0x0 0x3b9aca00>;
			opp-microvolt = <0xe7ef0>;
			opp-microvolt-L0 = <0xe7ef0>;
			opp-microvolt-L1 = <0xe1d48>;
			opp-microvolt-L2 = <0xdbba0>;
		};
	};
	iommu@fde4b000 {
		compatible = "rockchip,rk3568-iommu", "rockchip,iommu-v2";
		reg = <0x0 0xfde4b000 0x0 0x40>;
		interrupts = <0x0 0x97 0x4>;
		interrupt-names = "rknpu_mmu";
		clocks = <0x12 0x28 0x12 0x29>;
		clock-names = "aclk", "iface";
		power-domains = <0x14 0x6>;
		#iommu-cells = <0x0>;
		status = "okay";
		phandle = <0xf6>;
	};
	crypto@fe380000 {
		compatible = "rockchip,rk3568-crypto";
		reg = <0x0 0xfe380000 0x0 0x4000>;
		interrupts = <0x0 0x4 0x4>;
		clocks = <0x12 0x6a 0x12 0x6b 0x12 0x6c 0x12 0x6d>;
		clock-names = "aclk", "hclk", "sclk", "apb_pclk";
		assigned-clocks = <0x12 0x6c>;
		assigned-clock-rates = <0xbebc200>;
		resets = <0x12 0x69>;
		reset-names = "crypto-rst";
		status = "okay";
	};
};
