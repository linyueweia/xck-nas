/dts-v1/;

/ {
	interrupt-parent = <0x01>;
	#address-cells = <0x02>;
	#size-cells = <0x02>;
	compatible = "rockchip,rk3568-kickpi-k1", "rockchip,rk3568";
	model = "Rockchip RK3568 KICKPI K1 Board";

	ddr3-params {
		version = <0x100>;
		expanded_version = <0x00>;
		reserved = <0x00>;
		freq_0 = <0x420>;
		freq_1 = <0x144>;
		freq_2 = <0x210>;
		freq_3 = <0x30c>;
		freq_4 = <0x00>;
		freq_5 = <0x00>;
		pd_idle = <0x0d>;
		sr_idle = <0x5d>;
		sr_mc_gate_idle = <0x00>;
		srpd_lite_idle = <0x00>;
		standby_idle = <0x00>;
		pd_dis_freq = <0x42a>;
		sr_dis_freq = <0x320>;
		dram_dll_dis_freq = <0x12c>;
		phy_dll_dis_freq = <0x00>;
		phy_dq_drv_odten = <0x21>;
		phy_ca_drv_odten = <0x21>;
		phy_clk_drv_odten = <0x21>;
		dram_dq_drv_odten = <0x22>;
		phy_dq_drv_odtoff = <0x21>;
		phy_ca_drv_odtoff = <0x21>;
		phy_clk_drv_odtoff = <0x21>;
		dram_dq_drv_odtoff = <0x22>;
		dram_odt = <0x78>;
		phy_odt = <0xa7>;
		phy_odt_puup_en = <0x01>;
		phy_odt_pudn_en = <0x01>;
		dram_dq_odt_en_freq = <0x14d>;
		phy_odt_en_freq = <0x14d>;
		phy_dq_sr_odten = <0x0f>;
		phy_ca_sr_odten = <0x03>;
		phy_clk_sr_odten = <0x00>;
		phy_dq_sr_odtoff = <0x0f>;
		phy_ca_sr_odtoff = <0x03>;
		phy_clk_sr_odtoff = <0x00>;
		ssmod_downspread = <0x00>;
		ssmod_div = <0x00>;
		ssmod_spread = <0x00>;
		mode_2t = <0x00>;
		speed_bin = <0x15>;
		dram_ext_temp = <0x00>;
		byte_map = <0xe4>;
		dq_map_cs0_dq_l = <0x00>;
		dq_map_cs0_dq_h = <0x00>;
		dq_map_cs1_dq_l = <0x00>;
		dq_map_cs1_dq_h = <0x00>;
		phandle = <0xae>;
	};

	ddr4-params {
		version = <0x100>;
		expanded_version = <0x00>;
		reserved = <0x00>;
		freq_0 = <0x420>;
		freq_1 = <0x144>;
		freq_2 = <0x210>;
		freq_3 = <0x30c>;
		freq_4 = <0x00>;
		freq_5 = <0x00>;
		pd_idle = <0x0d>;
		sr_idle = <0x5d>;
		sr_mc_gate_idle = <0x00>;
		srpd_lite_idle = <0x00>;
		standby_idle = <0x00>;
		pd_dis_freq = <0x42a>;
		sr_dis_freq = <0x320>;
		dram_dll_dis_freq = <0x271>;
		phy_dll_dis_freq = <0x00>;
		phy_dq_drv_odten = <0x25>;
		phy_ca_drv_odten = <0x25>;
		phy_clk_drv_odten = <0x25>;
		dram_dq_drv_odten = <0x22>;
		phy_dq_drv_odtoff = <0x25>;
		phy_ca_drv_odtoff = <0x25>;
		phy_clk_drv_odtoff = <0x25>;
		dram_dq_drv_odtoff = <0x22>;
		dram_odt = <0x78>;
		phy_odt = <0x8b>;
		phy_odt_puup_en = <0x01>;
		phy_odt_pudn_en = <0x01>;
		dram_dq_odt_en_freq = <0x1f4>;
		phy_odt_en_freq = <0x1f4>;
		phy_dq_sr_odten = <0x0e>;
		phy_ca_sr_odten = <0x01>;
		phy_clk_sr_odten = <0x01>;
		phy_dq_sr_odtoff = <0x0e>;
		phy_ca_sr_odtoff = <0x01>;
		phy_clk_sr_odtoff = <0x01>;
		ssmod_downspread = <0x00>;
		ssmod_div = <0x00>;
		ssmod_spread = <0x00>;
		mode_2t = <0x00>;
		speed_bin = <0x0c>;
		dram_ext_temp = <0x00>;
		byte_map = <0xe4>;
		dq_map_cs0_dq_l = <0x22777788>;
		dq_map_cs0_dq_h = <0xd7888877>;
		dq_map_cs1_dq_l = <0x22777788>;
		dq_map_cs1_dq_h = <0xd7888877>;
		phandle = <0xaf>;
	};

	lpddr3-params {
		version = <0x100>;
		expanded_version = <0x00>;
		reserved = <0x00>;
		freq_0 = <0x420>;
		freq_1 = <0x144>;
		freq_2 = <0x210>;
		freq_3 = <0x30c>;
		freq_4 = <0x00>;
		freq_5 = <0x00>;
		pd_idle = <0x0d>;
		sr_idle = <0x5d>;
		sr_mc_gate_idle = <0x00>;
		srpd_lite_idle = <0x00>;
		standby_idle = <0x00>;
		pd_dis_freq = <0x42a>;
		sr_dis_freq = <0x320>;
		dram_dll_dis_freq = <0x00>;
		phy_dll_dis_freq = <0x00>;
		phy_dq_drv_odten = <0x25>;
		phy_ca_drv_odten = <0x25>;
		phy_clk_drv_odten = <0x27>;
		dram_dq_drv_odten = <0x22>;
		phy_dq_drv_odtoff = <0x25>;
		phy_ca_drv_odtoff = <0x25>;
		phy_clk_drv_odtoff = <0x27>;
		dram_dq_drv_odtoff = <0x22>;
		dram_odt = <0x78>;
		phy_odt = <0x94>;
		phy_odt_puup_en = <0x01>;
		phy_odt_pudn_en = <0x01>;
		dram_dq_odt_en_freq = <0x14d>;
		phy_odt_en_freq = <0x14d>;
		phy_dq_sr_odten = <0x0f>;
		phy_ca_sr_odten = <0x01>;
		phy_clk_sr_odten = <0x0f>;
		phy_dq_sr_odtoff = <0x0f>;
		phy_ca_sr_odtoff = <0x01>;
		phy_clk_sr_odtoff = <0x0f>;
		ssmod_downspread = <0x00>;
		ssmod_div = <0x00>;
		ssmod_spread = <0x00>;
		mode_2t = <0x00>;
		speed_bin = <0x00>;
		dram_ext_temp = <0x00>;
		byte_map = <0x8d>;
		dq_map_cs0_dq_l = <0x00>;
		dq_map_cs0_dq_h = <0x00>;
		dq_map_cs1_dq_l = <0x00>;
		dq_map_cs1_dq_h = <0x00>;
		phandle = <0xb0>;
	};

	lpddr4-params {
		version = <0x100>;
		expanded_version = <0x00>;
		reserved = <0x00>;
		freq_0 = <0x618>;
		freq_1 = <0x144>;
		freq_2 = <0x210>;
		freq_3 = <0x30c>;
		freq_4 = <0x00>;
		freq_5 = <0x00>;
		pd_idle = <0x0d>;
		sr_idle = <0x5d>;
		sr_mc_gate_idle = <0x00>;
		srpd_lite_idle = <0x00>;
		standby_idle = <0x00>;
		pd_dis_freq = <0x42a>;
		sr_dis_freq = <0x320>;
		dram_dll_dis_freq = <0x00>;
		phy_dll_dis_freq = <0x00>;
		phy_dq_drv_odten = <0x1e>;
		phy_ca_drv_odten = <0x26>;
		phy_clk_drv_odten = <0x26>;
		dram_dq_drv_odten = <0x28>;
		phy_dq_drv_odtoff = <0x1e>;
		phy_ca_drv_odtoff = <0x26>;
		phy_clk_drv_odtoff = <0x26>;
		dram_dq_drv_odtoff = <0x28>;
		dram_odt = <0x50>;
		phy_odt = <0x3c>;
		phy_odt_puup_en = <0x00>;
		phy_odt_pudn_en = <0x00>;
		dram_dq_odt_en_freq = <0x320>;
		phy_odt_en_freq = <0x320>;
		phy_dq_sr_odten = <0x00>;
		phy_ca_sr_odten = <0x0f>;
		phy_clk_sr_odten = <0x0f>;
		phy_dq_sr_odtoff = <0x00>;
		phy_ca_sr_odtoff = <0x0f>;
		phy_clk_sr_odtoff = <0x0f>;
		ssmod_downspread = <0x00>;
		ssmod_div = <0x00>;
		ssmod_spread = <0x00>;
		mode_2t = <0x00>;
		speed_bin = <0x00>;
		dram_ext_temp = <0x00>;
		byte_map = <0xe4>;
		dq_map_cs0_dq_l = <0x00>;
		dq_map_cs0_dq_h = <0x00>;
		dq_map_cs1_dq_l = <0x00>;
		dq_map_cs1_dq_h = <0x00>;
		lp4_ca_odt = <0x78>;
		lp4_drv_pu_cal_odten = <0x01>;
		lp4_drv_pu_cal_odtoff = <0x01>;
		phy_lp4_drv_pulldown_en_odten = <0x00>;
		phy_lp4_drv_pulldown_en_odtoff = <0x00>;
		lp4_ca_odt_en_freq = <0x320>;
		phy_lp4_cs_drv_odten = <0x00>;
		phy_lp4_cs_drv_odtoff = <0x00>;
		lp4_odte_ck_en = <0x01>;
		lp4_odte_cs_en = <0x01>;
		lp4_odtd_ca_en = <0x00>;
		phy_lp4_dq_vref_odten = <0xa6>;
		lp4_dq_vref_odten = <0x12c>;
		lp4_ca_vref_odten = <0x17c>;
		phy_lp4_dq_vref_odtoff = <0x1a4>;
		lp4_dq_vref_odtoff = <0x1a4>;
		lp4_ca_vref_odtoff = <0x1a4>;
		phandle = <0xb1>;
	};

	lpddr4x-params {
		version = <0x100>;
		expanded_version = <0x00>;
		reserved = <0x00>;
		freq_0 = <0x618>;
		freq_1 = <0x144>;
		freq_2 = <0x210>;
		freq_3 = <0x30c>;
		freq_4 = <0x00>;
		freq_5 = <0x00>;
		pd_idle = <0x0d>;
		sr_idle = <0x5d>;
		sr_mc_gate_idle = <0x00>;
		srpd_lite_idle = <0x00>;
		standby_idle = <0x00>;
		pd_dis_freq = <0x42a>;
		sr_dis_freq = <0x320>;
		dram_dll_dis_freq = <0x00>;
		phy_dll_dis_freq = <0x00>;
		phy_dq_drv_odten = <0x1d>;
		phy_ca_drv_odten = <0x24>;
		phy_clk_drv_odten = <0x24>;
		dram_dq_drv_odten = <0x28>;
		phy_dq_drv_odtoff = <0x1d>;
		phy_ca_drv_odtoff = <0x24>;
		phy_clk_drv_odtoff = <0x24>;
		dram_dq_drv_odtoff = <0x28>;
		dram_odt = <0x50>;
		phy_odt = <0x3c>;
		phy_odt_puup_en = <0x00>;
		phy_odt_pudn_en = <0x00>;
		dram_dq_odt_en_freq = <0x320>;
		phy_odt_en_freq = <0x320>;
		phy_dq_sr_odten = <0x00>;
		phy_ca_sr_odten = <0x00>;
		phy_clk_sr_odten = <0x00>;
		phy_dq_sr_odtoff = <0x00>;
		phy_ca_sr_odtoff = <0x00>;
		phy_clk_sr_odtoff = <0x00>;
		ssmod_downspread = <0x00>;
		ssmod_div = <0x00>;
		ssmod_spread = <0x00>;
		mode_2t = <0x00>;
		speed_bin = <0x00>;
		dram_ext_temp = <0x00>;
		byte_map = <0xe4>;
		dq_map_cs0_dq_l = <0x00>;
		dq_map_cs0_dq_h = <0x00>;
		dq_map_cs1_dq_l = <0x00>;
		dq_map_cs1_dq_h = <0x00>;
		lp4_ca_odt = <0x78>;
		lp4_drv_pu_cal_odten = <0x00>;
		lp4_drv_pu_cal_odtoff = <0x00>;
		phy_lp4_drv_pulldown_en_odten = <0x00>;
		phy_lp4_drv_pulldown_en_odtoff = <0x00>;
		lp4_ca_odt_en_freq = <0x320>;
		phy_lp4_cs_drv_odten = <0x00>;
		phy_lp4_cs_drv_odtoff = <0x00>;
		lp4_odte_ck_en = <0x00>;
		lp4_odte_cs_en = <0x00>;
		lp4_odtd_ca_en = <0x00>;
		phy_lp4_dq_vref_odten = <0xa6>;
		lp4_dq_vref_odten = <0xe4>;
		lp4_ca_vref_odten = <0x157>;
		phy_lp4_dq_vref_odtoff = <0x1a4>;
		lp4_dq_vref_odtoff = <0x1a4>;
		lp4_ca_vref_odtoff = <0x157>;
		phandle = <0xb2>;
	};

	aliases {
		csi2dphy0 = "/csi2-dphy0";
		csi2dphy1 = "/csi2-dphy1";
		csi2dphy2 = "/csi2-dphy2";
		dsi0 = "/dsi@fe060000";
		dsi1 = "/dsi@fe070000";
		ethernet1 = "/ethernet@fe010000";
		gpio0 = "/pinctrl/gpio@fdd60000";
		gpio1 = "/pinctrl/gpio@fe740000";
		gpio2 = "/pinctrl/gpio@fe750000";
		gpio3 = "/pinctrl/gpio@fe760000";
		gpio4 = "/pinctrl/gpio@fe770000";
		i2c0 = "/i2c@fdd40000";
		i2c1 = "/i2c@fe5a0000";
		i2c2 = "/i2c@fe5b0000";
		i2c3 = "/i2c@fe5c0000";
		i2c4 = "/i2c@fe5d0000";
		i2c5 = "/i2c@fe5e0000";
		mmc0 = "/mmc@fe310000";
		mmc1 = "/mmc@fe2b0000";
		mmc2 = "/mmc@fe2c0000";
		mmc3 = "/mmc@fe000000";
		serial0 = "/serial@fdd50000";
		serial1 = "/serial@fe650000";
		serial2 = "/serial@fe660000";
		serial3 = "/serial@fe670000";
		serial4 = "/serial@fe680000";
		serial5 = "/serial@fe690000";
		serial6 = "/serial@fe6a0000";
		serial7 = "/serial@fe6b0000";
		serial8 = "/serial@fe6c0000";
		serial9 = "/serial@fe6d0000";
		spi0 = "/spi@fe610000";
		spi1 = "/spi@fe620000";
		spi2 = "/spi@fe630000";
		spi3 = "/spi@fe640000";
		ethernet0 = "/ethernet@fe2a0000";
		lvds0 = "/syscon@fdc60000/lvds";
		lvds1 = "/syscon@fdc60000/lvds1";
	};

	cpus {
		#address-cells = <0x02>;
		#size-cells = <0x00>;

		cpu@0 {
			device_type = "cpu";
			compatible = "arm,cortex-a55";
			reg = <0x00 0x00>;
			clocks = <0x02 0x00>;
			#cooling-cells = <0x02>;
			enable-method = "psci";
			operating-points-v2 = <0x03>;
			cpu-idle-states = <0x04>;
			dynamic-power-coefficient = <0xbb>;
			cpu-supply = <0x05>;
			phandle = <0x1f>;
		};

		cpu@100 {
			device_type = "cpu";
			compatible = "arm,cortex-a55";
			reg = <0x00 0x100>;
			#cooling-cells = <0x02>;
			enable-method = "psci";
			operating-points-v2 = <0x03>;
			cpu-idle-states = <0x04>;
			phandle = <0x20>;
		};

		cpu@200 {
			device_type = "cpu";
			compatible = "arm,cortex-a55";
			reg = <0x00 0x200>;
			#cooling-cells = <0x02>;
			enable-method = "psci";
			operating-points-v2 = <0x03>;
			cpu-idle-states = <0x04>;
			phandle = <0x21>;
		};

		cpu@300 {
			device_type = "cpu";
			compatible = "arm,cortex-a55";
			reg = <0x00 0x300>;
			#cooling-cells = <0x02>;
			enable-method = "psci";
			operating-points-v2 = <0x03>;
			cpu-idle-states = <0x04>;
			phandle = <0x22>;
		};

		idle-states {
			entry-method = "psci";

			cpu-sleep {
				compatible = "arm,idle-state";
				local-timer-stop;
				arm,psci-suspend-param = <0x10000>;
				entry-latency-us = <0x64>;
				exit-latency-us = <0x78>;
				min-residency-us = <0x3e8>;
				phandle = <0x04>;
			};
		};
	};

	opp-table-0 {
		compatible = "operating-points-v2";
		opp-shared;
		mbist-vmin = <0xc96a8 0xdbba0 0xe7ef0>;
		nvmem-cells = <0x06 0x07 0x08 0x09 0x0a 0x0b>;
		nvmem-cell-names = "leakage", "pvtm", "mbist-vmin", "opp-info", "specification_serial_number", "remark_spec_serial_number";
		rockchip,supported-hw;
		rockchip,pvtm-voltage-sel = <0x00 0x14820 0x00 0x14821 0x153d8 0x01 0x153d9 0x16378 0x02 0x16379 0x186a0 0x03>;
		rockchip,pvtm-freq = <0x639c0>;
		rockchip,pvtm-volt = <0xdbba0>;
		rockchip,pvtm-ch = <0x00 0x05>;
		rockchip,pvtm-sample-time = <0x3e8>;
		rockchip,pvtm-number = <0x0a>;
		rockchip,pvtm-error = <0x3e8>;
		rockchip,pvtm-ref-temp = <0x28>;
		rockchip,pvtm-temp-prop = <0x1a 0x1a>;
		rockchip,thermal-zone = "soc-thermal";
		rockchip,temp-hysteresis = <0x1388>;
		rockchip,low-temp = <0x00>;
		rockchip,low-temp-adjust-volt = <0x00 0x7c8 0x124f8>;
		phandle = <0x03>;

		opp-408000000 {
			opp-supported-hw = <0xfb 0xffff>;
			opp-hz = <0x00 0x18519600>;
			opp-microvolt = <0xcf850 0xcf850 0x118c30>;
			clock-latency-ns = <0x9c40>;
		};

		opp-600000000 {
			opp-supported-hw = <0xfb 0xffff>;
			opp-hz = <0x00 0x23c34600>;
			opp-microvolt = <0xcf850 0xcf850 0x118c30>;
			clock-latency-ns = <0x9c40>;
		};

		opp-816000000 {
			opp-supported-hw = <0xfb 0xffff>;
			opp-hz = <0x00 0x30a32c00>;
			opp-microvolt = <0xcf850 0xcf850 0x118c30>;
			clock-latency-ns = <0x9c40>;
			opp-suspend;
		};

		opp-1104000000 {
			opp-supported-hw = <0xfb 0xffff>;
			opp-hz = <0x00 0x41cdb400>;
			opp-microvolt = <0xdbba0 0xdbba0 0x118c30>;
			opp-microvolt-L0 = <0xdbba0 0xdbba0 0x118c30>;
			opp-microvolt-L1 = <0xcf850 0xcf850 0x118c30>;
			opp-microvolt-L2 = <0xcf850 0xcf850 0x118c30>;
			opp-microvolt-L3 = <0xcf850 0xcf850 0x118c30>;
			clock-latency-ns = <0x9c40>;
		};

		opp-1416000000 {
			opp-supported-hw = <0xfb 0xffff>;
			opp-hz = <0x00 0x54667200>;
			opp-microvolt = <0xfa3e8 0xfa3e8 0x118c30>;
			opp-microvolt-L0 = <0xfa3e8 0xfa3e8 0x118c30>;
			opp-microvolt-L1 = <0xee098 0xee098 0x118c30>;
			opp-microvolt-L2 = <0xe7ef0 0xe7ef0 0x118c30>;
			opp-microvolt-L3 = <0xe1d48 0xe1d48 0x118c30>;
			clock-latency-ns = <0x9c40>;
		};

		opp-1608000000 {
			opp-supported-hw = <0xf9 0xffff>;
			opp-hz = <0x00 0x5fd82200>;
			opp-microvolt = <0x10c8e0 0x10c8e0 0x118c30>;
			opp-microvolt-L0 = <0x10c8e0 0x10c8e0 0x118c30>;
			opp-microvolt-L1 = <0x100590 0x100590 0x118c30>;
			opp-microvolt-L2 = <0xfa3e8 0xfa3e8 0x118c30>;
			opp-microvolt-L3 = <0xf4240 0xf4240 0x118c30>;
			clock-latency-ns = <0x9c40>;
		};

		opp-1800000000 {
			opp-supported-hw = <0xf9 0xffff>;
			opp-hz = <0x00 0x6b49d200>;
			opp-microvolt = <0x118c30 0x118c30 0x118c30>;
			opp-microvolt-L0 = <0x118c30 0x118c30 0x118c30>;
			opp-microvolt-L1 = <0x10c8e0 0x10c8e0 0x118c30>;
			opp-microvolt-L2 = <0x106738 0x106738 0x118c30>;
			opp-microvolt-L3 = <0x100590 0x100590 0x118c30>;
			clock-latency-ns = <0x9c40>;
		};

		opp-1992000000 {
			opp-supported-hw = <0xf9 0xffff>;
			opp-hz = <0x00 0x76bb8200>;
			opp-microvolt = <0x118c30 0x118c30 0x118c30>;
			opp-microvolt-L0 = <0x118c30 0x118c30 0x118c30>;
			opp-microvolt-L1 = <0x118c30 0x118c30 0x118c30>;
			opp-microvolt-L2 = <0x112a88 0x112a88 0x118c30>;
			opp-microvolt-L3 = <0x10c8e0 0x10c8e0 0x118c30>;
			clock-latency-ns = <0x9c40>;
		};

		opp-j-1008000000 {
			opp-supported-hw = <0x04 0xffff>;
			opp-hz = <0x00 0x3c14dc00>;
			opp-microvolt = <0xcf850 0xcf850 0x118c30>;
			clock-latency-ns = <0x9c40>;
		};

		opp-j-1416000000 {
			opp-supported-hw = <0x04 0xffff>;
			opp-hz = <0x00 0x54667200>;
			opp-microvolt = <0xdbba0 0xdbba0 0x118c30>;
			clock-latency-ns = <0x9c40>;
		};

		opp-j-od-1608000000 {
			opp-supported-hw = <0x04 0xffff>;
			opp-hz = <0x00 0x5fd82200>;
			opp-microvolt = <0x10c8e0 0x10c8e0 0x118c30>;
			opp-microvolt-L0 = <0x10c8e0 0x10c8e0 0x118c30>;
			opp-microvolt-L1 = <0x100590 0x100590 0x118c30>;
			opp-microvolt-L2 = <0xfa3e8 0xfa3e8 0x118c30>;
			opp-microvolt-L3 = <0xf4240 0xf4240 0x118c30>;
			clock-latency-ns = <0x9c40>;
			status = "disabled";
		};

		opp-j-od-1800000000 {
			opp-supported-hw = <0x04 0xffff>;
			opp-hz = <0x00 0x6b49d200>;
			opp-microvolt = <0x118c30 0x118c30 0x118c30>;
			opp-microvolt-L0 = <0x118c30 0x118c30 0x118c30>;
			opp-microvolt-L1 = <0x10c8e0 0x10c8e0 0x118c30>;
			opp-microvolt-L2 = <0x106738 0x106738 0x118c30>;
			opp-microvolt-L3 = <0x100590 0x100590 0x118c30>;
			clock-latency-ns = <0x9c40>;
			status = "disabled";
		};

		opp-m-1608000000 {
			opp-supported-hw = <0x02 0xffff>;
			opp-hz = <0x00 0x5fd82200>;
			opp-microvolt = <0xf4240 0xf4240 0x118c30>;
			clock-latency-ns = <0x9c40>;
		};
	};

	cpuinfo {
		compatible = "rockchip,cpuinfo";
		nvmem-cells = <0x0c 0x0d 0x0e 0x0a 0x0b>;
		nvmem-cell-names = "id", "cpu-version", "cpu-code", "specification_serial_number", "remark_spec_serial_number";
	};

	display-subsystem {
		compatible = "rockchip,display-subsystem";
		memory-region = <0x0f 0x10>;
		memory-region-names = "drm-logo", "drm-cubic-lut";
		ports = <0x11>;
		devfreq = <0x12>;

		route {

			route-dsi0 {
				status = "disabled";
				logo,uboot = "logo.bmp";
				logo,kernel = "logo_kernel.bmp";
				logo,mode = "center";
				charge_logo,mode = "center";
				connect = <0x13>;
			};

			route-dsi1 {
				status = "disabled";
				logo,uboot = "logo.bmp";
				logo,kernel = "logo_kernel.bmp";
				logo,mode = "center";
				charge_logo,mode = "center";
				connect = <0x14>;
			};

			route-edp {
				status = "disabled";
				logo,uboot = "logo.bmp";
				logo,kernel = "logo_kernel.bmp";
				logo,mode = "center";
				charge_logo,mode = "center";
				connect = <0x15>;
			};

			route-hdmi {
				status = "okay";
				logo,uboot = "logo.bmp";
				logo,kernel = "logo_kernel.bmp";
				logo,mode = "center";
				charge_logo,mode = "center";
				connect = <0x16>;
			};

			route-lvds {
				status = "disabled";
				logo,uboot = "logo.bmp";
				logo,kernel = "logo_kernel.bmp";
				logo,mode = "center";
				charge_logo,mode = "center";
				connect = <0x17>;
			};

			route-rgb {
				status = "disabled";
				logo,uboot = "logo.bmp";
				logo,kernel = "logo_kernel.bmp";
				logo,mode = "center";
				charge_logo,mode = "center";
				connect = <0x18>;
			};
		};
	};

	dmcdbg {
		compatible = "rockchip,rk3568-dmcdbg";
		status = "disabled";
	};

	firmware {

		scmi {
			compatible = "arm,scmi-smc";
			arm,smc-id = <0x82000010>;
			shmem = <0x19>;
			#address-cells = <0x01>;
			#size-cells = <0x00>;

			protocol@14 {
				reg = <0x14>;
				#clock-cells = <0x01>;
				rockchip,clk-init = <0x41cdb400>;
				phandle = <0x02>;
			};
		};

		sdei {
			compatible = "arm,sdei-1.0";
			method = "smc";
		};
	};

	opp-table-1 {
		compatible = "operating-points-v2";
		mbist-vmin = <0xc96a8 0xdbba0 0xe7ef0>;
		nvmem-cells = <0x1a 0x07 0x08 0x1b 0x0a 0x0b>;
		nvmem-cell-names = "leakage", "pvtm", "mbist-vmin", "opp-info", "specification_serial_number", "remark_spec_serial_number";
		rockchip,supported-hw;
		rockchip,max-volt = <0xf4240>;
		rockchip,temp-hysteresis = <0x1388>;
		rockchip,low-temp = <0x00>;
		rockchip,low-temp-adjust-volt = <0x00 0x320 0xc350>;
		rockchip,pvtm-voltage-sel = <0x00 0x14820 0x00 0x14821 0x153d8 0x01 0x153d9 0x16378 0x02 0x16379 0x186a0 0x03>;
		rockchip,pvtm-ch = <0x00 0x05>;
		phandle = <0x70>;

		opp-200000000 {
			opp-supported-hw = <0xfb 0xffff>;
			opp-hz = <0x00 0xbebc200>;
			opp-microvolt = <0xcf850 0xcf850 0xf4240>;
		};

		opp-300000000 {
			opp-supported-hw = <0xfb 0xffff>;
			opp-hz = <0x00 0x11e1a300>;
			opp-microvolt = <0xcf850 0xcf850 0xf4240>;
		};

		opp-400000000 {
			opp-supported-hw = <0xfb 0xffff>;
			opp-hz = <0x00 0x17d78400>;
			opp-microvolt = <0xcf850 0xcf850 0xf4240>;
		};

		opp-600000000 {
			opp-supported-hw = <0xfb 0xffff>;
			opp-hz = <0x00 0x23c34600>;
			opp-microvolt = <0xdbba0 0xdbba0 0xf4240>;
			opp-microvolt-L0 = <0xdbba0 0xdbba0 0xf4240>;
			opp-microvolt-L1 = <0xd59f8 0xd59f8 0xf4240>;
			opp-microvolt-L2 = <0xcf850 0xcf850 0xf4240>;
			opp-microvolt-L3 = <0xcf850 0xcf850 0xf4240>;
		};

		opp-700000000 {
			opp-supported-hw = <0xfb 0xffff>;
			opp-hz = <0x00 0x29b92700>;
			opp-microvolt = <0xe7ef0 0xe7ef0 0xf4240>;
			opp-microvolt-L0 = <0xe7ef0 0xe7ef0 0xf4240>;
			opp-microvolt-L1 = <0xe1d48 0xe1d48 0xf4240>;
			opp-microvolt-L2 = <0xdbba0 0xdbba0 0xf4240>;
			opp-microvolt-L3 = <0xd59f8 0xd59f8 0xf4240>;
		};

		opp-800000000 {
			opp-supported-hw = <0xf9 0xffff>;
			opp-hz = <0x00 0x2faf0800>;
			opp-microvolt = <0xf4240 0xf4240 0xf4240>;
			opp-microvolt-L0 = <0xf4240 0xf4240 0xf4240>;
			opp-microvolt-L1 = <0xee098 0xee098 0xf4240>;
			opp-microvolt-L2 = <0xe7ef0 0xe7ef0 0xf4240>;
			opp-microvolt-L3 = <0xe1d48 0xe1d48 0xf4240>;
		};

		opp-j-600000000 {
			opp-supported-hw = <0x04 0xffff>;
			opp-hz = <0x00 0x23c34600>;
			opp-microvolt = <0xdbba0 0xdbba0 0xf4240>;
		};

		opp-j-od-800000000 {
			opp-supported-hw = <0x04 0xffff>;
			opp-hz = <0x00 0x2faf0800>;
			opp-microvolt = <0xf4240 0xf4240 0xf4240>;
			opp-microvolt-L0 = <0xf4240 0xf4240 0xf4240>;
			opp-microvolt-L1 = <0xee098 0xee098 0xf4240>;
			opp-microvolt-L2 = <0xe7ef0 0xe7ef0 0xf4240>;
			opp-microvolt-L3 = <0xe1d48 0xe1d48 0xf4240>;
			status = "disabled";
		};

		opp-m-800000000 {
			opp-supported-hw = <0x02 0xffff>;
			opp-hz = <0x00 0x2faf0800>;
			opp-microvolt = <0xe7ef0 0xe7ef0 0xf4240>;
		};
	};

	hdmi-sound {
		compatible = "simple-audio-card";
		simple-audio-card,name = "rockchip,hdmi";
		simple-audio-card,format = "i2s";
		simple-audio-card,mclk-fs = <0x80>;
		status = "okay";

		simple-audio-card,codec {
			sound-dai = <0x1c>;
		};

		simple-audio-card,cpu {
			sound-dai = <0x1d>;
		};
	};

	mipi-csi2 {
		compatible = "rockchip,rk3568-mipi-csi2";
		rockchip,hw = <0x1e>;
		status = "disabled";
	};

	mpp-srv {
		compatible = "rockchip,mpp-service";
		rockchip,taskqueue-count = <0x06>;
		rockchip,resetgroup-count = <0x06>;
		status = "okay";
		phandle = <0x73>;
	};

	pmu {
		compatible = "arm,cortex-a55-pmu";
		interrupts = <0x00 0xe4 0x04 0x00 0xe5 0x04 0x00 0xe6 0x04 0x00 0xe7 0x04>;
		interrupt-affinity = <0x1f 0x20 0x21 0x22>;
	};

	psci {
		compatible = "arm,psci-1.0";
		method = "smc";
	};

	reserved-memory {
		#address-cells = <0x02>;
		#size-cells = <0x02>;
		ranges;

		drm-logo@0 {
			compatible = "rockchip,drm-logo";
			reg = <0x00 0x00 0x00 0x00>;
			phandle = <0x0f>;
		};

		drm-cubic-lut@0 {
			compatible = "rockchip,drm-cubic-lut";
			reg = <0x00 0x00 0x00 0x00>;
			phandle = <0x10>;
		};

		ramoops@110000 {
			compatible = "ramoops";
			reg = <0x00 0x110000 0x00 0xf0000>;
			record-size = <0x20000>;
			console-size = <0x80000>;
			ftrace-size = <0x00>;
			pmsg-size = <0x50000>;
		};
	};

	rockchip-suspend {
		compatible = "rockchip,pm-rk3568";
		status = "okay";
		rockchip,sleep-debug-en = <0x01>;
		rockchip,sleep-mode-config = <0x5ec>;
		rockchip,wakeup-config = <0x10>;
	};

	rockchip-system-monitor {
		compatible = "rockchip,system-monitor";
		rockchip,thermal-zone = "soc-thermal";
	};

	timer {
		compatible = "arm,armv8-timer";
		interrupts = <0x01 0x0d 0xf04 0x01 0x0e 0xf04 0x01 0x0b 0xf04 0x01 0x0a 0xf04>;
		arm,no-tick-in-suspend;
	};

	external-gmac1-clock {
		compatible = "fixed-clock";
		clock-frequency = <0x7735940>;
		clock-output-names = "gmac1_clkin";
		#clock-cells = <0x00>;
	};

	xpcs-gmac1-clock {
		compatible = "fixed-clock";
		clock-frequency = <0x7735940>;
		clock-output-names = "clk_gmac1_xpcs_mii";
		#clock-cells = <0x00>;
	};

	i2s1-mclkin-rx {
		compatible = "fixed-clock";
		#clock-cells = <0x00>;
		clock-frequency = <0xbb8000>;
		clock-output-names = "i2s1_mclkin_rx";
	};

	i2s1-mclkin-tx {
		compatible = "fixed-clock";
		#clock-cells = <0x00>;
		clock-frequency = <0xbb8000>;
		clock-output-names = "i2s1_mclkin_tx";
	};

	i2s2-mclkin {
		compatible = "fixed-clock";
		#clock-cells = <0x00>;
		clock-frequency = <0xbb8000>;
		clock-output-names = "i2s2_mclkin";
	};

	i2s3-mclkin {
		compatible = "fixed-clock";
		#clock-cells = <0x00>;
		clock-frequency = <0xbb8000>;
		clock-output-names = "i2s3_mclkin";
	};

	mpll {
		compatible = "fixed-clock";
		#clock-cells = <0x00>;
		clock-frequency = <0x2faf0800>;
		clock-output-names = "mpll";
	};

	xin24m {
		compatible = "fixed-clock";
		clock-frequency = <0x16e3600>;
		clock-output-names = "xin24m";
		#clock-cells = <0x00>;
	};

	xin32k {
		compatible = "fixed-clock";
		clock-frequency = <0x8000>;
		clock-output-names = "xin32k";
		pinctrl-0 = <0x23>;
		pinctrl-names = "default";
		#clock-cells = <0x00>;
	};

	scmi-shmem@10f000 {
		compatible = "arm,scmi-shmem";
		reg = <0x00 0x10f000 0x00 0x100>;
		phandle = <0x19>;
	};

	sata@fc400000 {
		compatible = "rockchip,rk3568-dwc-ahci", "snps,dwc-ahci";
		reg = <0x00 0xfc400000 0x00 0x1000>;
		clocks = <0x24 0x9b 0x24 0x9c 0x24 0x9d>;
		clock-names = "sata", "pmalive", "rxoob";
		interrupts = <0x00 0x5f 0x04>;
		phys = <0x25 0x01>;
		phy-names = "sata-phy";
		ports-implemented = <0x01>;
		power-domains = <0x26 0x0f>;
		status = "disabled";
	};

	sata@fc800000 {
		compatible = "rockchip,rk3568-dwc-ahci", "snps,dwc-ahci";
		reg = <0x00 0xfc800000 0x00 0x1000>;
		clocks = <0x24 0xa0 0x24 0xa1 0x24 0xa2>;
		clock-names = "sata", "pmalive", "rxoob";
		interrupts = <0x00 0x60 0x04>;
		phys = <0x27 0x01>;
		phy-names = "sata-phy";
		ports-implemented = <0x01>;
		power-domains = <0x26 0x0f>;
		status = "disabled";
	};

	usbdrd {
		compatible = "rockchip,rk3568-dwc3", "rockchip,rk3399-dwc3";
		clocks = <0x24 0xa6 0x24 0xa7 0x24 0xa5 0x24 0x7f>;
		clock-names = "ref_clk", "suspend_clk", "bus_clk", "pipe_clk";
		#address-cells = <0x02>;
		#size-cells = <0x02>;
		ranges;
		status = "okay";

		usb@fcc00000 {
			compatible = "snps,dwc3";
			reg = <0x00 0xfcc00000 0x00 0x400000>;
			interrupts = <0x00 0xa9 0x04>;
			dr_mode = "otg";
			phy_type = "utmi_wide";
			power-domains = <0x26 0x0f>;
			resets = <0x24 0x94>;
			reset-names = "usb3-otg";
			snps,dis_enblslpm_quirk;
			snps,dis-u1-entry-quirk;
			snps,dis-u2-entry-quirk;
			snps,dis-u2-freeclk-exists-quirk;
			snps,dis-del-phy-power-chg-quirk;
			snps,dis-tx-ipgap-linecheck-quirk;
			snps,dis_rxdet_inp3_quirk;
			snps,parkmode-disable-hs-quirk;
			snps,parkmode-disable-ss-quirk;
			quirk-skip-phy-init;
			status = "okay";
			phys = <0x28>;
			phy-names = "usb2-phy";
			extcon = <0x29>;
			maximum-speed = "high-speed";
			snps,dis_u2_susphy_quirk;
		};
	};

	usbhost {
		compatible = "rockchip,rk3568-dwc3", "rockchip,rk3399-dwc3";
		clocks = <0x24 0xa9 0x24 0xaa 0x24 0xa8 0x24 0x7f>;
		clock-names = "ref_clk", "suspend_clk", "bus_clk", "pipe_clk";
		#address-cells = <0x02>;
		#size-cells = <0x02>;
		ranges;
		status = "okay";

		usb@fd000000 {
			compatible = "snps,dwc3";
			reg = <0x00 0xfd000000 0x00 0x400000>;
			interrupts = <0x00 0xaa 0x04>;
			dr_mode = "host";
			phys = <0x2a 0x25 0x04>;
			phy-names = "usb2-phy", "usb3-phy";
			phy_type = "utmi_wide";
			power-domains = <0x26 0x0f>;
			resets = <0x24 0x95>;
			reset-names = "usb3-host";
			snps,dis_enblslpm_quirk;
			snps,dis-u2-freeclk-exists-quirk;
			snps,dis-del-phy-power-chg-quirk;
			snps,dis-tx-ipgap-linecheck-quirk;
			snps,dis_rxdet_inp3_quirk;
			snps,parkmode-disable-hs-quirk;
			snps,parkmode-disable-ss-quirk;
			status = "okay";
		};
	};

	interrupt-controller@fd400000 {
		compatible = "arm,gic-v3";
		#interrupt-cells = <0x03>;
		#address-cells = <0x02>;
		#size-cells = <0x02>;
		ranges;
		interrupt-controller;
		reg = <0x00 0xfd400000 0x00 0x10000 0x00 0xfd460000 0x00 0xc0000>;
		interrupts = <0x01 0x09 0x04>;
		phandle = <0x01>;

		interrupt-controller@fd440000 {
			compatible = "arm,gic-v3-its";
			msi-controller;
			#msi-cells = <0x01>;
			reg = <0x00 0xfd440000 0x00 0x20000>;
			phandle = <0xb5>;
		};
	};

	usb@fd800000 {
		compatible = "generic-ehci";
		reg = <0x00 0xfd800000 0x00 0x40000>;
		interrupts = <0x00 0x82 0x04>;
		clocks = <0x24 0xbd 0x24 0xbe 0x24 0xbc 0x2b>;
		clock-names = "usbhost", "arbiter", "pclk", "utmi";
		phys = <0x2c>;
		phy-names = "usb2-phy";
		status = "okay";
	};

	usb@fd840000 {
		compatible = "generic-ohci";
		reg = <0x00 0xfd840000 0x00 0x40000>;
		interrupts = <0x00 0x83 0x04>;
		clocks = <0x24 0xbd 0x24 0xbe 0x24 0xbc 0x2b>;
		clock-names = "usbhost", "arbiter", "pclk", "utmi";
		phys = <0x2c>;
		phy-names = "usb2-phy";
		status = "okay";
	};

	usb@fd880000 {
		compatible = "generic-ehci";
		reg = <0x00 0xfd880000 0x00 0x40000>;
		interrupts = <0x00 0x85 0x04>;
		clocks = <0x24 0xbf 0x24 0xc0 0x24 0xbc 0x2b>;
		clock-names = "usbhost", "arbiter", "pclk", "utmi";
		phys = <0x2d>;
		phy-names = "usb2-phy";
		status = "okay";
	};

	usb@fd8c0000 {
		compatible = "generic-ohci";
		reg = <0x00 0xfd8c0000 0x00 0x40000>;
		interrupts = <0x00 0x86 0x04>;
		clocks = <0x24 0xbf 0x24 0xc0 0x24 0xbc 0x2b>;
		clock-names = "usbhost", "arbiter", "pclk", "utmi";
		phys = <0x2d>;
		phy-names = "usb2-phy";
		status = "okay";
	};

	syscon@fda00000 {
		compatible = "rockchip,rk3568-xpcs", "syscon";
		reg = <0x00 0xfda00000 0x00 0x200000>;
		status = "disabled";
	};

	syscon@fdc20000 {
		compatible = "rockchip,rk3568-pmugrf", "syscon", "simple-mfd";
		reg = <0x00 0xfdc20000 0x00 0x10000>;
		phandle = <0x3b>;

		io-domains {
			compatible = "rockchip,rk3568-pmu-io-voltage-domain";
			status = "okay";
			pmuio2-supply = <0x2e>;
			vccio1-supply = <0x2f>;
			vccio3-supply = <0x30>;
			vccio4-supply = <0x31>;
			vccio5-supply = <0x32>;
			vccio6-supply = <0x31>;
			vccio7-supply = <0x32>;
		};

		reboot-mode {
			compatible = "syscon-reboot-mode";
			offset = <0x200>;
			mode-bootloader = <0x5242c301>;
			mode-charge = <0x5242c30b>;
			mode-fastboot = <0x5242c309>;
			mode-loader = <0x5242c301>;
			mode-normal = <0x5242c300>;
			mode-recovery = <0x5242c303>;
			mode-ums = <0x5242c30c>;
			mode-panic = <0x5242c307>;
			mode-watchdog = <0x5242c308>;
		};
	};

	syscon@fdc50000 {
		compatible = "rockchip,rk3568-pipe-grf", "syscon";
		reg = <0x00 0xfdc50000 0x00 0x1000>;
		phandle = <0x10f>;
	};

	syscon@fdc60000 {
		compatible = "rockchip,rk3568-grf", "syscon", "simple-mfd";
		reg = <0x00 0xfdc60000 0x00 0x10000>;
		phandle = <0x3a>;

		io-domains {
			compatible = "rockchip,rk3568-io-voltage-domain";
			status = "disabled";
		};

		lvds {
			compatible = "rockchip,rk3568-lvds";
			phys = <0x33>;
			phy-names = "phy";
			status = "disabled";

			ports {
				#address-cells = <0x01>;
				#size-cells = <0x00>;

				port@0 {
					reg = <0x00>;
					#address-cells = <0x01>;
					#size-cells = <0x00>;

					endpoint@1 {
						reg = <0x01>;
						remote-endpoint = <0x17>;
						status = "disabled";
						phandle = <0x9e>;
					};

					endpoint@2 {
						reg = <0x02>;
						remote-endpoint = <0x34>;
						status = "disabled";
						phandle = <0xa0>;
					};
				};
			};
		};

		rgb {
			compatible = "rockchip,rk3568-rgb";
			pinctrl-names = "default";
			pinctrl-0 = <0x35>;
			status = "disabled";

			ports {
				#address-cells = <0x01>;
				#size-cells = <0x00>;

				port@0 {
					reg = <0x00>;
					#address-cells = <0x01>;
					#size-cells = <0x00>;

					endpoint@2 {
						reg = <0x02>;
						remote-endpoint = <0x18>;
						status = "disabled";
						phandle = <0xa1>;
					};
				};
			};
		};

		lvds1 {
			compatible = "rockchip,rk3568-lvds";
			phys = <0x36>;
			phy-names = "phy";
			status = "disabled";

			ports {
				#address-cells = <0x01>;
				#size-cells = <0x00>;

				port@0 {
					reg = <0x00>;
					#address-cells = <0x01>;
					#size-cells = <0x00>;

					endpoint@0 {
						reg = <0x00>;
						remote-endpoint = <0x37>;
						status = "disabled";
						phandle = <0x9f>;
					};

					endpoint@1 {
						reg = <0x01>;
						remote-endpoint = <0x38>;
						status = "disabled";
						phandle = <0xa2>;
					};
				};
			};
		};
	};

	syscon@fdc80000 {
		compatible = "rockchip,pipe-phy-grf", "syscon";
		reg = <0x00 0xfdc80000 0x00 0x1000>;
		phandle = <0x110>;
	};

	syscon@fdc90000 {
		compatible = "rockchip,pipe-phy-grf", "syscon";
		reg = <0x00 0xfdc90000 0x00 0x1000>;
		phandle = <0x111>;
	};

	syscon@fdca0000 {
		compatible = "rockchip,rk3568-usb2phy-grf", "syscon";
		reg = <0x00 0xfdca0000 0x00 0x8000>;
		phandle = <0x115>;
	};

	syscon@fdca8000 {
		compatible = "rockchip,rk3568-usb2phy-grf", "syscon";
		reg = <0x00 0xfdca8000 0x00 0x8000>;
		phandle = <0x118>;
	};

	syscon@fdcb0000 {
		compatible = "rockchip,rk3568-edp-phy-grf", "syscon", "simple-mfd";
		reg = <0x00 0xfdcb0000 0x00 0x100>;
		clocks = <0x24 0x192>;

		edp-phy {
			compatible = "rockchip,rk3568-edp-phy";
			clocks = <0x39 0x29>;
			clock-names = "refclk";
			#phy-cells = <0x00>;
			status = "disabled";
			phandle = <0xa9>;
		};
	};

	sram@fdcc0000 {
		compatible = "mmio-sram";
		reg = <0x00 0xfdcc0000 0x00 0xb000>;
		#address-cells = <0x01>;
		#size-cells = <0x01>;
		ranges = <0x00 0x00 0xfdcc0000 0xb000>;

		rkvdec-sram@0 {
			reg = <0x00 0xb000>;
			phandle = <0x7c>;
		};
	};

	clock-controller@fdd00000 {
		compatible = "rockchip,rk3568-pmucru";
		reg = <0x00 0xfdd00000 0x00 0x1000>;
		rockchip,grf = <0x3a>;
		rockchip,pmugrf = <0x3b>;
		#clock-cells = <0x01>;
		#reset-cells = <0x01>;
		assigned-clocks = <0x39 0x32>;
		assigned-clock-parents = <0x39 0x05>;
		phandle = <0x39>;
	};

	clock-controller@fdd20000 {
		compatible = "rockchip,rk3568-cru";
		reg = <0x00 0xfdd20000 0x00 0x1000>;
		rockchip,grf = <0x3a>;
		#clock-cells = <0x01>;
		#reset-cells = <0x01>;
		assigned-clocks = <0x39 0x05 0x24 0x106 0x24 0x10b 0x39 0x01 0x39 0x2b 0x24 0x03 0x24 0x19b 0x24 0x09 0x24 0x19c 0x24 0x19d 0x24 0x1a1 0x24 0x19e 0x24 0x19f 0x24 0x1a0 0x24 0x04 0x24 0x10d 0x24 0x10e 0x24 0x173 0x24 0x174 0x24 0x175 0x24 0x176 0x24 0xc9 0x24 0xca 0x24 0x06 0x24 0x7e 0x24 0x7f 0x24 0x3d 0x24 0x41 0x24 0x45 0x24 0x49 0x24 0x4d 0x24 0x4d 0x24 0x55 0x24 0x51 0x24 0x5d 0x24 0xdd>;
		assigned-clock-rates = <0x8000 0x11e1a300 0x11e1a300 0xbebc200 0x5f5e100 0x3b9aca00 0x1dcd6500 0x13d92d40 0xee6b280 0x7735940 0x5f5e100 0x3b9aca0 0x2faf080 0x17d7840 0x46cf7100 0x8f0d180 0x5f5e100 0x1dcd6500 0x17d78400 0x8f0d180 0x5f5e100 0x11e1a300 0x8f0d180 0x47868c00 0x17d78400 0x5f5e100 0x46cf7100 0x46cf7100 0x46cf7100 0x46cf7100 0x46cf7100 0x46cf7100 0x46cf7100 0x46cf7100 0x46cf7100 0x1dcd6500>;
		assigned-clock-parents = <0x39 0x08 0x24 0x04 0x24 0x04>;
		phandle = <0x24>;
	};

	i2c@fdd40000 {
		compatible = "rockchip,rk3568-i2c", "rockchip,rk3399-i2c";
		reg = <0x00 0xfdd40000 0x00 0x1000>;
		interrupts = <0x00 0x2e 0x04>;
		clocks = <0x39 0x07 0x39 0x2d>;
		clock-names = "i2c", "pclk";
		pinctrl-0 = <0x3c>;
		pinctrl-names = "default";
		#address-cells = <0x01>;
		#size-cells = <0x00>;
		status = "okay";

		tcs4525@1c {
			compatible = "tcs,tcs4525";
			reg = <0x1c>;
			vin-supply = <0x3d>;
			regulator-compatible = "fan53555-reg";
			regulator-name = "vdd_cpu";
			regulator-min-microvolt = <0xadf34>;
			regulator-max-microvolt = <0x1535b0>;
			regulator-init-microvolt = <0xdbba0>;
			regulator-ramp-delay = <0x8fc>;
			fcs,suspend-voltage-selector = <0x01>;
			regulator-boot-on;
			regulator-always-on;
			phandle = <0x05>;

			regulator-state-mem {
				regulator-off-in-suspend;
			};
		};

		pmic@20 {
			compatible = "rockchip,rk809";
			reg = <0x20>;
			interrupt-parent = <0x3e>;
			interrupts = <0x03 0x08>;
			pinctrl-names = "default", "pmic-sleep", "pmic-power-off", "pmic-reset";
			pinctrl-0 = <0x3f>;
			pinctrl-1 = <0x40 0x41>;
			pinctrl-2 = <0x42 0x43>;
			pinctrl-3 = <0x42 0x44>;
			rockchip,system-power-controller;
			wakeup-source;
			#clock-cells = <0x01>;
			clock-output-names = "rk808-clkout1", "rk808-clkout2";
			pmic-reset-func = <0x00>;
			not-save-power-en = <0x01>;
			vcc1-supply = <0x45>;
			vcc2-supply = <0x45>;
			vcc3-supply = <0x45>;
			vcc4-supply = <0x45>;
			vcc5-supply = <0x45>;
			vcc6-supply = <0x45>;
			vcc7-supply = <0x45>;
			vcc8-supply = <0x45>;
			vcc9-supply = <0x45>;
			phandle = <0x13e>;

			pwrkey {
				status = "okay";
			};

			pinctrl_rk8xx {
				gpio-controller;
				#gpio-cells = <0x02>;

				rk817_slppin_null {
					pins = "gpio_slp";
					function = "pin_fun0";
				};

				rk817_slppin_slp {
					pins = "gpio_slp";
					function = "pin_fun1";
					phandle = <0x41>;
				};

				rk817_slppin_pwrdn {
					pins = "gpio_slp";
					function = "pin_fun2";
					phandle = <0x43>;
				};

				rk817_slppin_rst {
					pins = "gpio_slp";
					function = "pin_fun3";
					phandle = <0x44>;
				};
			};

			regulators {

				DCDC_REG1 {
					regulator-always-on;
					regulator-boot-on;
					regulator-min-microvolt = <0x7a120>;
					regulator-max-microvolt = <0x149970>;
					regulator-init-microvolt = <0xdbba0>;
					regulator-ramp-delay = <0x1771>;
					regulator-initial-mode = <0x02>;
					regulator-name = "vdd_logic";
					phandle = <0x6f>;

					regulator-state-mem {
						regulator-off-in-suspend;
					};
				};

				DCDC_REG2 {
					regulator-always-on;
					regulator-boot-on;
					regulator-min-microvolt = <0x7a120>;
					regulator-max-microvolt = <0x149970>;
					regulator-init-microvolt = <0xdbba0>;
					regulator-ramp-delay = <0x1771>;
					regulator-initial-mode = <0x02>;
					regulator-name = "vdd_gpu";
					phandle = <0x71>;

					regulator-state-mem {
						regulator-off-in-suspend;
					};
				};

				DCDC_REG3 {
					regulator-always-on;
					regulator-boot-on;
					regulator-initial-mode = <0x02>;
					regulator-name = "vcc_ddr";

					regulator-state-mem {
						regulator-on-in-suspend;
					};
				};

				DCDC_REG4 {
					regulator-always-on;
					regulator-boot-on;
					regulator-min-microvolt = <0x7a120>;
					regulator-max-microvolt = <0x149970>;
					regulator-init-microvolt = <0xdbba0>;
					regulator-ramp-delay = <0x1771>;
					regulator-initial-mode = <0x02>;
					regulator-name = "vdd_npu";
					phandle = <0x6b>;

					regulator-state-mem {
						regulator-off-in-suspend;
					};
				};

				LDO_REG1 {
					regulator-boot-on;
					regulator-always-on;
					regulator-min-microvolt = <0xdbba0>;
					regulator-max-microvolt = <0xdbba0>;
					regulator-name = "vdda0v9_image";

					regulator-state-mem {
						regulator-off-in-suspend;
					};
				};

				LDO_REG2 {
					regulator-always-on;
					regulator-boot-on;
					regulator-min-microvolt = <0xdbba0>;
					regulator-max-microvolt = <0xdbba0>;
					regulator-name = "vdda_0v9";

					regulator-state-mem {
						regulator-off-in-suspend;
					};
				};

				LDO_REG3 {
					regulator-always-on;
					regulator-boot-on;
					regulator-min-microvolt = <0xdbba0>;
					regulator-max-microvolt = <0xdbba0>;
					regulator-name = "vdda0v9_pmu";

					regulator-state-mem {
						regulator-on-in-suspend;
						regulator-suspend-microvolt = <0xdbba0>;
					};
				};

				LDO_REG4 {
					regulator-always-on;
					regulator-boot-on;
					regulator-min-microvolt = <0x2dc6c0>;
					regulator-max-microvolt = <0x2dc6c0>;
					regulator-name = "vccio_acodec";
					phandle = <0x2f>;

					regulator-state-mem {
						regulator-off-in-suspend;
					};
				};

				LDO_REG5 {
					regulator-always-on;
					regulator-boot-on;
					regulator-min-microvolt = <0x1b7740>;
					regulator-max-microvolt = <0x325aa0>;
					regulator-name = "vccio_sd";
					phandle = <0x30>;

					regulator-state-mem {
						regulator-off-in-suspend;
					};
				};

				LDO_REG6 {
					regulator-always-on;
					regulator-boot-on;
					regulator-min-microvolt = <0x325aa0>;
					regulator-max-microvolt = <0x325aa0>;
					regulator-name = "vcc3v3_pmu";
					phandle = <0x2e>;

					regulator-state-mem {
						regulator-on-in-suspend;
						regulator-suspend-microvolt = <0x325aa0>;
					};
				};

				LDO_REG7 {
					regulator-always-on;
					regulator-boot-on;
					regulator-min-microvolt = <0x1b7740>;
					regulator-max-microvolt = <0x1b7740>;
					regulator-name = "vcca_1v8";
					phandle = <0x10e>;

					regulator-state-mem {
						regulator-off-in-suspend;
					};
				};

				LDO_REG8 {
					regulator-always-on;
					regulator-boot-on;
					regulator-min-microvolt = <0x1b7740>;
					regulator-max-microvolt = <0x1b7740>;
					regulator-name = "vcca1v8_pmu";

					regulator-state-mem {
						regulator-on-in-suspend;
						regulator-suspend-microvolt = <0x1b7740>;
					};
				};

				LDO_REG9 {
					regulator-always-on;
					regulator-boot-on;
					regulator-min-microvolt = <0x1b7740>;
					regulator-max-microvolt = <0x1b7740>;
					regulator-name = "vcca1v8_image";

					regulator-state-mem {
						regulator-off-in-suspend;
					};
				};

				DCDC_REG5 {
					regulator-always-on;
					regulator-boot-on;
					regulator-min-microvolt = <0x1b7740>;
					regulator-max-microvolt = <0x1b7740>;
					regulator-name = "vcc_1v8";
					phandle = <0x31>;

					regulator-state-mem {
						regulator-off-in-suspend;
					};
				};

				SWITCH_REG1 {
					regulator-always-on;
					regulator-boot-on;
					regulator-name = "vcc_3v3";
					phandle = <0x32>;

					regulator-state-mem {
						regulator-off-in-suspend;
					};
				};

				SWITCH_REG2 {
					regulator-always-on;
					regulator-boot-on;
					regulator-name = "vcc3v3_sd";
					phandle = <0xb7>;

					regulator-state-mem {
						regulator-off-in-suspend;
					};
				};
			};

			codec {
				#sound-dai-cells = <0x01>;
				compatible = "rockchip,rk809-codec", "rockchip,rk817-codec";
				clocks = <0x24 0x1a3>;
				clock-names = "mclk";
				spk-ctl-gpios = <0x46 0x16 0x00>;
				assigned-clocks = <0x24 0x1a3 0x24 0x1a6>;
				assigned-clock-rates = <0xbb8000>;
				assigned-clock-parents = <0x24 0x48 0x24 0x48>;
				pinctrl-names = "default";
				pinctrl-0 = <0x47>;
				hp-volume = <0x00>;
				spk-volume = <0x00>;
				mic-in-differential;
				status = "okay";
				phandle = <0x13a>;
			};
		};
	};

	serial@fdd50000 {
		compatible = "rockchip,rk3568-uart", "snps,dw-apb-uart";
		reg = <0x00 0xfdd50000 0x00 0x100>;
		interrupts = <0x00 0x74 0x04>;
		clocks = <0x39 0x0b 0x39 0x2c>;
		clock-names = "baudclk", "apb_pclk";
		dmas = <0x48 0x00 0x48 0x01>;
		pinctrl-0 = <0x49>;
		pinctrl-names = "default";
		reg-io-width = <0x04>;
		reg-shift = <0x02>;
		status = "okay";
	};

	pwm@fdd70000 {
		compatible = "rockchip,rk3568-pwm", "rockchip,rk3328-pwm";
		reg = <0x00 0xfdd70000 0x00 0x10>;
		interrupts = <0x00 0x52 0x04>;
		clocks = <0x39 0x0d 0x39 0x30>;
		clock-names = "pwm", "pclk";
		pinctrl-0 = <0x4a>;
		pinctrl-names = "active";
		#pwm-cells = <0x03>;
		status = "disabled";
	};

	pwm@fdd70010 {
		compatible = "rockchip,rk3568-pwm", "rockchip,rk3328-pwm";
		reg = <0x00 0xfdd70010 0x00 0x10>;
		interrupts = <0x00 0x52 0x04>;
		clocks = <0x39 0x0d 0x39 0x30>;
		clock-names = "pwm", "pclk";
		pinctrl-0 = <0x4b>;
		pinctrl-names = "active";
		#pwm-cells = <0x03>;
		status = "disabled";
	};

	pwm@fdd70020 {
		compatible = "rockchip,rk3568-pwm", "rockchip,rk3328-pwm";
		reg = <0x00 0xfdd70020 0x00 0x10>;
		interrupts = <0x00 0x52 0x04>;
		clocks = <0x39 0x0d 0x39 0x30>;
		clock-names = "pwm", "pclk";
		pinctrl-0 = <0x4c>;
		pinctrl-names = "active";
		#pwm-cells = <0x03>;
		status = "disabled";
	};

	pwm@fdd70030 {
		compatible = "rockchip,rk3568-pwm", "rockchip,rk3328-pwm";
		reg = <0x00 0xfdd70030 0x00 0x10>;
		interrupts = <0x00 0x52 0x04 0x00 0x56 0x04>;
		clocks = <0x39 0x0d 0x39 0x30>;
		clock-names = "pwm", "pclk";
		pinctrl-0 = <0x4d>;
		pinctrl-names = "active";
		#pwm-cells = <0x03>;
		status = "okay";
	};

	power-management@fdd90000 {
		compatible = "rockchip,rk3568-pmu", "syscon", "simple-mfd";
		reg = <0x00 0xfdd90000 0x00 0x1000>;

		power-controller {
			compatible = "rockchip,rk3568-power-controller";
			#power-domain-cells = <0x01>;
			#address-cells = <0x01>;
			#size-cells = <0x00>;
			phandle = <0x26>;

			power-domain@6 {
				reg = <0x06>;
				clocks = <0x24 0x27 0x24 0x25 0x24 0x26>;
				pm_qos = <0x4e>;
			};

			power-domain@7 {
				reg = <0x07>;
				clocks = <0x24 0x19 0x24 0x1a>;
				pm_qos = <0x4f>;
				#power-domain-cells = <0x00>;
			};

			power-domain@8 {
				reg = <0x08>;
				clocks = <0x24 0xcc 0x24 0xcd>;
				pm_qos = <0x50 0x51 0x52>;
				#power-domain-cells = <0x00>;
			};

			power-domain@9 {
				reg = <0x09>;
				clocks = <0x24 0xda 0x24 0xdb 0x24 0xdc>;
				pm_qos = <0x53 0x54 0x55>;
				#power-domain-cells = <0x00>;
			};

			power-domain@10 {
				reg = <0x0a>;
				clocks = <0x24 0xf1 0x24 0xf2>;
				pm_qos = <0x56 0x57 0x58 0x59 0x5a 0x5b>;
				#power-domain-cells = <0x00>;
			};

			power-domain@11 {
				reg = <0x0b>;
				clocks = <0x24 0xed>;
				pm_qos = <0x5c>;
				#power-domain-cells = <0x00>;
			};

			power-domain@13 {
				clocks = <0x24 0x107>;
				reg = <0x0d>;
				pm_qos = <0x5d>;
				#power-domain-cells = <0x00>;
			};

			power-domain@14 {
				reg = <0x0e>;
				clocks = <0x24 0x102>;
				pm_qos = <0x5e 0x5f 0x60>;
				#power-domain-cells = <0x00>;
			};

			power-domain@15 {
				reg = <0x0f>;
				clocks = <0x24 0x7f>;
				pm_qos = <0x61 0x62 0x63 0x64 0x65 0x66 0x67 0x68>;
				#power-domain-cells = <0x00>;
			};
		};
	};

	pvtm@fde00000 {
		compatible = "rockchip,rk3568-core-pvtm";
		reg = <0x00 0xfde00000 0x00 0x100>;
		#address-cells = <0x01>;
		#size-cells = <0x00>;

		pvtm@0 {
			reg = <0x00>;
			clocks = <0x24 0x13 0x24 0x1c2>;
			clock-names = "clk", "pclk";
			resets = <0x24 0x1a 0x24 0x19>;
			reset-names = "rts", "rst-p";
			thermal-zone = "soc-thermal";
		};
	};

	npu@fde40000 {
		compatible = "rockchip,rk3568-rknpu", "rockchip,rknpu";
		reg = <0x00 0xfde40000 0x00 0x10000>;
		interrupts = <0x00 0x97 0x04>;
		clocks = <0x02 0x02 0x24 0x23 0x24 0x28 0x24 0x29>;
		clock-names = "scmi_clk", "clk", "aclk", "hclk";
		assigned-clocks = <0x24 0x23>;
		assigned-clock-rates = <0x23c34600>;
		resets = <0x24 0x2b 0x24 0x2c>;
		reset-names = "srst_a", "srst_h";
		power-domains = <0x26 0x06>;
		operating-points-v2 = <0x69>;
		iommus = <0x6a>;
		status = "okay";
		rknpu-supply = <0x6b>;
	};

	npu-opp-table {
		compatible = "operating-points-v2";
		mbist-vmin = <0xc96a8 0xdbba0 0xe7ef0>;
		nvmem-cells = <0x6c 0x07 0x08 0x6d 0x0a 0x0b>;
		nvmem-cell-names = "leakage", "pvtm", "mbist-vmin", "opp-info", "specification_serial_number", "remark_spec_serial_number";
		rockchip,supported-hw;
		rockchip,max-volt = <0xf4240>;
		rockchip,temp-hysteresis = <0x1388>;
		rockchip,low-temp = <0x00>;
		rockchip,low-temp-adjust-volt = <0x00 0x3e8 0xc350>;
		rockchip,pvtm-voltage-sel = <0x00 0x14820 0x00 0x14821 0x153d8 0x01 0x153d9 0x16378 0x02 0x16379 0x186a0 0x03>;
		rockchip,pvtm-ch = <0x00 0x05>;
		rockchip,init-freq = <0xdbba0>;
		phandle = <0x69>;

		opp-200000000 {
			opp-supported-hw = <0xfb 0xffff>;
			opp-hz = <0x00 0xbebc200>;
			opp-microvolt = <0xcf850 0xcf850 0xf4240>;
		};

		opp-300000000 {
			opp-supported-hw = <0xfb 0xffff>;
			opp-hz = <0x00 0x11b3dc40>;
			opp-microvolt = <0xcf850 0xcf850 0xf4240>;
		};

		opp-400000000 {
			opp-supported-hw = <0xfb 0xffff>;
			opp-hz = <0x00 0x17d78400>;
			opp-microvolt = <0xcf850 0xcf850 0xf4240>;
		};

		opp-600000000 {
			opp-supported-hw = <0xfb 0xffff>;
			opp-hz = <0x00 0x23c34600>;
			opp-microvolt = <0xcf850 0xcf850 0xf4240>;
		};

		opp-700000000 {
			opp-supported-hw = <0xfb 0xffff>;
			opp-hz = <0x00 0x29b92700>;
			opp-microvolt = <0xd59f8 0xd59f8 0xf4240>;
			opp-microvolt-L0 = <0xd59f8 0xd59f8 0xf4240>;
			opp-microvolt-L1 = <0xcf850 0xcf850 0xf4240>;
			opp-microvolt-L2 = <0xcf850 0xcf850 0xf4240>;
			opp-microvolt-L3 = <0xcf850 0xcf850 0xf4240>;
		};

		opp-800000000 {
			opp-supported-hw = <0xfb 0xffff>;
			opp-hz = <0x00 0x2faf0800>;
			opp-microvolt = <0xe1d48 0xe1d48 0xf4240>;
			opp-microvolt-L0 = <0xe1d48 0xe1d48 0xf4240>;
			opp-microvolt-L1 = <0xdbba0 0xdbba0 0xf4240>;
			opp-microvolt-L2 = <0xd59f8 0xd59f8 0xf4240>;
			opp-microvolt-L3 = <0xd59f8 0xd59f8 0xf4240>;
		};

		opp-900000000 {
			opp-supported-hw = <0xf9 0xffff>;
			opp-hz = <0x00 0x35a4e900>;
			opp-microvolt = <0xee098 0xee098 0xf4240>;
			opp-microvolt-L0 = <0xee098 0xee098 0xf4240>;
			opp-microvolt-L1 = <0xe7ef0 0xe7ef0 0xf4240>;
			opp-microvolt-L2 = <0xe1d48 0xe1d48 0xf4240>;
			opp-microvolt-L3 = <0xdbba0 0xdbba0 0xf4240>;
		};

		opp-1000000000 {
			opp-supported-hw = <0xf9 0xffff>;
			opp-hz = <0x00 0x3b9aca00>;
			opp-microvolt = <0xf4240 0xf4240 0xf4240>;
			opp-microvolt-L0 = <0xf4240 0xf4240 0xf4240>;
			opp-microvolt-L1 = <0xee098 0xee098 0xf4240>;
			opp-microvolt-L2 = <0xe7ef0 0xe7ef0 0xf4240>;
			opp-microvolt-L3 = <0xe1d48 0xe1d48 0xf4240>;
			status = "disabled";
		};

		opp-j-600000000 {
			opp-supported-hw = <0x04 0xffff>;
			opp-hz = <0x00 0x23c34600>;
			opp-microvolt = <0xdbba0 0xdbba0 0xf4240>;
		};

		opp-j-od-800000000 {
			opp-supported-hw = <0x04 0xffff>;
			opp-hz = <0x00 0x2faf0800>;
			opp-microvolt = <0xe1d48 0xe1d48 0xf4240>;
			opp-microvolt-L0 = <0xe1d48 0xe1d48 0xf4240>;
			opp-microvolt-L1 = <0xdbba0 0xdbba0 0xf4240>;
			opp-microvolt-L2 = <0xdbba0 0xdbba0 0xf4240>;
			opp-microvolt-L3 = <0xdbba0 0xdbba0 0xf4240>;
			status = "disabled";
		};

		opp-m-900000000 {
			opp-supported-hw = <0x02 0xffff>;
			opp-hz = <0x00 0x35a4e900>;
			opp-microvolt = <0xe1d48 0xe1d48 0xf4240>;
		};
	};

	bus-npu {
		compatible = "rockchip,rk3568-bus";
		rockchip,busfreq-policy = "clkfreq";
		clocks = <0x02 0x02>;
		clock-names = "bus";
		operating-points-v2 = <0x6e>;
		status = "okay";
		bus-supply = <0x6f>;
		pvtm-supply = <0x05>;
	};

	bus-npu-opp-table {
		compatible = "operating-points-v2";
		opp-shared;
		nvmem-cells = <0x07>;
		nvmem-cell-names = "pvtm";
		rockchip,pvtm-voltage-sel = <0x00 0x14820 0x00 0x14821 0x16378 0x01 0x16379 0x186a0 0x02>;
		rockchip,pvtm-ch = <0x00 0x05>;
		phandle = <0x6e>;

		opp-700000000 {
			opp-hz = <0x00 0x29b92700>;
			opp-microvolt = <0xdbba0>;
			opp-microvolt-L0 = <0xdbba0>;
			opp-microvolt-L1 = <0xd59f8>;
			opp-microvolt-L2 = <0xd59f8>;
		};

		opp-900000000 {
			opp-hz = <0x00 0x35a4e900>;
			opp-microvolt = <0xdbba0>;
		};

		opp-1000000000 {
			opp-hz = <0x00 0x3b9aca00>;
			opp-microvolt = <0xe7ef0>;
			opp-microvolt-L0 = <0xe7ef0>;
			opp-microvolt-L1 = <0xe1d48>;
			opp-microvolt-L2 = <0xdbba0>;
		};
	};

	iommu@fde4b000 {
		compatible = "rockchip,iommu-v2";
		reg = <0x00 0xfde4b000 0x00 0x40>;
		interrupts = <0x00 0x97 0x04>;
		interrupt-names = "rknpu_mmu";
		clocks = <0x24 0x28 0x24 0x29>;
		clock-names = "aclk", "iface";
		power-domains = <0x26 0x06>;
		#iommu-cells = <0x00>;
		status = "okay";
		phandle = <0x6a>;
	};

	gpu@fde60000 {
		compatible = "arm,mali-bifrost";
		reg = <0x00 0xfde60000 0x00 0x4000>;
		interrupts = <0x00 0x27 0x04 0x00 0x29 0x04 0x00 0x28 0x04>;
		interrupt-names = "GPU", "MMU", "JOB";
		upthreshold = <0x28>;
		downdifferential = <0x0a>;
		clocks = <0x02 0x01 0x24 0x1b>;
		clock-names = "clk_mali", "clk_gpu";
		power-domains = <0x26 0x07>;
		#cooling-cells = <0x02>;
		operating-points-v2 = <0x70>;
		status = "okay";
		mali-supply = <0x71>;
		phandle = <0x105>;

		power-model {
			compatible = "simple-power-model";
			leakage-range = <0x05 0x0f>;
			ls = <0xffffa23e 0x5927 0x00>;
			static-coefficient = <0x186a0>;
			dynamic-coefficient = <0x3b9>;
			ts = <0xfffe56a6 0xf87a 0xfffffab5 0x14>;
			thermal-zone = "gpu-thermal";
		};
	};

	pvtm@fde80000 {
		compatible = "rockchip,rk3568-gpu-pvtm";
		reg = <0x00 0xfde80000 0x00 0x100>;
		#address-cells = <0x01>;
		#size-cells = <0x00>;

		pvtm@1 {
			reg = <0x01>;
			clocks = <0x24 0x1e 0x24 0x1d>;
			clock-names = "clk", "pclk";
			resets = <0x24 0x24 0x24 0x23>;
			reset-names = "rts", "rst-p";
			thermal-zone = "gpu-thermal";
		};
	};

	pvtm@fde90000 {
		compatible = "rockchip,rk3568-npu-pvtm";
		reg = <0x00 0xfde90000 0x00 0x100>;
		#address-cells = <0x01>;
		#size-cells = <0x00>;

		pvtm@2 {
			reg = <0x02>;
			clocks = <0x24 0x2b 0x24 0x2a 0x24 0x25>;
			clock-names = "clk", "pclk", "hclk";
			resets = <0x24 0x2e 0x24 0x2d>;
			reset-names = "rts", "rst-p";
			thermal-zone = "soc-thermal";
		};
	};

	video-codec@fdea0400 {
		compatible = "rockchip,rk3568-vpu";
		reg = <0x00 0xfdea0000 0x00 0x800>;
		interrupts = <0x00 0x8b 0x04>;
		interrupt-names = "vdpu";
		clocks = <0x24 0xee 0x24 0xef>;
		clock-names = "aclk", "hclk";
		iommus = <0x72>;
		power-domains = <0x26 0x0b>;
	};

	vdpu@fdea0400 {
		compatible = "rockchip,vpu-decoder-v2";
		reg = <0x00 0xfdea0400 0x00 0x400>;
		interrupts = <0x00 0x8b 0x04>;
		interrupt-names = "irq_dec";
		clocks = <0x24 0xee 0x24 0xef>;
		clock-names = "aclk_vcodec", "hclk_vcodec";
		resets = <0x24 0x11a 0x24 0x11b>;
		reset-names = "video_a", "video_h";
		iommus = <0x72>;
		power-domains = <0x26 0x0b>;
		rockchip,srv = <0x73>;
		rockchip,taskqueue-node = <0x00>;
		rockchip,resetgroup-node = <0x00>;
		status = "okay";
	};

	iommu@fdea0800 {
		compatible = "rockchip,iommu-v2";
		reg = <0x00 0xfdea0800 0x00 0x40>;
		interrupts = <0x00 0x8a 0x04>;
		interrupt-names = "vdpu_mmu";
		clock-names = "aclk", "iface";
		clocks = <0x24 0xee 0x24 0xef>;
		power-domains = <0x26 0x0b>;
		#iommu-cells = <0x00>;
		status = "okay";
		phandle = <0x72>;
	};

	rk_rga@fdeb0000 {
		compatible = "rockchip,rga2";
		reg = <0x00 0xfdeb0000 0x00 0x1000>;
		interrupts = <0x00 0x5a 0x04>;
		clocks = <0x24 0xf3 0x24 0xf4 0x24 0xf5>;
		clock-names = "aclk_rga", "hclk_rga", "clk_rga";
		power-domains = <0x26 0x0a>;
		status = "okay";
	};

	ebc@fdec0000 {
		compatible = "rockchip,rk3568-ebc-tcon";
		reg = <0x00 0xfdec0000 0x00 0x5000>;
		interrupts = <0x00 0x11 0x04>;
		clocks = <0x24 0xf9 0x24 0xfa>;
		clock-names = "hclk", "dclk";
		power-domains = <0x26 0x0a>;
		rockchip,grf = <0x3a>;
		pinctrl-names = "default";
		pinctrl-0 = <0x74>;
		status = "disabled";
	};

	jpegd@fded0000 {
		compatible = "rockchip,rkv-jpeg-decoder-v1";
		reg = <0x00 0xfded0000 0x00 0x400>;
		interrupts = <0x00 0x3e 0x04>;
		clocks = <0x24 0xfb 0x24 0xfc>;
		clock-names = "aclk_vcodec", "hclk_vcodec";
		rockchip,disable-auto-freq;
		resets = <0x24 0x12c 0x24 0x12d>;
		reset-names = "video_a", "video_h";
		iommus = <0x75>;
		rockchip,srv = <0x73>;
		rockchip,taskqueue-node = <0x01>;
		rockchip,resetgroup-node = <0x01>;
		power-domains = <0x26 0x0a>;
		status = "okay";
	};

	iommu@fded0480 {
		compatible = "rockchip,iommu-v2";
		reg = <0x00 0xfded0480 0x00 0x40>;
		interrupts = <0x00 0x3d 0x04>;
		interrupt-names = "jpegd_mmu";
		clock-names = "aclk", "iface";
		clocks = <0x24 0xfb 0x24 0xfc>;
		power-domains = <0x26 0x0a>;
		#iommu-cells = <0x00>;
		status = "okay";
		phandle = <0x75>;
	};

	vepu@fdee0000 {
		compatible = "rockchip,vpu-encoder-v2";
		reg = <0x00 0xfdee0000 0x00 0x400>;
		interrupts = <0x00 0x40 0x04>;
		clocks = <0x24 0xfd 0x24 0xfe>;
		clock-names = "aclk_vcodec", "hclk_vcodec";
		rockchip,disable-auto-freq;
		resets = <0x24 0x12e 0x24 0x12f>;
		reset-names = "video_a", "video_h";
		iommus = <0x76>;
		rockchip,srv = <0x73>;
		rockchip,taskqueue-node = <0x02>;
		rockchip,resetgroup-node = <0x02>;
		power-domains = <0x26 0x0a>;
		status = "okay";
	};

	iommu@fdee0800 {
		compatible = "rockchip,iommu-v2";
		reg = <0x00 0xfdee0800 0x00 0x40>;
		interrupts = <0x00 0x3f 0x04>;
		interrupt-names = "vepu_mmu";
		clocks = <0x24 0xfd 0x24 0xfe>;
		clock-names = "aclk", "iface";
		power-domains = <0x26 0x0a>;
		#iommu-cells = <0x00>;
		status = "okay";
		phandle = <0x76>;
	};

	iep@fdef0000 {
		compatible = "rockchip,iep-v2";
		reg = <0x00 0xfdef0000 0x00 0x500>;
		interrupts = <0x00 0x38 0x04>;
		clocks = <0x24 0xf6 0x24 0xf7 0x24 0xf8>;
		clock-names = "aclk", "hclk", "sclk";
		resets = <0x24 0x127 0x24 0x128 0x24 0x129>;
		reset-names = "rst_a", "rst_h", "rst_s";
		power-domains = <0x26 0x0a>;
		rockchip,srv = <0x73>;
		rockchip,taskqueue-node = <0x05>;
		rockchip,resetgroup-node = <0x05>;
		iommus = <0x77>;
		status = "okay";
	};

	iommu@fdef0800 {
		compatible = "rockchip,iommu-v2";
		reg = <0x00 0xfdef0800 0x00 0x100>;
		interrupts = <0x00 0x38 0x04>;
		interrupt-names = "iep_mmu";
		clocks = <0x24 0xf6 0x24 0xf7>;
		clock-names = "aclk", "iface";
		#iommu-cells = <0x00>;
		power-domains = <0x26 0x0a>;
		status = "okay";
		phandle = <0x77>;
	};

	rkvenc@fdf40000 {
		compatible = "rockchip,rkv-encoder-v1";
		reg = <0x00 0xfdf40000 0x00 0x400>;
		interrupts = <0x00 0x8c 0x04>;
		interrupt-names = "irq_enc";
		clocks = <0x24 0x103 0x24 0x104 0x24 0x105>;
		clock-names = "aclk_vcodec", "hclk_vcodec", "clk_core";
		rockchip,normal-rates = <0x11b3dc40 0x00 0x11b3dc40>;
		resets = <0x24 0x133 0x24 0x134 0x24 0x135>;
		reset-names = "video_a", "video_h", "video_core";
		assigned-clocks = <0x24 0x103 0x24 0x105>;
		assigned-clock-rates = <0x11b3dc40 0x11b3dc40>;
		iommus = <0x78>;
		node-name = "rkvenc";
		rockchip,srv = <0x73>;
		rockchip,taskqueue-node = <0x03>;
		rockchip,resetgroup-node = <0x03>;
		power-domains = <0x26 0x0e>;
		operating-points-v2 = <0x79>;
		status = "okay";
		venc-supply = <0x6f>;
	};

	rkvenc-opp-table {
		compatible = "operating-points-v2";
		nvmem-cells = <0x07>;
		nvmem-cell-names = "pvtm";
		rockchip,pvtm-voltage-sel = <0x00 0x14820 0x00 0x14821 0x16378 0x01 0x16379 0x186a0 0x02>;
		rockchip,pvtm-ch = <0x00 0x05>;
		phandle = <0x79>;

		opp-297000000 {
			opp-hz = <0x00 0x11b3dc40>;
			opp-microvolt = <0xdbba0>;
			opp-microvolt-L0 = <0xdbba0>;
			opp-microvolt-L1 = <0xd59f8>;
			opp-microvolt-L2 = <0xd59f8>;
		};

		opp-400000000 {
			opp-hz = <0x00 0x17d78400>;
			opp-microvolt = <0xe7ef0>;
			opp-microvolt-L0 = <0xe7ef0>;
			opp-microvolt-L1 = <0xe1d48>;
			opp-microvolt-L2 = <0xdbba0>;
		};
	};

	iommu@fdf40f00 {
		compatible = "rockchip,iommu-v2";
		reg = <0x00 0xfdf40f00 0x00 0x40 0x00 0xfdf40f40 0x00 0x40>;
		interrupts = <0x00 0x8d 0x04 0x00 0x8e 0x04>;
		interrupt-names = "rkvenc_mmu0", "rkvenc_mmu1";
		clocks = <0x24 0x103 0x24 0x104>;
		clock-names = "aclk", "iface";
		rockchip,disable-mmu-reset;
		rockchip,enable-cmd-retry;
		#iommu-cells = <0x00>;
		power-domains = <0x26 0x0e>;
		status = "okay";
		phandle = <0x78>;
	};

	rkvdec@fdf80200 {
		compatible = "rockchip,rkv-decoder-rk3568", "rockchip,rkv-decoder-v2";
		reg = <0x00 0xfdf80200 0x00 0x400 0x00 0xfdf80100 0x00 0x100>;
		reg-names = "regs", "link";
		interrupts = <0x00 0x5b 0x04>;
		interrupt-names = "irq_dec";
		clocks = <0x24 0x108 0x24 0x109 0x24 0x10a 0x24 0x10b 0x24 0x10c>;
		clock-names = "aclk_vcodec", "hclk_vcodec", "clk_cabac", "clk_core", "clk_hevc_cabac";
		rockchip,normal-rates = <0x11b3dc40 0x00 0x11b3dc40 0x11b3dc40 0x23c34600>;
		rockchip,advanced-rates = <0x179a7b00 0x00 0x179a7b00 0x179a7b00 0x23c34600>;
		rockchip,default-max-load = <0x1fe000>;
		resets = <0x24 0x142 0x24 0x143 0x24 0x144 0x24 0x145 0x24 0x146>;
		assigned-clocks = <0x24 0x108 0x24 0x10a 0x24 0x10b 0x24 0x10c>;
		assigned-clock-rates = <0x11b3dc40 0x11b3dc40 0x11b3dc40 0x11b3dc40>;
		reset-names = "video_a", "video_h", "video_cabac", "video_core", "video_hevc_cabac";
		power-domains = <0x26 0x0d>;
		operating-points-v2 = <0x7a>;
		vdec-supply = <0x6f>;
		iommus = <0x7b>;
		rockchip,srv = <0x73>;
		rockchip,taskqueue-node = <0x04>;
		rockchip,resetgroup-node = <0x04>;
		rockchip,sram = <0x7c>;
		rockchip,rcb-iova = <0x10000000 0x10000>;
		rockchip,rcb-min-width = <0x200>;
		rockchip,task-capacity = <0x10>;
		status = "okay";
	};

	rkvdec-opp-table {
		compatible = "operating-points-v2";
		nvmem-cells = <0x7d 0x07>;
		nvmem-cell-names = "leakage", "pvtm";
		rockchip,leakage-voltage-sel = <0x01 0x50 0x00 0x51 0xfe 0x01>;
		rockchip,pvtm-voltage-sel = <0x00 0x14820 0x00 0x14821 0x186a0 0x01>;
		rockchip,pvtm-ch = <0x00 0x05>;
		phandle = <0x7a>;

		opp-297000000 {
			opp-hz = <0x00 0x11b3dc40>;
			opp-microvolt = <0xdbba0>;
			opp-microvolt-L0 = <0xdbba0>;
			opp-microvolt-L1 = <0xd59f8>;
		};

		opp-400000000 {
			opp-hz = <0x00 0x17d78400>;
			opp-microvolt = <0xdbba0>;
		};
	};

	iommu@fdf80800 {
		compatible = "rockchip,iommu-v2";
		reg = <0x00 0xfdf80800 0x00 0x40 0x00 0xfdf80840 0x00 0x40>;
		interrupts = <0x00 0x5c 0x04>;
		interrupt-names = "rkvdec_mmu";
		clocks = <0x24 0x108 0x24 0x109>;
		clock-names = "aclk", "iface";
		power-domains = <0x26 0x0d>;
		#iommu-cells = <0x00>;
		status = "okay";
		phandle = <0x7b>;
	};

	mipi-csi2-hw@fdfb0000 {
		compatible = "rockchip,rk3568-mipi-csi2-hw";
		reg = <0x00 0xfdfb0000 0x00 0x10000>;
		reg-names = "csihost_regs";
		interrupts = <0x00 0x08 0x04 0x00 0x09 0x04>;
		interrupt-names = "csi-intr1", "csi-intr2";
		clocks = <0x24 0xd5>;
		clock-names = "pclk_csi2host";
		resets = <0x24 0xff>;
		reset-names = "srst_csihost_p";
		status = "okay";
		phandle = <0x1e>;
	};

	rkcif@fdfe0000 {
		compatible = "rockchip,rk3568-cif";
		reg = <0x00 0xfdfe0000 0x00 0x8000>;
		reg-names = "cif_regs";
		interrupts = <0x00 0x92 0x04>;
		interrupt-names = "cif-intr";
		clocks = <0x24 0xce 0x24 0xcf 0x24 0xd0 0x24 0xd1>;
		clock-names = "aclk_cif", "hclk_cif", "dclk_cif", "iclk_cif_g";
		resets = <0x24 0xf7 0x24 0xf8 0x24 0xf9 0x24 0xfb 0x24 0xfa>;
		reset-names = "rst_cif_a", "rst_cif_h", "rst_cif_d", "rst_cif_p", "rst_cif_i";
		assigned-clocks = <0x24 0xd0>;
		assigned-clock-rates = <0x11e1a300>;
		power-domains = <0x26 0x08>;
		rockchip,grf = <0x3a>;
		iommus = <0x7e>;
		status = "disabled";
		phandle = <0x7f>;
	};

	iommu@fdfe0800 {
		compatible = "rockchip,iommu-v2";
		reg = <0x00 0xfdfe0800 0x00 0x100>;
		interrupts = <0x00 0x92 0x04>;
		interrupt-names = "cif_mmu";
		clocks = <0x24 0xce 0x24 0xcf>;
		clock-names = "aclk", "iface";
		power-domains = <0x26 0x08>;
		rockchip,disable-mmu-reset;
		#iommu-cells = <0x00>;
		status = "disabled";
		phandle = <0x7e>;
	};

	rkcif_dvp {
		compatible = "rockchip,rkcif-dvp";
		rockchip,hw = <0x7f>;
		status = "disabled";
		phandle = <0x80>;
	};

	rkcif_dvp_sditf {
		compatible = "rockchip,rkcif-sditf";
		rockchip,cif = <0x80>;
		status = "disabled";
	};

	rkcif_mipi_lvds {
		compatible = "rockchip,rkcif-mipi-lvds";
		rockchip,hw = <0x7f>;
		status = "disabled";
		phandle = <0x81>;
	};

	rkcif_mipi_lvds_sditf {
		compatible = "rockchip,rkcif-sditf";
		rockchip,cif = <0x81>;
		status = "disabled";
	};

	rkisp@fdff0000 {
		compatible = "rockchip,rk3568-rkisp";
		reg = <0x00 0xfdff0000 0x00 0x10000>;
		interrupts = <0x00 0x39 0x04 0x00 0x3a 0x04 0x00 0x3c 0x04>;
		interrupt-names = "mipi_irq", "mi_irq", "isp_irq";
		clocks = <0x24 0xd2 0x24 0xd3 0x24 0xd4>;
		clock-names = "aclk_isp", "hclk_isp", "clk_isp";
		resets = <0x24 0xfd 0x24 0xfc>;
		reset-names = "isp", "isp-h";
		rockchip,grf = <0x3a>;
		power-domains = <0x26 0x08>;
		iommus = <0x82>;
		rockchip,iq-feature = <0x1bfb 0xfffe67ff>;
		status = "okay";
		phandle = <0x83>;
	};

	iommu@fdff1a00 {
		compatible = "rockchip,iommu-v2";
		reg = <0x00 0xfdff1a00 0x00 0x100>;
		interrupts = <0x00 0x3b 0x04>;
		interrupt-names = "isp_mmu";
		clocks = <0x24 0xd2 0x24 0xd3>;
		clock-names = "aclk", "iface";
		power-domains = <0x26 0x08>;
		#iommu-cells = <0x00>;
		rockchip,disable-mmu-reset;
		status = "okay";
		phandle = <0x82>;
	};

	rkisp-vir0 {
		compatible = "rockchip,rkisp-vir";
		rockchip,hw = <0x83>;
		status = "okay";

		port {
			#address-cells = <0x01>;
			#size-cells = <0x00>;

			endpoint@0 {
				reg = <0x00>;
				remote-endpoint = <0x84>;
				phandle = <0x114>;
			};
		};
	};

	rkisp-vir1 {
		compatible = "rockchip,rkisp-vir";
		rockchip,hw = <0x83>;
		status = "disabled";
	};

	mmc@fe000000 {
		compatible = "rockchip,rk3568-dw-mshc", "rockchip,rk3288-dw-mshc";
		reg = <0x00 0xfe000000 0x00 0x4000>;
		interrupts = <0x00 0x64 0x04>;
		clocks = <0x24 0xc1 0x24 0xc2 0x24 0x18e 0x24 0x18f>;
		clock-names = "biu", "ciu", "ciu-drive", "ciu-sample";
		fifo-depth = <0x100>;
		max-frequency = <0x8f0d180>;
		resets = <0x24 0xeb>;
		reset-names = "reset";
		status = "okay";
		no-sd;
		no-mmc;
		bus-width = <0x04>;
		disable-wp;
		cap-sd-highspeed;
		cap-sdio-irq;
		keep-power-in-suspend;
		mmc-pwrseq = <0x85>;
		non-removable;
		pinctrl-names = "default";
		pinctrl-0 = <0x86 0x87 0x88>;
		sd-uhs-sdr104;
	};

	uio@fe010000 {
		compatible = "rockchip,uio-gmac";
		reg = <0x00 0xfe010000 0x00 0x10000>;
		rockchip,ethernet = <0x89>;
		status = "disabled";
	};

	ethernet@fe010000 {
		compatible = "rockchip,rk3568-gmac", "snps,dwmac-4.20a";
		reg = <0x00 0xfe010000 0x00 0x10000>;
		interrupts = <0x00 0x20 0x04 0x00 0x1d 0x04>;
		interrupt-names = "macirq", "eth_wake_irq";
		clocks = <0x24 0x186 0x24 0x189 0x24 0x189 0x24 0xc7 0x24 0xc3 0x24 0xc4 0x24 0x189 0x24 0xc8 0x24 0xac 0x24 0xab>;
		clock-names = "stmmaceth", "mac_clk_rx", "mac_clk_tx", "clk_mac_refout", "aclk_mac", "pclk_mac", "clk_mac_speed", "ptp_ref", "pclk_xpcs", "clk_xpcs_eee";
		resets = <0x24 0xec>;
		reset-names = "stmmaceth";
		rockchip,grf = <0x3a>;
		snps,axi-config = <0x8a>;
		snps,mixed-burst;
		snps,mtl-rx-config = <0x8b>;
		snps,mtl-tx-config = <0x8c>;
		snps,tso;
		status = "okay";
		phy-mode = "rgmii";
		clock_in_out = "output";
		snps,reset-gpio = <0x8d 0x07 0x01>;
		snps,reset-active-low;
		snps,reset-delays-us = <0x00 0x4e20 0x186a0>;
		assigned-clocks = <0x24 0x189 0x24 0x186>;
		assigned-clock-parents = <0x24 0x187 0x24 0xc5>;
		assigned-clock-rates = <0x00 0x7735940>;
		pinctrl-names = "default";
		pinctrl-0 = <0x8e 0x8f 0x90 0x91 0x92>;
		tx_delay = <0x2f>;
		rx_delay = <0x39>;
		phy-handle = <0x93>;
		phandle = <0x89>;

		mdio {
			compatible = "snps,dwmac-mdio";
			#address-cells = <0x01>;
			#size-cells = <0x00>;

			phy@0 {
				compatible = "ethernet-phy-ieee802.3-c22";
				reg = <0x00>;
				phandle = <0x93>;
			};
		};

		stmmac-axi-config {
			snps,blen = <0x00 0x00 0x00 0x00 0x10 0x08 0x04>;
			snps,rd_osr_lmt = <0x08>;
			snps,wr_osr_lmt = <0x04>;
			phandle = <0x8a>;
		};

		rx-queues-config {
			snps,rx-queues-to-use = <0x01>;
			phandle = <0x8b>;

			queue0 {
			};
		};

		tx-queues-config {
			snps,tx-queues-to-use = <0x01>;
			phandle = <0x8c>;

			queue0 {
			};
		};
	};

	vop@fe040000 {
		compatible = "rockchip,rk3568-vop";
		reg = <0x00 0xfe040000 0x00 0x3000 0x00 0xfe044000 0x00 0x1000>;
		reg-names = "regs", "gamma_lut";
		interrupts = <0x00 0x94 0x04>;
		clocks = <0x24 0xdd 0x24 0xde 0x24 0xdf 0x24 0xe0 0x24 0xe1>;
		clock-names = "aclk_vop", "hclk_vop", "dclk_vp0", "dclk_vp1", "dclk_vp2";
		rockchip,aclk-normal-mode-rates = <0x179a7b00>;
		rockchip,aclk-advanced-mode-rates = <0x1dcd6500>;
		operating-points-v2 = <0x94>;
		iommus = <0x95>;
		power-domains = <0x26 0x09>;
		rockchip,grf = <0x3a>;
		status = "okay";
		assigned-clocks = <0x24 0xdf 0x24 0xe0 0x24 0xe1>;
		assigned-clock-parents = <0x39 0x02 0x24 0x05 0x24 0x04>;
		disable-win-move;

		ports {
			#address-cells = <0x01>;
			#size-cells = <0x00>;
			phandle = <0x11>;

			port@0 {
				reg = <0x00>;
				#address-cells = <0x01>;
				#size-cells = <0x00>;

				endpoint@0 {
					reg = <0x00>;
					remote-endpoint = <0x96>;
					phandle = <0x13>;
				};

				endpoint@1 {
					reg = <0x01>;
					remote-endpoint = <0x97>;
					phandle = <0x14>;
				};

				endpoint@2 {
					reg = <0x02>;
					remote-endpoint = <0x98>;
					phandle = <0x15>;
				};

				endpoint@3 {
					reg = <0x03>;
					remote-endpoint = <0x99>;
					phandle = <0x16>;
				};
			};

			port@1 {
				reg = <0x01>;
				#address-cells = <0x01>;
				#size-cells = <0x00>;

				endpoint@0 {
					reg = <0x00>;
					remote-endpoint = <0x9a>;
					phandle = <0xa3>;
				};

				endpoint@1 {
					reg = <0x01>;
					remote-endpoint = <0x9b>;
					phandle = <0xa4>;
				};

				endpoint@2 {
					reg = <0x02>;
					remote-endpoint = <0x9c>;
					phandle = <0xaa>;
				};

				endpoint@3 {
					reg = <0x03>;
					remote-endpoint = <0x9d>;
					phandle = <0xa8>;
				};

				endpoint@4 {
					reg = <0x04>;
					remote-endpoint = <0x9e>;
					phandle = <0x17>;
				};

				endpoint@5 {
					reg = <0x05>;
					remote-endpoint = <0x9f>;
					phandle = <0x37>;
				};
			};

			port@2 {
				reg = <0x02>;
				#address-cells = <0x01>;
				#size-cells = <0x00>;

				endpoint@0 {
					reg = <0x00>;
					remote-endpoint = <0xa0>;
					phandle = <0x34>;
				};

				endpoint@1 {
					reg = <0x01>;
					remote-endpoint = <0xa1>;
					phandle = <0x18>;
				};

				endpoint@2 {
					reg = <0x02>;
					remote-endpoint = <0xa2>;
					phandle = <0x38>;
				};
			};
		};
	};

	vop-opp-table {
		compatible = "operating-points-v2";
		nvmem-cells = <0x7d 0x07>;
		nvmem-cell-names = "leakage", "pvtm";
		rockchip,leakage-voltage-sel = <0x01 0x50 0x00 0x51 0xfe 0x01>;
		rockchip,pvtm-voltage-sel = <0x00 0x14820 0x00 0x14821 0x186a0 0x01>;
		rockchip,pvtm-ch = <0x00 0x05>;
		phandle = <0x94>;

		opp-396000000 {
			opp-hz = <0x00 0x179a7b00>;
			opp-microvolt = <0xdbba0 0xdbba0 0xf4240>;
			opp-microvolt-L0 = <0xdbba0 0xdbba0 0xf4240>;
			opp-microvolt-L1 = <0xd59f8 0xd59f8 0xf4240>;
		};

		opp-500000000 {
			opp-hz = <0x00 0x1dcd6500>;
			opp-microvolt = <0xe1d48 0xe1d48 0xf4240>;
			opp-microvolt-L0 = <0xe1d48 0xe1d48 0xf4240>;
			opp-microvolt-L1 = <0xdbba0 0xdbba0 0xf4240>;
		};
	};

	iommu@fe043e00 {
		compatible = "rockchip,iommu-v2";
		reg = <0x00 0xfe043e00 0x00 0x100 0x00 0xfe043f00 0x00 0x100>;
		interrupts = <0x00 0x94 0x04>;
		interrupt-names = "vop_mmu";
		clocks = <0x24 0xdd 0x24 0xde>;
		clock-names = "aclk", "iface";
		#iommu-cells = <0x00>;
		rockchip,disable-device-link-resume;
		status = "okay";
		phandle = <0x95>;
	};

	dsi@fe060000 {
		compatible = "rockchip,rk3568-mipi-dsi";
		reg = <0x00 0xfe060000 0x00 0x10000>;
		interrupts = <0x00 0x44 0x04>;
		clock-names = "pclk", "hclk";
		clocks = <0x24 0xe8 0x24 0xda>;
		phy-names = "dphy";
		phys = <0x33>;
		power-domains = <0x26 0x09>;
		reset-names = "apb";
		resets = <0x24 0x110>;
		rockchip,grf = <0x3a>;
		#address-cells = <0x01>;
		#size-cells = <0x00>;
		status = "disabled";

		ports {
			#address-cells = <0x01>;
			#size-cells = <0x00>;

			port@0 {
				reg = <0x00>;
				#address-cells = <0x01>;
				#size-cells = <0x00>;

				endpoint@0 {
					reg = <0x00>;
					remote-endpoint = <0x13>;
					status = "disabled";
					phandle = <0x96>;
				};

				endpoint@1 {
					reg = <0x01>;
					remote-endpoint = <0xa3>;
					status = "disabled";
					phandle = <0x9a>;
				};
			};
		};
	};

	dsi@fe070000 {
		compatible = "rockchip,rk3568-mipi-dsi";
		reg = <0x00 0xfe070000 0x00 0x10000>;
		interrupts = <0x00 0x45 0x04>;
		clock-names = "pclk", "hclk";
		clocks = <0x24 0xe9 0x24 0xda>;
		phy-names = "dphy";
		phys = <0x36>;
		power-domains = <0x26 0x09>;
		reset-names = "apb";
		resets = <0x24 0x111>;
		rockchip,grf = <0x3a>;
		#address-cells = <0x01>;
		#size-cells = <0x00>;
		status = "disabled";

		ports {
			#address-cells = <0x01>;
			#size-cells = <0x00>;

			port@0 {
				reg = <0x00>;
				#address-cells = <0x01>;
				#size-cells = <0x00>;

				endpoint@0 {
					reg = <0x00>;
					remote-endpoint = <0x14>;
					status = "disabled";
					phandle = <0x97>;
				};

				endpoint@1 {
					reg = <0x01>;
					remote-endpoint = <0xa4>;
					status = "disabled";
					phandle = <0x9b>;
				};
			};
		};
	};

	hdmi@fe0a0000 {
		compatible = "rockchip,rk3568-dw-hdmi";
		reg = <0x00 0xfe0a0000 0x00 0x20000>;
		interrupts = <0x00 0x2d 0x04>;
		clocks = <0x24 0xe6 0x24 0xe7 0x24 0x193 0x39 0x02 0x24 0xde>;
		clock-names = "iahb", "isfr", "cec", "ref", "hclk";
		pinctrl-names = "default";
		pinctrl-0 = <0xa5 0xa6 0xa7>;
		power-domains = <0x26 0x09>;
		reg-io-width = <0x04>;
		rockchip,grf = <0x3a>;
		#sound-dai-cells = <0x00>;
		status = "okay";
		rockchip,phy-table = <0x58834d4 0x8009 0x00 0x270 0x9d5b340 0x800b 0x00 0x26d 0xb1069a8 0x800b 0x00 0x1ed 0x11b3dc40 0x800b 0x00 0x1ad 0x2367b880 0x8029 0x00 0x88 0x00 0x00 0x00 0x00>;
		phandle = <0x1c>;

		ports {
			#address-cells = <0x01>;
			#size-cells = <0x00>;

			port@0 {
				reg = <0x00>;
				#address-cells = <0x01>;
				#size-cells = <0x00>;

				endpoint@0 {
					reg = <0x00>;
					remote-endpoint = <0x16>;
					status = "okay";
					phandle = <0x99>;
				};

				endpoint@1 {
					reg = <0x01>;
					remote-endpoint = <0xa8>;
					status = "disabled";
					phandle = <0x9d>;
				};
			};
		};
	};

	edp@fe0c0000 {
		compatible = "rockchip,rk3568-edp";
		reg = <0x00 0xfe0c0000 0x00 0x10000>;
		interrupts = <0x00 0x12 0x04>;
		clocks = <0x39 0x29 0x24 0xea 0x24 0xeb 0x24 0xda>;
		clock-names = "dp", "pclk", "spdif", "hclk";
		resets = <0x24 0x113 0x24 0x112>;
		reset-names = "dp", "apb";
		phys = <0xa9>;
		phy-names = "dp";
		power-domains = <0x26 0x09>;
		status = "disabled";

		ports {
			#address-cells = <0x01>;
			#size-cells = <0x00>;

			port@0 {
				reg = <0x00>;
				#address-cells = <0x01>;
				#size-cells = <0x00>;

				endpoint@0 {
					reg = <0x00>;
					remote-endpoint = <0x15>;
					status = "disabled";
					phandle = <0x98>;
				};

				endpoint@1 {
					reg = <0x01>;
					remote-endpoint = <0xaa>;
					status = "disabled";
					phandle = <0x9c>;
				};
			};
		};
	};

	nocp-cpu@fe102000 {
		compatible = "rockchip,rk3568-nocp";
		reg = <0x00 0xfe102000 0x00 0x400>;
		phandle = <0xac>;
	};

	nocp-gpu-vpu-rga-venc@fe102400 {
		compatible = "rockchip,rk3568-nocp";
		reg = <0x00 0xfe102400 0x00 0x400>;
	};

	nocp-vdec@fe102800 {
		compatible = "rockchip,rk3568-nocp";
		reg = <0x00 0xfe102800 0x00 0x400>;
	};

	nocp-vi-usb-peri-pipe@fe102c00 {
		compatible = "rockchip,rk3568-nocp";
		reg = <0x00 0xfe102c00 0x00 0x400>;
	};

	nocp-vo@fe103000 {
		compatible = "rockchip,rk3568-nocp";
		reg = <0x00 0xfe103000 0x00 0x400>;
	};

	qos@fe128000 {
		compatible = "rockchip,rk3568-qos", "syscon";
		reg = <0x00 0xfe128000 0x00 0x20>;
		phandle = <0x4f>;
	};

	qos@fe138080 {
		compatible = "rockchip,rk3568-qos", "syscon";
		reg = <0x00 0xfe138080 0x00 0x20>;
		phandle = <0x5e>;
	};

	qos@fe138100 {
		compatible = "rockchip,rk3568-qos", "syscon";
		reg = <0x00 0xfe138100 0x00 0x20>;
		phandle = <0x5f>;
	};

	qos@fe138180 {
		compatible = "rockchip,rk3568-qos", "syscon";
		reg = <0x00 0xfe138180 0x00 0x20>;
		phandle = <0x60>;
	};

	qos@fe148000 {
		compatible = "rockchip,rk3568-qos", "syscon";
		reg = <0x00 0xfe148000 0x00 0x20>;
		phandle = <0x50>;
	};

	qos@fe148080 {
		compatible = "rockchip,rk3568-qos", "syscon";
		reg = <0x00 0xfe148080 0x00 0x20>;
		phandle = <0x51>;
	};

	qos@fe148100 {
		compatible = "rockchip,rk3568-qos", "syscon";
		reg = <0x00 0xfe148100 0x00 0x20>;
		phandle = <0x52>;
	};

	qos@fe150000 {
		compatible = "rockchip,rk3568-qos", "syscon";
		reg = <0x00 0xfe150000 0x00 0x20>;
		phandle = <0x5c>;
	};

	qos@fe158000 {
		compatible = "rockchip,rk3568-qos", "syscon";
		reg = <0x00 0xfe158000 0x00 0x20>;
		phandle = <0x56>;
	};

	qos@fe158100 {
		compatible = "rockchip,rk3568-qos", "syscon";
		reg = <0x00 0xfe158100 0x00 0x20>;
		phandle = <0x57>;
	};

	qos@fe158180 {
		compatible = "rockchip,rk3568-qos", "syscon";
		reg = <0x00 0xfe158180 0x00 0x20>;
		phandle = <0x58>;
	};

	qos@fe158200 {
		compatible = "rockchip,rk3568-qos", "syscon";
		reg = <0x00 0xfe158200 0x00 0x20>;
		phandle = <0x59>;
	};

	qos@fe158280 {
		compatible = "rockchip,rk3568-qos", "syscon";
		reg = <0x00 0xfe158280 0x00 0x20>;
		phandle = <0x5a>;
	};

	qos@fe158300 {
		compatible = "rockchip,rk3568-qos", "syscon";
		reg = <0x00 0xfe158300 0x00 0x20>;
		phandle = <0x5b>;
	};

	qos@fe180000 {
		compatible = "rockchip,rk3568-qos", "syscon";
		reg = <0x00 0xfe180000 0x00 0x20>;
		phandle = <0x4e>;
	};

	qos@fe190000 {
		compatible = "rockchip,rk3568-qos", "syscon";
		reg = <0x00 0xfe190000 0x00 0x20>;
		phandle = <0x61>;
	};

	qos@fe190280 {
		compatible = "rockchip,rk3568-qos", "syscon";
		reg = <0x00 0xfe190280 0x00 0x20>;
		phandle = <0x65>;
	};

	qos@fe190300 {
		compatible = "rockchip,rk3568-qos", "syscon";
		reg = <0x00 0xfe190300 0x00 0x20>;
		phandle = <0x66>;
	};

	qos@fe190380 {
		compatible = "rockchip,rk3568-qos", "syscon";
		reg = <0x00 0xfe190380 0x00 0x20>;
		phandle = <0x67>;
	};

	qos@fe190400 {
		compatible = "rockchip,rk3568-qos", "syscon";
		reg = <0x00 0xfe190400 0x00 0x20>;
		phandle = <0x68>;
	};

	qos@fe198000 {
		compatible = "rockchip,rk3568-qos", "syscon";
		reg = <0x00 0xfe198000 0x00 0x20>;
		phandle = <0x5d>;
	};

	qos@fe1a8000 {
		compatible = "rockchip,rk3568-qos", "syscon";
		reg = <0x00 0xfe1a8000 0x00 0x20>;
		phandle = <0x53>;
	};

	qos@fe1a8080 {
		compatible = "rockchip,rk3568-qos", "syscon";
		reg = <0x00 0xfe1a8080 0x00 0x20>;
		phandle = <0x54>;
	};

	qos@fe1a8100 {
		compatible = "rockchip,rk3568-qos", "syscon";
		reg = <0x00 0xfe1a8100 0x00 0x20>;
		phandle = <0x55>;
	};

	dfi@fe230000 {
		reg = <0x00 0xfe230000 0x00 0x400>;
		compatible = "rockchip,rk3568-dfi";
		rockchip,pmugrf = <0x3b>;
		status = "okay";
		phandle = <0xab>;
	};

	dmc {
		compatible = "rockchip,rk3568-dmc";
		interrupts = <0x00 0x0a 0x04>;
		interrupt-names = "complete";
		devfreq-events = <0xab 0xac>;
		clocks = <0x02 0x03>;
		clock-names = "dmc_clk";
		operating-points-v2 = <0xad>;
		vop-bw-dmc-freq = <0x00 0x11e 0x4f1a0 0x11f 0x1869f 0x80e80>;
		vop-frame-bw-dmc-freq = <0x00 0x26c 0x4f1a0 0x26d 0x1869f 0xbe6e0>;
		cpu-bw-dmc-freq = <0x00 0x15e 0x4f1a0 0x15f 0x190 0x80e80 0x191 0x1869f 0xbe6e0>;
		upthreshold = <0x28>;
		downdifferential = <0x14>;
		system-status-level = <0x01 0x04 0x08 0x08 0x02 0x01 0x10 0x04 0x10000 0x04 0x1000 0x08 0x4000 0x08 0x2000 0x08 0xc00 0x08>;
		auto-min-freq = <0x4f1a0>;
		auto-freq-en = <0x01>;
		#cooling-cells = <0x02>;
		status = "okay";
		center-supply = <0x6f>;
		phandle = <0x12>;
	};

	dmc-fsp {
		compatible = "rockchip,rk3568-dmc-fsp";
		debug_print_level = <0x00>;
		ddr3_params = <0xae>;
		ddr4_params = <0xaf>;
		lpddr3_params = <0xb0>;
		lpddr4_params = <0xb1>;
		lpddr4x_params = <0xb2>;
		status = "okay";
	};

	dmc-opp-table {
		compatible = "operating-points-v2";
		mbist-vmin = <0xc96a8 0xdbba0 0xe7ef0>;
		nvmem-cells = <0x7d 0x07 0x08 0xb3 0x0a 0x0b>;
		nvmem-cell-names = "leakage", "pvtm", "mbist-vmin", "opp-info", "specification_serial_number", "remark_spec_serial_number";
		rockchip,supported-hw;
		rockchip,max-volt = <0xf4240>;
		rockchip,temp-hysteresis = <0x1388>;
		rockchip,low-temp = <0x00>;
		rockchip,low-temp-adjust-volt = <0x00 0x618 0x124f8>;
		rockchip,leakage-voltage-sel = <0x01 0x50 0x00 0x51 0xfe 0x01>;
		rockchip,pvtm-voltage-sel = <0x00 0x14820 0x00 0x14821 0x186a0 0x01>;
		rockchip,pvtm-ch = <0x00 0x05>;
		phandle = <0xad>;

		opp-1560000000 {
			opp-supported-hw = <0xf9 0xffff>;
			opp-hz = <0x00 0x5cfbb600>;
			opp-microvolt = <0xdbba0 0xdbba0 0xf4240>;
			opp-microvolt-L0 = <0xdbba0 0xdbba0 0xf4240>;
			opp-microvolt-L1 = <0xd59f8 0xd59f8 0xf4240>;
		};

		opp-j-m-1560000000 {
			opp-supported-hw = <0x06 0xffff>;
			opp-hz = <0x00 0x5cfbb600>;
			opp-microvolt = <0xd59f8 0xd59f8 0xf4240>;
		};
	};

	pcie@fe260000 {
		compatible = "rockchip,rk3568-pcie", "snps,dw-pcie";
		reg = <0x03 0xc0000000 0x00 0x400000 0x00 0xfe260000 0x00 0x10000 0x00 0xf4000000 0x00 0x100000>;
		reg-names = "pcie-dbi", "pcie-apb", "config";
		interrupts = <0x00 0x4b 0x04 0x00 0x4a 0x04 0x00 0x49 0x04 0x00 0x48 0x04 0x00 0x47 0x04>;
		interrupt-names = "sys", "pmc", "msg", "legacy", "err";
		bus-range = <0x00 0x0f>;
		clocks = <0x24 0x81 0x24 0x82 0x24 0x83 0x24 0x84 0x24 0x85>;
		clock-names = "aclk_mst", "aclk_slv", "aclk_dbi", "pclk", "aux";
		device_type = "pci";
		#interrupt-cells = <0x01>;
		interrupt-map-mask = <0x00 0x00 0x00 0x07>;
		interrupt-map = <0x00 0x00 0x00 0x01 0xb4 0x00 0x00 0x00 0x00 0x02 0xb4 0x01 0x00 0x00 0x00 0x03 0xb4 0x02 0x00 0x00 0x00 0x04 0xb4 0x03>;
		linux,pci-domain = <0x00>;
		num-ib-windows = <0x06>;
		num-viewport = <0x08>;
		num-ob-windows = <0x02>;
		max-link-speed = <0x02>;
		msi-map = <0x00 0xb5 0x00 0x1000>;
		num-lanes = <0x01>;
		phys = <0x27 0x02>;
		phy-names = "pcie-phy";
		power-domains = <0x26 0x0f>;
		ranges = <0x1000000 0x00 0xf4100000 0x00 0xf4100000 0x00 0x100000 0x2000000 0x00 0xf4200000 0x00 0xf4200000 0x00 0x1e00000 0x3000000 0x03 0x00 0x03 0x00 0x00 0x40000000>;
		resets = <0x24 0xa1>;
		reset-names = "pipe";
		#address-cells = <0x03>;
		#size-cells = <0x02>;
		status = "okay";
		reset-gpios = <0x8d 0x11 0x00>;
		disable-gpios = <0x8d 0x12 0x00>;
		vpcie3v3-supply = <0xb6>;

		legacy-interrupt-controller {
			#address-cells = <0x00>;
			#interrupt-cells = <0x01>;
			interrupt-controller;
			interrupt-parent = <0x01>;
			interrupts = <0x00 0x48 0x01>;
			phandle = <0xb4>;
		};
	};

	mmc@fe2b0000 {
		compatible = "rockchip,rk3568-dw-mshc", "rockchip,rk3288-dw-mshc";
		reg = <0x00 0xfe2b0000 0x00 0x4000>;
		interrupts = <0x00 0x62 0x04>;
		clocks = <0x24 0xb0 0x24 0xb1 0x24 0x18a 0x24 0x18b>;
		clock-names = "biu", "ciu", "ciu-drive", "ciu-sample";
		fifo-depth = <0x100>;
		max-frequency = <0x8f0d180>;
		resets = <0x24 0xd4>;
		reset-names = "reset";
		status = "okay";
		no-sdio;
		no-mmc;
		bus-width = <0x04>;
		cap-mmc-highspeed;
		cap-sd-highspeed;
		disable-wp;
		sd-uhs-sdr104;
		vmmc-supply = <0xb7>;
		vqmmc-supply = <0x30>;
		pinctrl-names = "default";
		pinctrl-0 = <0xb8 0xb9 0xba 0xbb>;
	};

	mmc@fe2c0000 {
		compatible = "rockchip,rk3568-dw-mshc", "rockchip,rk3288-dw-mshc";
		reg = <0x00 0xfe2c0000 0x00 0x4000>;
		interrupts = <0x00 0x63 0x04>;
		clocks = <0x24 0xb2 0x24 0xb3 0x24 0x18c 0x24 0x18d>;
		clock-names = "biu", "ciu", "ciu-drive", "ciu-sample";
		fifo-depth = <0x100>;
		max-frequency = <0x8f0d180>;
		resets = <0x24 0xd6>;
		reset-names = "reset";
		status = "disabled";
	};

	spi@fe300000 {
		compatible = "rockchip,sfc";
		reg = <0x00 0xfe300000 0x00 0x4000>;
		interrupts = <0x00 0x65 0x04>;
		clocks = <0x24 0x78 0x24 0x76>;
		clock-names = "clk_sfc", "hclk_sfc";
		assigned-clocks = <0x24 0x78>;
		assigned-clock-rates = <0x5f5e100>;
		#address-cells = <0x01>;
		#size-cells = <0x00>;
		status = "disabled";
	};

	mmc@fe310000 {
		compatible = "rockchip,rk3568-dwcmshc", "rockchip,dwcmshc-sdhci";
		reg = <0x00 0xfe310000 0x00 0x10000>;
		interrupts = <0x00 0x13 0x04>;
		assigned-clocks = <0x24 0x7b 0x24 0x7d 0x24 0x7c>;
		assigned-clock-rates = <0xbebc200 0x16e3600 0xbebc200>;
		clocks = <0x24 0x7c 0x24 0x7a 0x24 0x79 0x24 0x7b 0x24 0x7d>;
		clock-names = "core", "bus", "axi", "block", "timer";
		resets = <0x24 0x78 0x24 0x76 0x24 0x75 0x24 0x77 0x24 0x79>;
		reset-names = "core", "bus", "axi", "block", "timer";
		status = "okay";
		bus-width = <0x08>;
		no-sdio;
		no-sd;
		non-removable;
		max-frequency = <0xbebc200>;
	};

	nand-controller@fe330000 {
		compatible = "rockchip,px30-nfc";
		reg = <0x00 0xfe330000 0x00 0x4000>;
		interrupts = <0x00 0x46 0x04>;
		clocks = <0x24 0x74 0x24 0x75>;
		clock-names = "ahb", "nfc";
		assigned-clocks = <0x24 0x75>;
		assigned-clock-rates = <0x8f0d180>;
		status = "disabled";
		#address-cells = <0x01>;
		#size-cells = <0x00>;

		nand@0 {
			reg = <0x00>;
			label = "rk-nand";
			nand-bus-width = <0x08>;
			nand-ecc-mode = "hw";
			nand-ecc-step-size = <0x400>;
			nand-ecc-strength = <0x10>;
			nand-is-boot-medium;
			rockchip,boot-blks = <0x08>;
			rockchip,boot-ecc-strength = <0x10>;
		};
	};

	nandc@fe330000 {
		compatible = "rockchip,rk-nandc-v9";
		reg = <0x00 0xfe330000 0x00 0x4000>;
		interrupts = <0x00 0x46 0x04>;
		nandc_id = <0x00>;
		clocks = <0x24 0x75 0x24 0x74>;
		clock-names = "clk_nandc", "hclk_nandc";
		status = "okay";
		#address-cells = <0x01>;
		#size-cells = <0x00>;

		nand@0 {
			reg = <0x00>;
			nand-bus-width = <0x08>;
			nand-ecc-mode = "hw";
			nand-ecc-strength = <0x10>;
			nand-ecc-step-size = <0x400>;
		};
	};

	crypto@fe380000 {
		compatible = "rockchip,rk3568-crypto";
		reg = <0x00 0xfe380000 0x00 0x4000>;
		interrupts = <0x00 0x04 0x04>;
		clocks = <0x24 0x6a 0x24 0x6b 0x24 0x6c 0x24 0x6d>;
		clock-names = "aclk", "hclk", "sclk", "apb_pclk";
		assigned-clocks = <0x24 0x6c>;
		assigned-clock-rates = <0xbebc200>;
		resets = <0x24 0x69>;
		reset-names = "crypto-rst";
		status = "disabled";
	};

	rng@fe388000 {
		compatible = "rockchip,cryptov2-rng";
		reg = <0x00 0xfe388000 0x00 0x2000>;
		clocks = <0x24 0x70 0x24 0x6f>;
		clock-names = "clk_trng", "hclk_trng";
		resets = <0x24 0x6d>;
		reset-names = "reset";
		status = "okay";
	};

	otp@fe38c000 {
		compatible = "rockchip,rk3568-otp";
		reg = <0x00 0xfe38c000 0x00 0x4000>;
		#address-cells = <0x01>;
		#size-cells = <0x01>;
		clocks = <0x24 0x73 0x24 0x72 0x24 0x71 0x24 0x181>;
		clock-names = "usr", "sbpi", "apb", "phy";
		resets = <0x24 0x1cf>;
		reset-names = "otp_phy";

		cpu-code@2 {
			reg = <0x02 0x02>;
			phandle = <0x0e>;
		};

		specification-serial-number@7 {
			reg = <0x07 0x01>;
			bits = <0x00 0x05>;
			phandle = <0x0a>;
		};

		cpu-version@8 {
			reg = <0x08 0x01>;
			bits = <0x03 0x03>;
			phandle = <0x0d>;
		};

		mbist-vmin@9 {
			reg = <0x09 0x01>;
			bits = <0x00 0x04>;
			phandle = <0x08>;
		};

		id@a {
			reg = <0x0a 0x10>;
			phandle = <0x0c>;
		};

		cpu-leakage@1a {
			reg = <0x1a 0x01>;
			phandle = <0x06>;
		};

		log-leakage@1b {
			reg = <0x1b 0x01>;
			phandle = <0x7d>;
		};

		npu-leakage@1c {
			reg = <0x1c 0x01>;
			phandle = <0x6c>;
		};

		gpu-leakage@1d {
			reg = <0x1d 0x01>;
			phandle = <0x1a>;
		};

		core-pvtm@2a {
			reg = <0x2a 0x02>;
			phandle = <0x07>;
		};

		cpu-tsadc-trim-l@2e {
			reg = <0x2e 0x01>;
			phandle = <0x10a>;
		};

		cpu-tsadc-trim-h@2f {
			reg = <0x2f 0x01>;
			bits = <0x00 0x04>;
			phandle = <0x10b>;
		};

		npu-tsadc-trim-l@30 {
			reg = <0x30 0x01>;
			phandle = <0x10c>;
		};

		npu-tsadc-trim-h@31 {
			reg = <0x31 0x01>;
			bits = <0x00 0x04>;
			phandle = <0x10d>;
		};

		tsadc-trim-base-frac@31 {
			reg = <0x31 0x01>;
			bits = <0x04 0x04>;
			phandle = <0x107>;
		};

		tsadc-trim-base@32 {
			reg = <0x32 0x01>;
			phandle = <0x106>;
		};

		cpu-opp-info@36 {
			reg = <0x36 0x06>;
			phandle = <0x09>;
		};

		gpu-opp-info@3c {
			reg = <0x3c 0x06>;
			phandle = <0x1b>;
		};

		npu-opp-info@42 {
			reg = <0x42 0x06>;
			phandle = <0x6d>;
		};

		dmc-opp-info@48 {
			reg = <0x48 0x06>;
			phandle = <0xb3>;
		};

		remark-spec-serial-number@56 {
			reg = <0x56 0x01>;
			bits = <0x00 0x05>;
			phandle = <0x0b>;
		};
	};

	i2s@fe400000 {
		compatible = "rockchip,rk3568-i2s-tdm";
		reg = <0x00 0xfe400000 0x00 0x1000>;
		interrupts = <0x00 0x34 0x04>;
		clocks = <0x24 0x3f 0x24 0x43 0x24 0x39>;
		clock-names = "mclk_tx", "mclk_rx", "hclk";
		dmas = <0xbc 0x00>;
		dma-names = "tx";
		resets = <0x24 0x50 0x24 0x51>;
		reset-names = "tx-m", "rx-m";
		rockchip,cru = <0x24>;
		rockchip,grf = <0x3a>;
		rockchip,playback-only;
		#sound-dai-cells = <0x00>;
		sound-name-prefix = "I2S0";
		status = "okay";
		phandle = <0x1d>;
	};

	i2s@fe410000 {
		compatible = "rockchip,rk3568-i2s-tdm";
		reg = <0x00 0xfe410000 0x00 0x1000>;
		interrupts = <0x00 0x35 0x04>;
		clocks = <0x24 0x47 0x24 0x4b 0x24 0x3a>;
		clock-names = "mclk_tx", "mclk_rx", "hclk";
		dmas = <0xbc 0x02 0xbc 0x03>;
		dma-names = "tx", "rx";
		resets = <0x24 0x52 0x24 0x53>;
		reset-names = "tx-m", "rx-m";
		rockchip,cru = <0x24>;
		rockchip,grf = <0x3a>;
		i2s-lrck-gpio = <0xbd 0x05 0x00>;
		pinctrl-names = "default";
		pinctrl-0 = <0xbe 0xbf 0xc0 0xc1>;
		#sound-dai-cells = <0x00>;
		sound-name-prefix = "I2S1";
		status = "okay";
		rockchip,clk-trcm = <0x01>;
		phandle = <0xd1>;
	};

	i2s@fe420000 {
		compatible = "rockchip,rk3568-i2s-tdm";
		reg = <0x00 0xfe420000 0x00 0x1000>;
		interrupts = <0x00 0x36 0x04>;
		clocks = <0x24 0x4f 0x24 0x4f 0x24 0x3b>;
		clock-names = "mclk_tx", "mclk_rx", "hclk";
		dmas = <0xbc 0x04 0xbc 0x05>;
		dma-names = "tx", "rx";
		rockchip,cru = <0x24>;
		rockchip,grf = <0x3a>;
		rockchip,trcm-sync-tx-only;
		i2s-lrck-gpio = <0xc2 0x13 0x00>;
		pinctrl-names = "default";
		pinctrl-0 = <0xc3 0xc4 0xc5 0xc6>;
		#sound-dai-cells = <0x00>;
		sound-name-prefix = "I2S2";
		status = "disabled";
	};

	i2s@fe430000 {
		compatible = "rockchip,rk3568-i2s-tdm";
		reg = <0x00 0xfe430000 0x00 0x1000>;
		interrupts = <0x00 0x37 0x04>;
		clocks = <0x24 0x53 0x24 0x57 0x24 0x3c>;
		clock-names = "mclk_tx", "mclk_rx", "hclk";
		dmas = <0xbc 0x06 0xbc 0x07>;
		dma-names = "tx", "rx";
		resets = <0x24 0x55 0x24 0x56>;
		reset-names = "tx-m", "rx-m";
		rockchip,cru = <0x24>;
		rockchip,grf = <0x3a>;
		rockchip,trcm-sync-tx-only;
		i2s-lrck-gpio = <0x8d 0x04 0x00>;
		#sound-dai-cells = <0x00>;
		pinctrl-names = "default";
		pinctrl-0 = <0xc7 0xc8 0xc9 0xca>;
		sound-name-prefix = "I2S3";
		status = "disabled";
		phandle = <0x136>;
	};

	pdm@fe440000 {
		compatible = "rockchip,rk3568-pdm";
		reg = <0x00 0xfe440000 0x00 0x1000>;
		interrupts = <0x00 0x4c 0x04>;
		clocks = <0x24 0x5a 0x24 0x59>;
		clock-names = "pdm_clk", "pdm_hclk";
		dmas = <0xbc 0x09>;
		dma-names = "rx";
		pinctrl-0 = <0xcb 0xcc 0xcd 0xce 0xcf 0xd0>;
		pinctrl-names = "default";
		resets = <0x24 0x58>;
		reset-names = "pdm-m";
		#sound-dai-cells = <0x00>;
		sound-name-prefix = "PDM";
		status = "disabled";
		phandle = <0x138>;
	};

	vad@fe450000 {
		compatible = "rockchip,rk3568-vad";
		reg = <0x00 0xfe450000 0x00 0x10000>;
		reg-names = "vad";
		clocks = <0x24 0x5b>;
		clock-names = "hclk";
		interrupts = <0x00 0x89 0x04>;
		rockchip,audio-src = <0xd1>;
		rockchip,det-channel = <0x00>;
		rockchip,mode = <0x00>;
		#sound-dai-cells = <0x00>;
		status = "disabled";
		rockchip,buffer-time-ms = <0x80>;
		phandle = <0x13c>;
	};

	spdif@fe460000 {
		compatible = "rockchip,rk3568-spdif";
		reg = <0x00 0xfe460000 0x00 0x1000>;
		interrupts = <0x00 0x66 0x04>;
		clock-names = "mclk", "hclk";
		clocks = <0x24 0x5f 0x24 0x5c>;
		dmas = <0xbc 0x01>;
		dma-names = "tx";
		pinctrl-names = "default";
		pinctrl-0 = <0xd2>;
		#sound-dai-cells = <0x00>;
		status = "disabled";
	};

	audpwm@fe470000 {
		compatible = "rockchip,rk3568-audio-pwm", "rockchip,audio-pwm-v1";
		reg = <0x00 0xfe470000 0x00 0x1000>;
		clocks = <0x24 0x63 0x24 0x60>;
		clock-names = "clk", "hclk";
		dmas = <0xbc 0x08>;
		dma-names = "tx";
		#sound-dai-cells = <0x00>;
		rockchip,sample-width-bits = <0x0b>;
		rockchip,interpolat-points = <0x01>;
		status = "disabled";
	};

	codec-digital@fe478000 {
		compatible = "rockchip,rk3568-codec-digital", "rockchip,codec-digital-v1";
		reg = <0x00 0xfe478000 0x00 0x1000>;
		clocks = <0x24 0x67 0x24 0x66 0x24 0x65 0x24 0x64>;
		clock-names = "adc", "dac", "i2c", "pclk";
		pinctrl-names = "default";
		pinctrl-0 = <0xd3>;
		resets = <0x24 0x5f>;
		reset-names = "reset";
		rockchip,grf = <0x3a>;
		#sound-dai-cells = <0x00>;
		status = "disabled";
		phandle = <0x137>;
	};

	dma-controller@fe530000 {
		compatible = "arm,pl330", "arm,primecell";
		reg = <0x00 0xfe530000 0x00 0x4000>;
		interrupts = <0x00 0x0e 0x04 0x00 0x0d 0x04>;
		arm,pl330-periph-burst;
		clocks = <0x24 0x10d>;
		clock-names = "apb_pclk";
		#dma-cells = <0x01>;
		phandle = <0x48>;
	};

	dma-controller@fe550000 {
		compatible = "arm,pl330", "arm,primecell";
		reg = <0x00 0xfe550000 0x00 0x4000>;
		interrupts = <0x00 0x10 0x04 0x00 0x0f 0x04>;
		arm,pl330-periph-burst;
		clocks = <0x24 0x10d>;
		clock-names = "apb_pclk";
		#dma-cells = <0x01>;
		phandle = <0xbc>;
	};

	rkscr@fe560000 {
		compatible = "rockchip-scr";
		reg = <0x00 0xfe560000 0x00 0x10000>;
		interrupts = <0x00 0x61 0x04>;
		pinctrl-names = "default";
		pinctrl-0 = <0xd4>;
		clocks = <0x24 0x114>;
		clock-names = "g_pclk_sim_card";
		status = "disabled";
	};

	can@fe570000 {
		compatible = "rockchip,rk3568-can-2.0";
		reg = <0x00 0xfe570000 0x00 0x1000>;
		interrupts = <0x00 0x01 0x04>;
		clocks = <0x24 0x141 0x24 0x140>;
		clock-names = "baudclk", "apb_pclk";
		resets = <0x24 0x155 0x24 0x154>;
		reset-names = "can", "can-apb";
		tx-fifo-depth = <0x01>;
		rx-fifo-depth = <0x06>;
		status = "disabled";
		assigned-clocks = <0x24 0x141>;
		assigned-clock-rates = <0x8f0d180>;
		pinctrl-names = "default";
		pinctrl-0 = <0xd5>;
	};

	can@fe580000 {
		compatible = "rockchip,rk3568-can-2.0";
		reg = <0x00 0xfe580000 0x00 0x1000>;
		interrupts = <0x00 0x02 0x04>;
		clocks = <0x24 0x143 0x24 0x142>;
		clock-names = "baudclk", "apb_pclk";
		resets = <0x24 0x157 0x24 0x156>;
		reset-names = "can", "can-apb";
		tx-fifo-depth = <0x01>;
		rx-fifo-depth = <0x06>;
		status = "disabled";
		assigned-clocks = <0x24 0x143>;
		assigned-clock-rates = <0x8f0d180>;
		pinctrl-names = "default";
		pinctrl-0 = <0xd6>;
	};

	can@fe590000 {
		compatible = "rockchip,rk3568-can-2.0";
		reg = <0x00 0xfe590000 0x00 0x1000>;
		interrupts = <0x00 0x03 0x04>;
		clocks = <0x24 0x145 0x24 0x144>;
		clock-names = "baudclk", "apb_pclk";
		resets = <0x24 0x159 0x24 0x158>;
		reset-names = "can", "can-apb";
		tx-fifo-depth = <0x01>;
		rx-fifo-depth = <0x06>;
		status = "disabled";
		assigned-clocks = <0x24 0x145>;
		assigned-clock-rates = <0x8f0d180>;
		pinctrl-names = "default";
		pinctrl-0 = <0xd7>;
	};

	i2c@fe5a0000 {
		compatible = "rockchip,rk3568-i2c", "rockchip,rk3399-i2c";
		reg = <0x00 0xfe5a0000 0x00 0x1000>;
		interrupts = <0x00 0x2f 0x04>;
		clocks = <0x24 0x148 0x24 0x147>;
		clock-names = "i2c", "pclk";
		pinctrl-0 = <0xd8>;
		pinctrl-names = "default";
		#address-cells = <0x01>;
		#size-cells = <0x00>;
		status = "disabled";
	};

	i2c@fe5b0000 {
		compatible = "rockchip,rk3568-i2c", "rockchip,rk3399-i2c";
		reg = <0x00 0xfe5b0000 0x00 0x1000>;
		interrupts = <0x00 0x30 0x04>;
		clocks = <0x24 0x14a 0x24 0x149>;
		clock-names = "i2c", "pclk";
		pinctrl-0 = <0xd9>;
		pinctrl-names = "default";
		#address-cells = <0x01>;
		#size-cells = <0x00>;
		status = "okay";
	};

	i2c@fe5c0000 {
		compatible = "rockchip,rk3568-i2c", "rockchip,rk3399-i2c";
		reg = <0x00 0xfe5c0000 0x00 0x1000>;
		interrupts = <0x00 0x31 0x04>;
		clocks = <0x24 0x14c 0x24 0x14b>;
		clock-names = "i2c", "pclk";
		pinctrl-0 = <0xda>;
		pinctrl-names = "default";
		#address-cells = <0x01>;
		#size-cells = <0x00>;
		status = "okay";
	};

	i2c@fe5d0000 {
		compatible = "rockchip,rk3568-i2c", "rockchip,rk3399-i2c";
		reg = <0x00 0xfe5d0000 0x00 0x1000>;
		interrupts = <0x00 0x32 0x04>;
		clocks = <0x24 0x14e 0x24 0x14d>;
		clock-names = "i2c", "pclk";
		pinctrl-0 = <0xdb>;
		pinctrl-names = "default";
		#address-cells = <0x01>;
		#size-cells = <0x00>;
		status = "okay";

		gc5035@37 {
			compatible = "galaxycore,gc5035";
			status = "okay";
			reg = <0x37>;
			clocks = <0x24 0xd6>;
			clock-names = "xvclk";
			power-domains = <0x26 0x08>;
			pinctrl-names = "default";
			pinctrl-0 = <0xdc>;
			reset-gpios = <0x3e 0x0f 0x00>;
			pwdn-gpios = <0xbd 0x19 0x00>;
			rockchip,camera-module-index = <0x00>;
			rockchip,camera-module-facing = "front";
			rockchip,camera-module-name = "default";
			rockchip,camera-module-lens-name = "PC5322-M5";

			port {

				endpoint {
					remote-endpoint = <0xdd>;
					data-lanes = <0x01 0x02>;
					phandle = <0x113>;
				};
			};
		};
	};

	i2c@fe5e0000 {
		compatible = "rockchip,rk3568-i2c", "rockchip,rk3399-i2c";
		reg = <0x00 0xfe5e0000 0x00 0x1000>;
		interrupts = <0x00 0x33 0x04>;
		clocks = <0x24 0x150 0x24 0x14f>;
		clock-names = "i2c", "pclk";
		pinctrl-0 = <0xde>;
		pinctrl-names = "default";
		#address-cells = <0x01>;
		#size-cells = <0x00>;
		status = "okay";

		hym8563@51 {
			compatible = "haoyu,hym8563";
			reg = <0x51>;
			#clock-cells = <0x00>;
			clock-frequency = <0x8000>;
			clock-output-names = "hym8563";
			rtc-irq-gpio = <0x3e 0x1b 0x02>;
		};
	};

	timer@fe5f0000 {
		compatible = "rockchip,rk3568-timer", "rockchip,rk3288-timer";
		reg = <0x00 0xfe5f0000 0x00 0x1000>;
		interrupts = <0x00 0x6d 0x04>;
		clocks = <0x24 0x16c 0x24 0x16d>;
		clock-names = "pclk", "timer";
	};

	watchdog@fe600000 {
		compatible = "rockchip,rk3568-wdt", "snps,dw-wdt";
		reg = <0x00 0xfe600000 0x00 0x100>;
		interrupts = <0x00 0x95 0x04>;
		clocks = <0x24 0x116 0x24 0x115>;
		clock-names = "tclk", "pclk";
	};

	spi@fe610000 {
		compatible = "rockchip,rk3568-spi", "rockchip,rk3066-spi";
		reg = <0x00 0xfe610000 0x00 0x1000>;
		interrupts = <0x00 0x67 0x04>;
		clocks = <0x24 0x152 0x24 0x151>;
		clock-names = "spiclk", "apb_pclk";
		dmas = <0x48 0x14 0x48 0x15>;
		dma-names = "tx", "rx";
		pinctrl-names = "default", "high_speed";
		pinctrl-0 = <0xdf 0xe0 0xe1>;
		pinctrl-1 = <0xdf 0xe0 0xe2>;
		#address-cells = <0x01>;
		#size-cells = <0x00>;
		num-cs = <0x02>;
		status = "disabled";
	};

	spi@fe620000 {
		compatible = "rockchip,rk3568-spi", "rockchip,rk3066-spi";
		reg = <0x00 0xfe620000 0x00 0x1000>;
		interrupts = <0x00 0x68 0x04>;
		clocks = <0x24 0x154 0x24 0x153>;
		clock-names = "spiclk", "apb_pclk";
		dmas = <0x48 0x16 0x48 0x17>;
		dma-names = "tx", "rx";
		pinctrl-names = "default", "high_speed";
		pinctrl-0 = <0xe3 0xe4 0xe5>;
		pinctrl-1 = <0xe3 0xe4 0xe6>;
		#address-cells = <0x01>;
		#size-cells = <0x00>;
		num-cs = <0x02>;
		status = "disabled";
	};

	spi@fe630000 {
		compatible = "rockchip,rk3568-spi", "rockchip,rk3066-spi";
		reg = <0x00 0xfe630000 0x00 0x1000>;
		interrupts = <0x00 0x69 0x04>;
		clocks = <0x24 0x156 0x24 0x155>;
		clock-names = "spiclk", "apb_pclk";
		dmas = <0x48 0x18 0x48 0x19>;
		dma-names = "tx", "rx";
		pinctrl-names = "default", "high_speed";
		pinctrl-0 = <0xe7 0xe8 0xe9>;
		pinctrl-1 = <0xe7 0xe8 0xea>;
		#address-cells = <0x01>;
		#size-cells = <0x00>;
		num-cs = <0x02>;
		status = "disabled";
	};

	spi@fe640000 {
		compatible = "rockchip,rk3568-spi", "rockchip,rk3066-spi";
		reg = <0x00 0xfe640000 0x00 0x1000>;
		interrupts = <0x00 0x6a 0x04>;
		clocks = <0x24 0x158 0x24 0x157>;
		clock-names = "spiclk", "apb_pclk";
		dmas = <0x48 0x1a 0x48 0x1b>;
		dma-names = "tx", "rx";
		pinctrl-names = "default", "high_speed";
		pinctrl-0 = <0xeb>;
		pinctrl-1 = <0xec>;
		#address-cells = <0x01>;
		#size-cells = <0x00>;
		num-cs = <0x02>;
		status = "okay";
	};

	serial@fe650000 {
		compatible = "rockchip,rk3568-uart", "snps,dw-apb-uart";
		reg = <0x00 0xfe650000 0x00 0x100>;
		interrupts = <0x00 0x75 0x04>;
		clocks = <0x24 0x11f 0x24 0x11c>;
		clock-names = "baudclk", "apb_pclk";
		dmas = <0x48 0x02 0x48 0x03>;
		pinctrl-0 = <0xed>;
		pinctrl-names = "default";
		reg-io-width = <0x04>;
		reg-shift = <0x02>;
		status = "disabled";
	};

	serial@fe660000 {
		compatible = "rockchip,rk3568-uart", "snps,dw-apb-uart";
		reg = <0x00 0xfe660000 0x00 0x100>;
		interrupts = <0x00 0x76 0x04>;
		clocks = <0x24 0x123 0x24 0x120>;
		clock-names = "baudclk", "apb_pclk";
		dmas = <0x48 0x04 0x48 0x05>;
		pinctrl-0 = <0xee>;
		pinctrl-names = "default";
		reg-io-width = <0x04>;
		reg-shift = <0x02>;
		status = "disabled";
	};

	serial@fe670000 {
		compatible = "rockchip,rk3568-uart", "snps,dw-apb-uart";
		reg = <0x00 0xfe670000 0x00 0x100>;
		interrupts = <0x00 0x77 0x04>;
		clocks = <0x24 0x127 0x24 0x124>;
		clock-names = "baudclk", "apb_pclk";
		dmas = <0x48 0x06 0x48 0x07>;
		pinctrl-0 = <0xef>;
		pinctrl-names = "default";
		reg-io-width = <0x04>;
		reg-shift = <0x02>;
		status = "okay";
	};

	serial@fe680000 {
		compatible = "rockchip,rk3568-uart", "snps,dw-apb-uart";
		reg = <0x00 0xfe680000 0x00 0x100>;
		interrupts = <0x00 0x78 0x04>;
		clocks = <0x24 0x12b 0x24 0x128>;
		clock-names = "baudclk", "apb_pclk";
		dmas = <0x48 0x08 0x48 0x09>;
		pinctrl-0 = <0xf0>;
		pinctrl-names = "default";
		reg-io-width = <0x04>;
		reg-shift = <0x02>;
		status = "okay";
	};

	serial@fe690000 {
		compatible = "rockchip,rk3568-uart", "snps,dw-apb-uart";
		reg = <0x00 0xfe690000 0x00 0x100>;
		interrupts = <0x00 0x79 0x04>;
		clocks = <0x24 0x12f 0x24 0x12c>;
		clock-names = "baudclk", "apb_pclk";
		dmas = <0x48 0x0a 0x48 0x0b>;
		pinctrl-0 = <0xf1>;
		pinctrl-names = "default";
		reg-io-width = <0x04>;
		reg-shift = <0x02>;
		status = "disabled";
	};

	serial@fe6a0000 {
		compatible = "rockchip,rk3568-uart", "snps,dw-apb-uart";
		reg = <0x00 0xfe6a0000 0x00 0x100>;
		interrupts = <0x00 0x7a 0x04>;
		clocks = <0x24 0x133 0x24 0x130>;
		clock-names = "baudclk", "apb_pclk";
		dmas = <0x48 0x0c 0x48 0x0d>;
		pinctrl-0 = <0xf2>;
		pinctrl-names = "default";
		reg-io-width = <0x04>;
		reg-shift = <0x02>;
		status = "disabled";
	};

	serial@fe6b0000 {
		compatible = "rockchip,rk3568-uart", "snps,dw-apb-uart";
		reg = <0x00 0xfe6b0000 0x00 0x100>;
		interrupts = <0x00 0x7b 0x04>;
		clocks = <0x24 0x137 0x24 0x134>;
		clock-names = "baudclk", "apb_pclk";
		dmas = <0x48 0x0e 0x48 0x0f>;
		pinctrl-0 = <0xf3>;
		pinctrl-names = "default";
		reg-io-width = <0x04>;
		reg-shift = <0x02>;
		status = "okay";
	};

	serial@fe6c0000 {
		compatible = "rockchip,rk3568-uart", "snps,dw-apb-uart";
		reg = <0x00 0xfe6c0000 0x00 0x100>;
		interrupts = <0x00 0x7c 0x04>;
		clocks = <0x24 0x13b 0x24 0x138>;
		clock-names = "baudclk", "apb_pclk";
		dmas = <0x48 0x10 0x48 0x11>;
		pinctrl-0 = <0xf4 0xf5>;
		pinctrl-names = "default";
		reg-io-width = <0x04>;
		reg-shift = <0x02>;
		status = "okay";
	};

	serial@fe6d0000 {
		compatible = "rockchip,rk3568-uart", "snps,dw-apb-uart";
		reg = <0x00 0xfe6d0000 0x00 0x100>;
		interrupts = <0x00 0x7d 0x04>;
		clocks = <0x24 0x13f 0x24 0x13c>;
		clock-names = "baudclk", "apb_pclk";
		dmas = <0x48 0x12 0x48 0x13>;
		pinctrl-0 = <0xf6>;
		pinctrl-names = "default";
		reg-io-width = <0x04>;
		reg-shift = <0x02>;
		status = "disabled";
	};

	pwm@fe6e0000 {
		compatible = "rockchip,rk3568-pwm", "rockchip,rk3328-pwm";
		reg = <0x00 0xfe6e0000 0x00 0x10>;
		interrupts = <0x00 0x53 0x04>;
		clocks = <0x24 0x15a 0x24 0x159>;
		clock-names = "pwm", "pclk";
		pinctrl-0 = <0xf7>;
		pinctrl-names = "active";
		#pwm-cells = <0x03>;
		status = "disabled";
	};

	pwm@fe6e0010 {
		compatible = "rockchip,rk3568-pwm", "rockchip,rk3328-pwm";
		reg = <0x00 0xfe6e0010 0x00 0x10>;
		interrupts = <0x00 0x53 0x04>;
		clocks = <0x24 0x15a 0x24 0x159>;
		clock-names = "pwm", "pclk";
		pinctrl-0 = <0xf8>;
		pinctrl-names = "active";
		#pwm-cells = <0x03>;
		status = "disabled";
	};

	pwm@fe6e0020 {
		compatible = "rockchip,rk3568-pwm", "rockchip,rk3328-pwm";
		reg = <0x00 0xfe6e0020 0x00 0x10>;
		interrupts = <0x00 0x53 0x04>;
		clocks = <0x24 0x15a 0x24 0x159>;
		clock-names = "pwm", "pclk";
		pinctrl-0 = <0xf9>;
		pinctrl-names = "active";
		#pwm-cells = <0x03>;
		status = "disabled";
	};

	pwm@fe6e0030 {
		compatible = "rockchip,remotectl-pwm";
		reg = <0x00 0xfe6e0030 0x00 0x10>;
		interrupts = <0x00 0x53 0x04 0x00 0x57 0x04>;
		clocks = <0x24 0x15a 0x24 0x159>;
		clock-names = "pwm", "pclk";
		pinctrl-0 = <0xfa>;
		pinctrl-names = "default";
		#pwm-cells = <0x03>;
		status = "okay";
		remote_pwm_id = <0x03>;
		handle_cpu_id = <0x01>;
		remote_support_psci = <0x00>;

		ir_key1 {
			rockchip,usercode = <0x4040>;
			rockchip,key_table = <0xf2 0xe8 0xbd 0x9e 0xf4 0x67 0xf1 0x6c 0xef 0x69 0xee 0x6a 0xe5 0x66 0xe7 0x73 0xe8 0x72 0xb2 0x74 0xbc 0x71 0xba 0x8b 0xfe 0x02 0xfd 0x03 0xfc 0x04 0xfb 0x05 0xfa 0x06 0xf9 0x07 0xf8 0x08 0xf7 0x09 0xf6 0x0a 0xff 0x0b 0xb8 0x184 0xa4 0x2c1 0xa8 0x2c2 0xab 0x2c3 0xe0 0xa5 0xac 0xa4 0xe1 0xa3 0xf3 0x0e 0xbb 0x34 0x54 0x8d>;
		};

		ir_key2 {
			rockchip,usercode = <0xfe01>;
			rockchip,key_table = <0xec 0xe8 0xe6 0x9e 0xe9 0x67 0xe5 0x6c 0xae 0x69 0xaf 0x6a 0xe7 0x73 0xee 0x66 0xb3 0x8b 0xbf 0x74 0xbe 0x71 0xef 0x72 0xff 0x184 0xb1 0x02 0xf2 0x03 0xf3 0x04 0xb5 0x05 0xf6 0x06 0xf7 0x07 0xb9 0x08 0xfa 0x09 0xfb 0x0a 0xfe 0x0b 0xbd 0x0e 0xbc 0x8d 0xf0 0x2c3>;
		};

		ir_key3 {
			rockchip,usercode = <0xdf00>;
			rockchip,key_table = <0xf9 0xe8 0xf5 0x9e 0xe5 0x67 0xb7 0x6c 0xb8 0x69 0xf8 0x6a 0xb4 0x73 0xb0 0x72 0xe3 0x74 0xe7 0x8b 0xfc 0x66 0xab 0x02 0xe9 0x03 0xea 0x04 0xaf 0x05 0xed 0x06 0xee 0x07 0xb3 0x08 0xf1 0x09 0xf2 0x0a 0xf3 0x0b 0xfe 0x3c 0xa0 0x3d 0xa4 0x3e 0xbe 0x8d 0xf7 0x58 0xef 0x0e 0xbd 0x184>;
		};

		ir_key4 {
			rockchip,usercode = <0xff>;
			rockchip,key_table = <0xf8 0xe8 0xa3 0x9e 0xfc 0x67 0xfd 0x6c 0xf1 0x69 0xe5 0x6a 0xf4 0x73 0xa7 0x72 0xeb 0x74 0xec 0x8b 0xb7 0x66 0xef 0x3c 0xf2 0x3d 0x7d 0x8d>;
		};

		ir_key5 {
			rockchip,usercode = <0xf708>;
			rockchip,key_table = <0x9a 0xe8 0x9c 0x9e 0x9d 0x67 0x97 0x6c 0x9b 0x69 0x99 0x6a 0x7e 0x73 0x7d 0x72 0x7f 0x74 0x98 0x8b 0x9f 0x66 0x9f 0x66 0x86 0x71 0x87 0x42 0x8d 0x184 0x0a 0x3f 0xba 0x40>;
		};

		ir_key6 {
			rockchip,usercode = <0x1608>;
			rockchip,key_table = <0xb0 0x66 0x74 0x9e 0x75 0x8b 0x4d 0x1c 0x7b 0x67 0x72 0x6c 0x44 0x69 0x71 0x6a 0x4a 0x72 0x76 0x73 0xa4 0x71 0x78 0x74 0x23 0x3e 0x0a 0x3f 0xba 0x40 0x99 0x41>;
		};

		ir_key7 {
			rockchip,usercode = <0x7f80>;
			rockchip,key_table = <0xf2 0xe8 0xe4 0x9e 0xd9 0x67 0xd7 0x6c 0xda 0x69 0xd8 0x6a 0xac 0x66 0xb1 0x73 0xa9 0x72 0xae 0x74 0xb2 0x71 0xb6 0x8b 0xad 0x184 0xce 0x02 0xcd 0x03 0xcc 0x04 0xcb 0x05 0xca 0x06 0xc9 0x07 0xc8 0x08 0xc7 0x09 0xc6 0x0a 0xcf 0x0b 0x42 0xa3 0x44 0xa5 0xbb 0x0e 0xa7 0x34 0xee 0x188 0xab 0x96 0xf6 0x189 0xb0 0x244>;
		};

		ir_key8 {
			rockchip,usercode = <0x4040>;
			rockchip,key_table = <0xf2 0xe8 0xbd 0x9e 0xf4 0x67 0xf1 0x6c 0xef 0x69 0xee 0x6a 0xe5 0x66 0xe7 0x73 0xe8 0x72 0xb2 0x74 0xbc 0x71 0xba 0x8b 0xfe 0x02 0xfd 0x03 0xfc 0x04 0xfb 0x05 0xfa 0x06 0xf9 0x07 0xf8 0x08 0xf7 0x09 0xf6 0x0a 0xff 0x0b 0xb8 0x184 0xa4 0x2c1 0xa8 0x2c2 0xab 0x2c3 0xe0 0xa5 0xac 0xa4 0xe1 0xa3 0xf3 0x0e 0xbb 0x34 0x54 0x8d>;
		};

		ir_key9 {
			rockchip,usercode = <0x1dcc>;
			rockchip,key_table = <0xee 0xe8 0xf0 0x9e 0xf8 0x67 0xbb 0x6c 0xef 0x69 0xed 0x6a 0xfc 0x66 0xf1 0x73 0xfd 0x72 0xb7 0xd9 0xff 0x74 0xf3 0x71 0xbf 0x8b 0xf9 0x191 0xf5 0x192 0xb3 0x184 0xbe 0x02 0xba 0x03 0xb2 0x04 0xbd 0x05 0xf9 0x06 0xb1 0x07 0xfc 0x08 0xf8 0x09 0xb0 0x0a 0xb6 0x0b 0xb5 0x0e>;
		};
	};

	pwm@fe6f0000 {
		compatible = "rockchip,rk3568-pwm", "rockchip,rk3328-pwm";
		reg = <0x00 0xfe6f0000 0x00 0x10>;
		interrupts = <0x00 0x54 0x04>;
		clocks = <0x24 0x15d 0x24 0x15c>;
		clock-names = "pwm", "pclk";
		pinctrl-0 = <0xfb>;
		pinctrl-names = "active";
		#pwm-cells = <0x03>;
		status = "disabled";
	};

	pwm@fe6f0010 {
		compatible = "rockchip,rk3568-pwm", "rockchip,rk3328-pwm";
		reg = <0x00 0xfe6f0010 0x00 0x10>;
		clocks = <0x24 0x15d 0x24 0x15c>;
		clock-names = "pwm", "pclk";
		pinctrl-0 = <0xfc>;
		pinctrl-names = "active";
		#pwm-cells = <0x03>;
		status = "disabled";
	};

	pwm@fe6f0020 {
		compatible = "rockchip,rk3568-pwm", "rockchip,rk3328-pwm";
		reg = <0x00 0xfe6f0020 0x00 0x10>;
		interrupts = <0x00 0x54 0x04>;
		clocks = <0x24 0x15d 0x24 0x15c>;
		clock-names = "pwm", "pclk";
		pinctrl-0 = <0xfd>;
		pinctrl-names = "active";
		#pwm-cells = <0x03>;
		status = "disabled";
	};

	pwm@fe6f0030 {
		compatible = "rockchip,rk3568-pwm", "rockchip,rk3328-pwm";
		reg = <0x00 0xfe6f0030 0x00 0x10>;
		interrupts = <0x00 0x54 0x04 0x00 0x58 0x04>;
		clocks = <0x24 0x15d 0x24 0x15c>;
		clock-names = "pwm", "pclk";
		pinctrl-0 = <0xfe>;
		pinctrl-names = "active";
		#pwm-cells = <0x03>;
		status = "disabled";
	};

	pwm@fe700000 {
		compatible = "rockchip,rk3568-pwm", "rockchip,rk3328-pwm";
		reg = <0x00 0xfe700000 0x00 0x10>;
		interrupts = <0x00 0x55 0x04>;
		clocks = <0x24 0x160 0x24 0x15f>;
		clock-names = "pwm", "pclk";
		pinctrl-0 = <0xff>;
		pinctrl-names = "active";
		#pwm-cells = <0x03>;
		status = "disabled";
	};

	pwm@fe700010 {
		compatible = "rockchip,rk3568-pwm", "rockchip,rk3328-pwm";
		reg = <0x00 0xfe700010 0x00 0x10>;
		interrupts = <0x00 0x55 0x04>;
		clocks = <0x24 0x160 0x24 0x15f>;
		clock-names = "pwm", "pclk";
		pinctrl-0 = <0x100>;
		pinctrl-names = "active";
		#pwm-cells = <0x03>;
		status = "disabled";
	};

	pwm@fe700020 {
		compatible = "rockchip,rk3568-pwm", "rockchip,rk3328-pwm";
		reg = <0x00 0xfe700020 0x00 0x10>;
		interrupts = <0x00 0x55 0x04>;
		clocks = <0x24 0x160 0x24 0x15f>;
		clock-names = "pwm", "pclk";
		pinctrl-0 = <0x101>;
		pinctrl-names = "active";
		#pwm-cells = <0x03>;
		status = "disabled";
	};

	pwm@fe700030 {
		compatible = "rockchip,rk3568-pwm", "rockchip,rk3328-pwm";
		reg = <0x00 0xfe700030 0x00 0x10>;
		interrupts = <0x00 0x55 0x04 0x00 0x59 0x04>;
		clocks = <0x24 0x160 0x24 0x15f>;
		clock-names = "pwm", "pclk";
		pinctrl-0 = <0x102>;
		pinctrl-names = "active";
		#pwm-cells = <0x03>;
		status = "disabled";
	};

	thermal-zones {

		soc-thermal {
			polling-delay-passive = <0x14>;
			polling-delay = <0x3e8>;
			sustainable-power = <0x389>;
			thermal-sensors = <0x103 0x00>;

			trips {

				trip-point-0 {
					temperature = <0x124f8>;
					hysteresis = <0x7d0>;
					type = "passive";
				};

				trip-point-1 {
					temperature = <0x14c08>;
					hysteresis = <0x7d0>;
					type = "passive";
					phandle = <0x104>;
				};

				soc-crit {
					temperature = <0x1c138>;
					hysteresis = <0x7d0>;
					type = "critical";
				};
			};

			cooling-maps {

				map0 {
					trip = <0x104>;
					cooling-device = <0x1f 0xffffffff 0xffffffff>;
					contribution = <0x400>;
				};

				map1 {
					trip = <0x104>;
					cooling-device = <0x105 0xffffffff 0xffffffff>;
					contribution = <0x400>;
				};
			};
		};

		gpu-thermal {
			polling-delay-passive = <0x14>;
			polling-delay = <0x3e8>;
			thermal-sensors = <0x103 0x01>;

			trips {

				gpu-crit {
					temperature = <0x1c138>;
					hysteresis = <0x7d0>;
					type = "critical";
				};
			};
		};
	};

	tsadc@fe710000 {
		compatible = "rockchip,rk3568-tsadc";
		reg = <0x00 0xfe710000 0x00 0x100>;
		interrupts = <0x00 0x73 0x04>;
		assigned-clocks = <0x24 0x110 0x24 0x111>;
		assigned-clock-rates = <0x1036640 0xaae60>;
		clocks = <0x24 0x111 0x24 0x10f>;
		clock-names = "tsadc", "apb_pclk";
		resets = <0x24 0x182 0x24 0x181 0x24 0x1d7>;
		reset-names = "tsadc", "tsadc-apb", "tsadc-phy";
		rockchip,grf = <0x3a>;
		nvmem-cells = <0x106 0x107>;
		nvmem-cell-names = "trim_base", "trim_base_frac";
		rockchip,hw-tshut-temp = <0x1d4c0>;
		rockchip,hw-tshut-mode = <0x00>;
		rockchip,hw-tshut-polarity = <0x00>;
		pinctrl-names = "gpio", "otpout";
		pinctrl-0 = <0x108>;
		pinctrl-1 = <0x109>;
		#address-cells = <0x01>;
		#size-cells = <0x00>;
		#thermal-sensor-cells = <0x01>;
		status = "okay";
		phandle = <0x103>;

		tsadc@0 {
			reg = <0x00>;
			nvmem-cells = <0x10a 0x10b>;
			nvmem-cell-names = "trim_l", "trim_h";
		};

		tsadc@1 {
			reg = <0x01>;
			nvmem-cells = <0x10c 0x10d>;
			nvmem-cell-names = "trim_l", "trim_h";
		};
	};

	saradc@fe720000 {
		compatible = "rockchip,rk3568-saradc", "rockchip,rk3399-saradc";
		reg = <0x00 0xfe720000 0x00 0x100>;
		interrupts = <0x00 0x5d 0x04>;
		clocks = <0x24 0x113 0x24 0x112>;
		clock-names = "saradc", "apb_pclk";
		resets = <0x24 0x180>;
		reset-names = "saradc-apb";
		#io-channel-cells = <0x01>;
		status = "okay";
		vref-supply = <0x10e>;
		phandle = <0x134>;
	};

	mailbox@fe780000 {
		compatible = "rockchip,rk3568-mailbox", "rockchip,rk3368-mailbox";
		reg = <0x00 0xfe780000 0x00 0x1000>;
		interrupts = <0x00 0xb7 0x04 0x00 0xb8 0x04 0x00 0xb9 0x04 0x00 0xba 0x04>;
		clocks = <0x24 0x11b>;
		clock-names = "pclk_mailbox";
		#mbox-cells = <0x01>;
		status = "disabled";
	};

	phy@fe830000 {
		compatible = "rockchip,rk3568-naneng-combphy";
		reg = <0x00 0xfe830000 0x00 0x100>;
		clocks = <0x39 0x22 0x24 0x17d 0x24 0x7f>;
		clock-names = "refclk", "apbclk", "pipe_clk";
		assigned-clocks = <0x39 0x22>;
		assigned-clock-rates = <0x5f5e100>;
		resets = <0x24 0x1c6 0x24 0x1c7>;
		reset-names = "combphy-apb", "combphy";
		rockchip,pipe-grf = <0x10f>;
		rockchip,pipe-phy-grf = <0x110>;
		#phy-cells = <0x01>;
		status = "okay";
		phandle = <0x25>;
	};

	phy@fe840000 {
		compatible = "rockchip,rk3568-naneng-combphy";
		reg = <0x00 0xfe840000 0x00 0x100>;
		clocks = <0x39 0x25 0x24 0x17e 0x24 0x7f>;
		clock-names = "refclk", "apbclk", "pipe_clk";
		assigned-clocks = <0x39 0x25>;
		assigned-clock-rates = <0x5f5e100>;
		resets = <0x24 0x1c8 0x24 0x1c9>;
		reset-names = "combphy-apb", "combphy";
		rockchip,pipe-grf = <0x10f>;
		rockchip,pipe-phy-grf = <0x111>;
		#phy-cells = <0x01>;
		status = "okay";
		phandle = <0x27>;
	};

	phy@fe850000 {
		compatible = "rockchip,rk3568-dsi-dphy", "rockchip,rk3568-video-phy";
		reg = <0x00 0xfe850000 0x00 0x10000 0x00 0xfe060000 0x00 0x10000>;
		reg-names = "phy", "host";
		clocks = <0x39 0x17 0x24 0x17a 0x24 0xe8>;
		clock-names = "ref", "pclk", "pclk_host";
		#clock-cells = <0x00>;
		resets = <0x24 0x1bb>;
		reset-names = "apb";
		power-domains = <0x26 0x09>;
		#phy-cells = <0x00>;
		status = "disabled";
		phandle = <0x33>;
	};

	phy@fe860000 {
		compatible = "rockchip,rk3568-dsi-dphy", "rockchip,rk3568-video-phy";
		reg = <0x00 0xfe860000 0x00 0x10000 0x00 0xfe070000 0x00 0x10000>;
		reg-names = "phy", "host";
		clocks = <0x39 0x19 0x24 0x17b 0x24 0xe9>;
		clock-names = "ref", "pclk", "pclk_host";
		#clock-cells = <0x00>;
		resets = <0x24 0x1bc>;
		reset-names = "apb";
		power-domains = <0x26 0x09>;
		#phy-cells = <0x00>;
		status = "disabled";
		phandle = <0x36>;
	};

	mipi-dphy@fe850000 {
		compatible = "rockchip,rk3568-dsi-dphy";
		reg = <0x00 0xfe850000 0x00 0x10000>;
		clock-names = "ref", "pclk";
		clocks = <0x39 0x17 0x24 0x17a>;
		#phy-cells = <0x00>;
		power-domains = <0x26 0x09>;
		reset-names = "apb";
		resets = <0x24 0x1bb>;
		status = "disabled";
	};

	mipi-dphy@fe860000 {
		compatible = "rockchip,rk3568-dsi-dphy";
		reg = <0x00 0xfe860000 0x00 0x10000>;
		clock-names = "ref", "pclk";
		clocks = <0x39 0x19 0x24 0x17b>;
		#phy-cells = <0x00>;
		power-domains = <0x26 0x09>;
		reset-names = "apb";
		resets = <0x24 0x1bc>;
		status = "disabled";
	};

	csi2-dphy-hw@fe870000 {
		compatible = "rockchip,rk3568-csi2-dphy-hw";
		reg = <0x00 0xfe870000 0x00 0x1000>;
		clocks = <0x24 0x179>;
		clock-names = "pclk";
		rockchip,grf = <0x3a>;
		status = "okay";
		phandle = <0x112>;
	};

	csi2-dphy0 {
		compatible = "rockchip,rk3568-csi2-dphy";
		rockchip,hw = <0x112>;
		status = "okay";

		ports {
			#address-cells = <0x01>;
			#size-cells = <0x00>;

			port@0 {
				reg = <0x00>;
				#address-cells = <0x01>;
				#size-cells = <0x00>;

				endpoint@1 {
					reg = <0x01>;
					remote-endpoint = <0x113>;
					data-lanes = <0x01 0x02>;
					phandle = <0xdd>;
				};
			};

			port@1 {
				reg = <0x01>;
				#address-cells = <0x01>;
				#size-cells = <0x00>;

				endpoint@0 {
					reg = <0x00>;
					remote-endpoint = <0x114>;
					phandle = <0x84>;
				};
			};
		};
	};

	csi2-dphy1 {
		compatible = "rockchip,rk3568-csi2-dphy";
		rockchip,hw = <0x112>;
		status = "disabled";
	};

	csi2-dphy2 {
		compatible = "rockchip,rk3568-csi2-dphy";
		rockchip,hw = <0x112>;
		status = "disabled";
	};

	usb2-phy@fe8a0000 {
		compatible = "rockchip,rk3568-usb2phy";
		reg = <0x00 0xfe8a0000 0x00 0x10000>;
		clocks = <0x39 0x13>;
		clock-names = "phyclk";
		clock-output-names = "usb480m_phy";
		interrupts = <0x00 0x87 0x04>;
		rockchip,usbgrf = <0x115>;
		#clock-cells = <0x00>;
		assigned-clocks = <0x24 0x0b>;
		assigned-clock-parents = <0x29>;
		status = "okay";
		phandle = <0x29>;

		host-port {
			#phy-cells = <0x00>;
			status = "okay";
			phy-supply = <0x116>;
			phandle = <0x2a>;
		};

		otg-port {
			#phy-cells = <0x00>;
			status = "okay";
			vbus-supply = <0x117>;
			phandle = <0x28>;
		};
	};

	usb2-phy@fe8b0000 {
		compatible = "rockchip,rk3568-usb2phy";
		reg = <0x00 0xfe8b0000 0x00 0x10000>;
		clocks = <0x39 0x15>;
		clock-names = "phyclk";
		interrupts = <0x00 0x88 0x04>;
		rockchip,usbgrf = <0x118>;
		#clock-cells = <0x00>;
		status = "okay";
		phandle = <0x2b>;

		host-port {
			#phy-cells = <0x00>;
			status = "okay";
			phy-supply = <0x116>;
			phandle = <0x2d>;
		};

		otg-port {
			#phy-cells = <0x00>;
			status = "okay";
			phy-supply = <0x116>;
			phandle = <0x2c>;
		};
	};

	pinctrl {
		compatible = "rockchip,rk3568-pinctrl";
		rockchip,grf = <0x3a>;
		rockchip,pmu = <0x3b>;
		#address-cells = <0x02>;
		#size-cells = <0x02>;
		ranges;

		gpio@fdd60000 {
			compatible = "rockchip,gpio-bank";
			reg = <0x00 0xfdd60000 0x00 0x100>;
			interrupts = <0x00 0x21 0x04>;
			clocks = <0x39 0x2e 0x39 0x0c>;
			gpio-controller;
			#gpio-cells = <0x02>;
			interrupt-controller;
			#interrupt-cells = <0x02>;
			phandle = <0x3e>;
		};

		gpio@fe740000 {
			compatible = "rockchip,gpio-bank";
			reg = <0x00 0xfe740000 0x00 0x100>;
			interrupts = <0x00 0x22 0x04>;
			clocks = <0x24 0x163 0x24 0x164>;
			gpio-controller;
			#gpio-cells = <0x02>;
			interrupt-controller;
			#interrupt-cells = <0x02>;
			phandle = <0xbd>;
		};

		gpio@fe750000 {
			compatible = "rockchip,gpio-bank";
			reg = <0x00 0xfe750000 0x00 0x100>;
			interrupts = <0x00 0x23 0x04>;
			clocks = <0x24 0x165 0x24 0x166>;
			gpio-controller;
			#gpio-cells = <0x02>;
			interrupt-controller;
			#interrupt-cells = <0x02>;
			phandle = <0xc2>;
		};

		gpio@fe760000 {
			compatible = "rockchip,gpio-bank";
			reg = <0x00 0xfe760000 0x00 0x100>;
			interrupts = <0x00 0x24 0x04>;
			clocks = <0x24 0x167 0x24 0x168>;
			gpio-controller;
			#gpio-cells = <0x02>;
			interrupt-controller;
			#interrupt-cells = <0x02>;
			phandle = <0x8d>;
		};

		gpio@fe770000 {
			compatible = "rockchip,gpio-bank";
			reg = <0x00 0xfe770000 0x00 0x100>;
			interrupts = <0x00 0x25 0x04>;
			clocks = <0x24 0x169 0x24 0x16a>;
			gpio-controller;
			#gpio-cells = <0x02>;
			interrupt-controller;
			#interrupt-cells = <0x02>;
			phandle = <0x46>;
		};

		pcfg-pull-up {
			bias-pull-up;
			phandle = <0x11b>;
		};

		pcfg-pull-down {
			bias-pull-down;
			phandle = <0x122>;
		};

		pcfg-pull-none {
			bias-disable;
			phandle = <0x119>;
		};

		pcfg-pull-none-drv-level-1 {
			bias-disable;
			drive-strength = <0x01>;
			phandle = <0x11d>;
		};

		pcfg-pull-none-drv-level-2 {
			bias-disable;
			drive-strength = <0x02>;
			phandle = <0x11c>;
		};

		pcfg-pull-none-drv-level-3 {
			bias-disable;
			drive-strength = <0x03>;
			phandle = <0x121>;
		};

		pcfg-pull-up-drv-level-1 {
			bias-pull-up;
			drive-strength = <0x01>;
			phandle = <0x120>;
		};

		pcfg-pull-up-drv-level-2 {
			bias-pull-up;
			drive-strength = <0x02>;
			phandle = <0x11a>;
		};

		pcfg-pull-none-smt {
			bias-disable;
			input-schmitt-enable;
			phandle = <0x11e>;
		};

		pcfg-output-low {
			output-low;
			phandle = <0x11f>;
		};

		acodec {

			acodec-pins {
				rockchip,pins = <0x01 0x09 0x05 0x119 0x01 0x01 0x05 0x119 0x01 0x00 0x05 0x119 0x01 0x07 0x05 0x119 0x01 0x08 0x05 0x119 0x01 0x03 0x05 0x119 0x01 0x05 0x05 0x119>;
				phandle = <0xd3>;
			};
		};

		audiopwm {
		};

		bt656 {
		};

		bt1120 {
		};

		cam {

			camera-pwr {
				rockchip,pins = <0x01 0x1b 0x00 0x119>;
			};
		};

		can0 {

			can0m1-pins {
				rockchip,pins = <0x02 0x02 0x04 0x119 0x02 0x01 0x04 0x119>;
				phandle = <0xd5>;
			};
		};

		can1 {

			can1m1-pins {
				rockchip,pins = <0x04 0x12 0x03 0x119 0x04 0x13 0x03 0x119>;
				phandle = <0xd6>;
			};
		};

		can2 {

			can2m1-pins {
				rockchip,pins = <0x02 0x09 0x04 0x119 0x02 0x0a 0x04 0x119>;
				phandle = <0xd7>;
			};
		};

		cif {

			cif-clk {
				rockchip,pins = <0x04 0x10 0x01 0x119>;
				phandle = <0xdc>;
			};
		};

		clk32k {

			clk32k-out0 {
				rockchip,pins = <0x00 0x08 0x02 0x119>;
				phandle = <0x23>;
			};
		};

		cpu {
		};

		ebc {

			ebc-pins {
				rockchip,pins = <0x04 0x10 0x02 0x119 0x04 0x0b 0x02 0x119 0x04 0x0c 0x02 0x119 0x04 0x06 0x02 0x119 0x04 0x11 0x02 0x119 0x03 0x16 0x02 0x119 0x03 0x17 0x02 0x119 0x03 0x18 0x02 0x119 0x03 0x19 0x02 0x119 0x03 0x1a 0x02 0x119 0x03 0x1b 0x02 0x119 0x03 0x1c 0x02 0x119 0x03 0x1d 0x02 0x119 0x03 0x1e 0x02 0x119 0x03 0x1f 0x02 0x119 0x04 0x00 0x02 0x119 0x04 0x01 0x02 0x119 0x04 0x02 0x02 0x119 0x04 0x03 0x02 0x119 0x04 0x04 0x02 0x119 0x04 0x05 0x02 0x119 0x04 0x0e 0x02 0x119 0x04 0x0f 0x02 0x119>;
				phandle = <0x74>;
			};
		};

		edpdp {
		};

		emmc {
		};

		eth0 {
		};

		eth1 {
		};

		flash {
		};

		fspi {
		};

		gmac0 {

			gmac0-miim {
				rockchip,pins = <0x02 0x13 0x02 0x119 0x02 0x14 0x02 0x119>;
				phandle = <0x12c>;
			};

			gmac0-rx-bus2 {
				rockchip,pins = <0x02 0x0e 0x01 0x119 0x02 0x0f 0x02 0x119 0x02 0x10 0x02 0x119>;
				phandle = <0x12e>;
			};

			gmac0-tx-bus2 {
				rockchip,pins = <0x02 0x0b 0x01 0x11c 0x02 0x0c 0x01 0x11c 0x02 0x0d 0x01 0x119>;
				phandle = <0x12d>;
			};

			gmac0-rgmii-clk {
				rockchip,pins = <0x02 0x05 0x02 0x119 0x02 0x08 0x02 0x11d>;
				phandle = <0x12f>;
			};

			gmac0-rgmii-bus {
				rockchip,pins = <0x02 0x03 0x02 0x119 0x02 0x04 0x02 0x119 0x02 0x06 0x02 0x11c 0x02 0x07 0x02 0x11c>;
				phandle = <0x130>;
			};
		};

		gmac1 {

			gmac1m1-miim {
				rockchip,pins = <0x04 0x0e 0x03 0x119 0x04 0x0f 0x03 0x119>;
				phandle = <0x8e>;
			};

			gmac1m1-rx-bus2 {
				rockchip,pins = <0x04 0x07 0x03 0x119 0x04 0x08 0x03 0x119 0x04 0x09 0x03 0x119>;
				phandle = <0x90>;
			};

			gmac1m1-tx-bus2 {
				rockchip,pins = <0x04 0x04 0x03 0x11c 0x04 0x05 0x03 0x11c 0x04 0x06 0x03 0x119>;
				phandle = <0x8f>;
			};

			gmac1m1-rgmii-clk {
				rockchip,pins = <0x04 0x03 0x03 0x119 0x04 0x00 0x03 0x11d>;
				phandle = <0x91>;
			};

			gmac1m1-rgmii-bus {
				rockchip,pins = <0x04 0x01 0x03 0x119 0x04 0x02 0x03 0x119 0x03 0x1e 0x03 0x11c 0x03 0x1f 0x03 0x11c>;
				phandle = <0x92>;
			};
		};

		gpu {
		};

		hdmitx {

			hdmitxm0-cec {
				rockchip,pins = <0x04 0x19 0x01 0x119>;
				phandle = <0xa7>;
			};

			hdmitx-scl {
				rockchip,pins = <0x04 0x17 0x01 0x119>;
				phandle = <0xa5>;
			};

			hdmitx-sda {
				rockchip,pins = <0x04 0x18 0x01 0x119>;
				phandle = <0xa6>;
			};
		};

		i2c0 {

			i2c0-xfer {
				rockchip,pins = <0x00 0x09 0x01 0x11e 0x00 0x0a 0x01 0x11e>;
				phandle = <0x3c>;
			};
		};

		i2c1 {

			i2c1-xfer {
				rockchip,pins = <0x00 0x0b 0x01 0x11e 0x00 0x0c 0x01 0x11e>;
				phandle = <0xd8>;
			};
		};

		i2c2 {

			i2c2m1-xfer {
				rockchip,pins = <0x04 0x0d 0x01 0x11e 0x04 0x0c 0x01 0x11e>;
				phandle = <0xd9>;
			};
		};

		i2c3 {

			i2c3m0-xfer {
				rockchip,pins = <0x01 0x01 0x01 0x11e 0x01 0x00 0x01 0x11e>;
				phandle = <0xda>;
			};
		};

		i2c4 {

			i2c4m0-xfer {
				rockchip,pins = <0x04 0x0b 0x01 0x11e 0x04 0x0a 0x01 0x11e>;
				phandle = <0xdb>;
			};
		};

		i2c5 {

			i2c5m0-xfer {
				rockchip,pins = <0x03 0x0b 0x04 0x11e 0x03 0x0c 0x04 0x11e>;
				phandle = <0xde>;
			};
		};

		i2s1 {

			i2s1m0-lrcktx {
				rockchip,pins = <0x01 0x05 0x01 0x11e>;
				phandle = <0xbf>;
			};

			i2s1m0-mclk {
				rockchip,pins = <0x01 0x02 0x01 0x11e>;
				phandle = <0x47>;
			};

			i2s1m0-sclktx {
				rockchip,pins = <0x01 0x03 0x01 0x11e>;
				phandle = <0xbe>;
			};

			i2s1m0-sdi0 {
				rockchip,pins = <0x01 0x0b 0x01 0x119>;
				phandle = <0xc0>;
			};

			i2s1m0-sdo0 {
				rockchip,pins = <0x01 0x07 0x01 0x119>;
				phandle = <0xc1>;
			};
		};

		i2s2 {

			i2s2m0-lrcktx {
				rockchip,pins = <0x02 0x13 0x01 0x11e>;
				phandle = <0xc4>;
			};

			i2s2m0-sclktx {
				rockchip,pins = <0x02 0x12 0x01 0x11e>;
				phandle = <0xc3>;
			};

			i2s2m0-sdi {
				rockchip,pins = <0x02 0x15 0x01 0x119>;
				phandle = <0xc5>;
			};

			i2s2m0-sdo {
				rockchip,pins = <0x02 0x14 0x01 0x119>;
				phandle = <0xc6>;
			};
		};

		i2s3 {

			i2s3m0-lrck {
				rockchip,pins = <0x03 0x04 0x04 0x11e>;
				phandle = <0xc8>;
			};

			i2s3m0-sclk {
				rockchip,pins = <0x03 0x03 0x04 0x11e>;
				phandle = <0xc7>;
			};

			i2s3m0-sdi {
				rockchip,pins = <0x03 0x06 0x04 0x119>;
				phandle = <0xc9>;
			};

			i2s3m0-sdo {
				rockchip,pins = <0x03 0x05 0x04 0x119>;
				phandle = <0xca>;
			};
		};

		isp {
		};

		jtag {
		};

		lcdc {

			lcdc-ctl {
				rockchip,pins = <0x03 0x00 0x01 0x119 0x02 0x18 0x01 0x119 0x02 0x19 0x01 0x119 0x02 0x1a 0x01 0x119 0x02 0x1b 0x01 0x119 0x02 0x1c 0x01 0x119 0x02 0x1d 0x01 0x119 0x02 0x1e 0x01 0x119 0x02 0x1f 0x01 0x119 0x03 0x01 0x01 0x119 0x03 0x02 0x01 0x119 0x03 0x03 0x01 0x119 0x03 0x04 0x01 0x119 0x03 0x05 0x01 0x119 0x03 0x06 0x01 0x119 0x03 0x07 0x01 0x119 0x03 0x08 0x01 0x119 0x03 0x09 0x01 0x119 0x03 0x0a 0x01 0x119 0x03 0x0b 0x01 0x119 0x03 0x0c 0x01 0x119 0x03 0x0d 0x01 0x119 0x03 0x0e 0x01 0x119 0x03 0x0f 0x01 0x119 0x03 0x10 0x01 0x119 0x03 0x13 0x01 0x119 0x03 0x11 0x01 0x119 0x03 0x12 0x01 0x119>;
				phandle = <0x35>;
			};
		};

		mcu {
		};

		npu {
		};

		pcie20 {
		};

		pcie30x1 {
		};

		pcie30x2 {
		};

		pdm {

			pdmm0-clk {
				rockchip,pins = <0x01 0x06 0x03 0x119>;
				phandle = <0xcb>;
			};

			pdmm0-clk1 {
				rockchip,pins = <0x01 0x04 0x03 0x119>;
				phandle = <0xcc>;
			};

			pdmm0-sdi0 {
				rockchip,pins = <0x01 0x0b 0x02 0x119>;
				phandle = <0xcd>;
			};

			pdmm0-sdi1 {
				rockchip,pins = <0x01 0x0a 0x03 0x119>;
				phandle = <0xce>;
			};

			pdmm0-sdi2 {
				rockchip,pins = <0x01 0x09 0x03 0x119>;
				phandle = <0xcf>;
			};

			pdmm0-sdi3 {
				rockchip,pins = <0x01 0x08 0x03 0x119>;
				phandle = <0xd0>;
			};
		};

		pmic {

			pmic_int {
				rockchip,pins = <0x00 0x03 0x00 0x11b>;
				phandle = <0x3f>;
			};

			soc_slppin_gpio {
				rockchip,pins = <0x00 0x02 0x00 0x11f>;
				phandle = <0x42>;
			};

			soc_slppin_slp {
				rockchip,pins = <0x00 0x02 0x01 0x119>;
				phandle = <0x40>;
			};

			soc_slppin_rst {
				rockchip,pins = <0x00 0x02 0x02 0x119>;
			};
		};

		pmu {
		};

		pwm0 {

			pwm0m0-pins {
				rockchip,pins = <0x00 0x0f 0x01 0x119>;
				phandle = <0x4a>;
			};
		};

		pwm1 {

			pwm1m0-pins {
				rockchip,pins = <0x00 0x10 0x01 0x119>;
				phandle = <0x4b>;
			};
		};

		pwm2 {

			pwm2m0-pins {
				rockchip,pins = <0x00 0x11 0x01 0x119>;
				phandle = <0x4c>;
			};
		};

		pwm3 {

			pwm3-pins {
				rockchip,pins = <0x00 0x12 0x01 0x119>;
				phandle = <0x4d>;
			};
		};

		pwm4 {

			pwm4-pins {
				rockchip,pins = <0x00 0x13 0x01 0x119>;
				phandle = <0xf7>;
			};
		};

		pwm5 {

			pwm5-pins {
				rockchip,pins = <0x00 0x14 0x01 0x119>;
				phandle = <0xf8>;
			};
		};

		pwm6 {

			pwm6-pins {
				rockchip,pins = <0x00 0x15 0x01 0x119>;
				phandle = <0xf9>;
			};
		};

		pwm7 {

			pwm7-pins {
				rockchip,pins = <0x00 0x16 0x01 0x119>;
				phandle = <0xfa>;
			};
		};

		pwm8 {

			pwm8m0-pins {
				rockchip,pins = <0x03 0x09 0x05 0x119>;
				phandle = <0xfb>;
			};
		};

		pwm9 {

			pwm9m0-pins {
				rockchip,pins = <0x03 0x0a 0x05 0x119>;
				phandle = <0xfc>;
			};
		};

		pwm10 {

			pwm10m0-pins {
				rockchip,pins = <0x03 0x0d 0x05 0x119>;
				phandle = <0xfd>;
			};
		};

		pwm11 {

			pwm11m0-pins {
				rockchip,pins = <0x03 0x0e 0x05 0x119>;
				phandle = <0xfe>;
			};
		};

		pwm12 {

			pwm12m0-pins {
				rockchip,pins = <0x03 0x0f 0x02 0x119>;
				phandle = <0xff>;
			};
		};

		pwm13 {

			pwm13m0-pins {
				rockchip,pins = <0x03 0x10 0x02 0x119>;
				phandle = <0x100>;
			};
		};

		pwm14 {

			pwm14m0-pins {
				rockchip,pins = <0x03 0x14 0x01 0x119>;
				phandle = <0x101>;
			};
		};

		pwm15 {

			pwm15m0-pins {
				rockchip,pins = <0x03 0x15 0x01 0x119>;
				phandle = <0x102>;
			};
		};

		refclk {
		};

		sata {
		};

		sata0 {
		};

		sata1 {
		};

		sata2 {
		};

		scr {

			scr-pins {
				rockchip,pins = <0x01 0x02 0x03 0x119 0x01 0x07 0x03 0x11b 0x01 0x03 0x03 0x11b 0x01 0x05 0x03 0x119>;
				phandle = <0xd4>;
			};
		};

		sdmmc0 {

			sdmmc0-bus4 {
				rockchip,pins = <0x01 0x1d 0x01 0x11a 0x01 0x1e 0x01 0x11a 0x01 0x1f 0x01 0x11a 0x02 0x00 0x01 0x11a>;
				phandle = <0xb8>;
			};

			sdmmc0-clk {
				rockchip,pins = <0x02 0x02 0x01 0x11a>;
				phandle = <0xb9>;
			};

			sdmmc0-cmd {
				rockchip,pins = <0x02 0x01 0x01 0x11a>;
				phandle = <0xba>;
			};

			sdmmc0-det {
				rockchip,pins = <0x00 0x04 0x01 0x11b>;
				phandle = <0xbb>;
			};
		};

		sdmmc1 {
		};

		sdmmc2 {

			sdmmc2m0-bus4 {
				rockchip,pins = <0x03 0x16 0x03 0x11a 0x03 0x17 0x03 0x11a 0x03 0x18 0x03 0x11a 0x03 0x19 0x03 0x11a>;
				phandle = <0x86>;
			};

			sdmmc2m0-clk {
				rockchip,pins = <0x03 0x1b 0x03 0x11a>;
				phandle = <0x88>;
			};

			sdmmc2m0-cmd {
				rockchip,pins = <0x03 0x1a 0x03 0x11a>;
				phandle = <0x87>;
			};
		};

		spdif {

			spdifm0-tx {
				rockchip,pins = <0x01 0x04 0x04 0x119>;
				phandle = <0xd2>;
			};
		};

		spi0 {

			spi0m0-pins {
				rockchip,pins = <0x00 0x0d 0x02 0x119 0x00 0x15 0x02 0x119 0x00 0x0e 0x02 0x119>;
				phandle = <0xe1>;
			};

			spi0m0-cs0 {
				rockchip,pins = <0x00 0x16 0x02 0x119>;
				phandle = <0xdf>;
			};

			spi0m0-cs1 {
				rockchip,pins = <0x00 0x14 0x02 0x119>;
				phandle = <0xe0>;
			};
		};

		spi1 {

			spi1m0-pins {
				rockchip,pins = <0x02 0x0d 0x03 0x119 0x02 0x0e 0x03 0x119 0x02 0x0f 0x04 0x119>;
				phandle = <0xe5>;
			};

			spi1m0-cs0 {
				rockchip,pins = <0x02 0x10 0x04 0x119>;
				phandle = <0xe3>;
			};

			spi1m0-cs1 {
				rockchip,pins = <0x02 0x16 0x03 0x119>;
				phandle = <0xe4>;
			};
		};

		spi2 {

			spi2m0-pins {
				rockchip,pins = <0x02 0x11 0x04 0x119 0x02 0x12 0x04 0x119 0x02 0x13 0x04 0x119>;
				phandle = <0xe9>;
			};

			spi2m0-cs0 {
				rockchip,pins = <0x02 0x14 0x04 0x119>;
				phandle = <0xe7>;
			};

			spi2m0-cs1 {
				rockchip,pins = <0x02 0x15 0x04 0x119>;
				phandle = <0xe8>;
			};
		};

		spi3 {

			spi3m1-pins {
				rockchip,pins = <0x04 0x12 0x02 0x119 0x04 0x15 0x02 0x119 0x04 0x13 0x02 0x119>;
				phandle = <0xeb>;
			};
		};

		tsadc {

			tsadc-shutorg {
				rockchip,pins = <0x00 0x01 0x02 0x119>;
				phandle = <0x109>;
			};
		};

		uart0 {

			uart0-xfer {
				rockchip,pins = <0x00 0x10 0x03 0x11b 0x00 0x11 0x03 0x11b>;
				phandle = <0x49>;
			};
		};

		uart1 {

			uart1m0-xfer {
				rockchip,pins = <0x02 0x0b 0x02 0x11b 0x02 0x0c 0x02 0x11b>;
				phandle = <0xed>;
			};
		};

		uart2 {

			uart2m0-xfer {
				rockchip,pins = <0x00 0x18 0x01 0x11b 0x00 0x19 0x01 0x11b>;
				phandle = <0xee>;
			};
		};

		uart3 {

			uart3m1-xfer {
				rockchip,pins = <0x03 0x10 0x04 0x11b 0x03 0x0f 0x04 0x11b>;
				phandle = <0xef>;
			};
		};

		uart4 {

			uart4m1-xfer {
				rockchip,pins = <0x03 0x09 0x04 0x11b 0x03 0x0a 0x04 0x11b>;
				phandle = <0xf0>;
			};
		};

		uart5 {

			uart5m0-xfer {
				rockchip,pins = <0x02 0x01 0x03 0x11b 0x02 0x02 0x03 0x11b>;
				phandle = <0xf1>;
			};
		};

		uart6 {

			uart6m0-xfer {
				rockchip,pins = <0x02 0x03 0x03 0x11b 0x02 0x04 0x03 0x11b>;
				phandle = <0xf2>;
			};
		};

		uart7 {

			uart7m1-xfer {
				rockchip,pins = <0x03 0x15 0x04 0x11b 0x03 0x14 0x04 0x11b>;
				phandle = <0xf3>;
			};
		};

		uart8 {

			uart8m0-xfer {
				rockchip,pins = <0x02 0x16 0x02 0x11b 0x02 0x15 0x03 0x11b>;
				phandle = <0xf4>;
			};

			uart8m0-ctsn {
				rockchip,pins = <0x02 0x0a 0x03 0x119>;
				phandle = <0xf5>;
			};

			uart8m0-rtsn {
				rockchip,pins = <0x02 0x09 0x03 0x119>;
				phandle = <0x141>;
			};
		};

		uart9 {

			uart9m0-xfer {
				rockchip,pins = <0x02 0x07 0x03 0x11b 0x02 0x08 0x03 0x11b>;
				phandle = <0xf6>;
			};
		};

		vop {
		};

		spi0-hs {

			spi0m0-pins {
				rockchip,pins = <0x00 0x0d 0x02 0x120 0x00 0x15 0x02 0x120 0x00 0x0e 0x02 0x120>;
				phandle = <0xe2>;
			};
		};

		spi1-hs {

			spi1m0-pins {
				rockchip,pins = <0x02 0x0d 0x03 0x120 0x02 0x0e 0x03 0x120 0x02 0x0f 0x04 0x120>;
				phandle = <0xe6>;
			};
		};

		spi2-hs {

			spi2m0-pins {
				rockchip,pins = <0x02 0x11 0x04 0x120 0x02 0x12 0x04 0x120 0x02 0x13 0x04 0x120>;
				phandle = <0xea>;
			};
		};

		spi3-hs {

			spi3m1-pins {
				rockchip,pins = <0x04 0x12 0x02 0x120 0x04 0x15 0x02 0x120 0x04 0x13 0x02 0x120>;
				phandle = <0xec>;
			};
		};

		gmac-txd-level3 {
		};

		gmac-txc-level2 {
		};

		gpio-func {

			tsadc-gpio-func {
				rockchip,pins = <0x00 0x01 0x00 0x119>;
				phandle = <0x108>;
			};
		};

		wireless-bluetooth {

			uart8-gpios {
				rockchip,pins = <0x02 0x09 0x00 0x119>;
				phandle = <0x142>;
			};
		};

		sdio-pwrseq {

			wifi-enable-h {
				rockchip,pins = <0x03 0x1d 0x00 0x11b>;
				phandle = <0x13f>;
			};
		};

		wireless-wlan {

			wifi-host-wake-irq {
				rockchip,pins = <0x03 0x1c 0x00 0x122>;
				phandle = <0x140>;
			};
		};

		usb {

			vcc5v0-host-en {
				rockchip,pins = <0x00 0x06 0x00 0x119>;
				phandle = <0x144>;
			};

			vcc5v0-otg-en {
				rockchip,pins = <0x00 0x05 0x00 0x119>;
				phandle = <0x145>;
			};
		};

		pcie3 {

			pcie3-power-en {
				rockchip,pins = <0x00 0x1c 0x00 0x119>;
				phandle = <0x146>;
			};
		};

		minipcie {

			minipcie-power-en {
				rockchip,pins = <0x03 0x13 0x00 0x119>;
				phandle = <0x147>;
			};
		};

		headphone {

			hp-det {
				rockchip,pins = <0x01 0x1b 0x00 0x11b>;
				phandle = <0x13b>;
			};
		};
	};

	edac {
		compatible = "rockchip,rk3568-edac";
		interrupts = <0x00 0xad 0x04 0x00 0xaf 0x04>;
		interrupt-names = "ce", "ue";
		status = "disabled";
	};

	external-gmac0-clock {
		compatible = "fixed-clock";
		clock-frequency = <0x7735940>;
		clock-output-names = "gmac0_clkin";
		#clock-cells = <0x00>;
	};

	xpcs-gmac0-clock {
		compatible = "fixed-clock";
		clock-frequency = <0x7735940>;
		clock-output-names = "clk_gmac0_xpcs_mii";
		#clock-cells = <0x00>;
	};

	sata@fc000000 {
		compatible = "rockchip,rk3568-dwc-ahci", "snps,dwc-ahci";
		reg = <0x00 0xfc000000 0x00 0x1000>;
		clocks = <0x24 0x96 0x24 0x97 0x24 0x98>;
		clock-names = "sata", "pmalive", "rxoob";
		interrupts = <0x00 0x5e 0x04>;
		phys = <0x123 0x01>;
		phy-names = "sata-phy";
		ports-implemented = <0x01>;
		power-domains = <0x26 0x0f>;
		status = "okay";
	};

	syscon@fdc70000 {
		compatible = "rockchip,pipe-phy-grf", "syscon";
		reg = <0x00 0xfdc70000 0x00 0x1000>;
		phandle = <0x132>;
	};

	syscon@fdcb8000 {
		compatible = "rockchip,pcie30-phy-grf", "syscon";
		reg = <0x00 0xfdcb8000 0x00 0x10000>;
		phandle = <0x133>;
	};

	qos@fe190080 {
		compatible = "rockchip,rk3568-qos", "syscon";
		reg = <0x00 0xfe190080 0x00 0x20>;
		phandle = <0x62>;
	};

	qos@fe190100 {
		compatible = "rockchip,rk3568-qos", "syscon";
		reg = <0x00 0xfe190100 0x00 0x20>;
		phandle = <0x63>;
	};

	qos@fe190200 {
		compatible = "rockchip,rk3568-qos", "syscon";
		reg = <0x00 0xfe190200 0x00 0x20>;
		phandle = <0x64>;
	};

	pcie@fe270000 {
		compatible = "rockchip,rk3568-pcie", "snps,dw-pcie";
		#address-cells = <0x03>;
		#size-cells = <0x02>;
		bus-range = <0x10 0x1f>;
		clocks = <0x24 0x88 0x24 0x89 0x24 0x8a 0x24 0x8b 0x24 0x8c>;
		clock-names = "aclk_mst", "aclk_slv", "aclk_dbi", "pclk", "aux";
		device_type = "pci";
		interrupts = <0x00 0xa0 0x04 0x00 0x9f 0x04 0x00 0x9e 0x04 0x00 0x9d 0x04 0x00 0x9c 0x04>;
		interrupt-names = "sys", "pmc", "msg", "legacy", "err";
		#interrupt-cells = <0x01>;
		interrupt-map-mask = <0x00 0x00 0x00 0x07>;
		interrupt-map = <0x00 0x00 0x00 0x01 0x124 0x00 0x00 0x00 0x00 0x02 0x124 0x01 0x00 0x00 0x00 0x03 0x124 0x02 0x00 0x00 0x00 0x04 0x124 0x03>;
		linux,pci-domain = <0x01>;
		num-ib-windows = <0x06>;
		num-ob-windows = <0x02>;
		num-viewport = <0x08>;
		max-link-speed = <0x03>;
		msi-map = <0x1000 0xb5 0x1000 0x1000>;
		num-lanes = <0x01>;
		phys = <0x125>;
		phy-names = "pcie-phy";
		power-domains = <0x26 0x0f>;
		reg = <0x03 0xc0400000 0x00 0x400000 0x00 0xfe270000 0x00 0x10000 0x00 0xf2000000 0x00 0x100000>;
		reg-names = "pcie-dbi", "pcie-apb", "config";
		ranges = <0x1000000 0x00 0xf2100000 0x00 0xf2100000 0x00 0x100000 0x2000000 0x00 0xf2200000 0x00 0xf2200000 0x00 0x1e00000 0x3000000 0x03 0x40000000 0x03 0x40000000 0x00 0x40000000>;
		resets = <0x24 0xb1>;
		reset-names = "pipe";
		status = "disabled";

		legacy-interrupt-controller {
			interrupt-controller;
			#address-cells = <0x00>;
			#interrupt-cells = <0x01>;
			interrupt-parent = <0x01>;
			interrupts = <0x00 0x9d 0x01>;
			phandle = <0x124>;
		};
	};

	pcie@fe280000 {
		compatible = "rockchip,rk3568-pcie", "snps,dw-pcie";
		#address-cells = <0x03>;
		#size-cells = <0x02>;
		bus-range = <0x20 0x2f>;
		clocks = <0x24 0x8f 0x24 0x90 0x24 0x91 0x24 0x92 0x24 0x93>;
		clock-names = "aclk_mst", "aclk_slv", "aclk_dbi", "pclk", "aux";
		device_type = "pci";
		interrupts = <0x00 0xa5 0x04 0x00 0xa4 0x04 0x00 0xa3 0x04 0x00 0xa2 0x04 0x00 0xa1 0x04>;
		interrupt-names = "sys", "pmc", "msg", "legacy", "err";
		#interrupt-cells = <0x01>;
		interrupt-map-mask = <0x00 0x00 0x00 0x07>;
		interrupt-map = <0x00 0x00 0x00 0x01 0x126 0x00 0x00 0x00 0x00 0x02 0x126 0x01 0x00 0x00 0x00 0x03 0x126 0x02 0x00 0x00 0x00 0x04 0x126 0x03>;
		linux,pci-domain = <0x02>;
		num-ib-windows = <0x06>;
		num-viewport = <0x08>;
		num-ob-windows = <0x02>;
		max-link-speed = <0x03>;
		msi-map = <0x2000 0xb5 0x2000 0x1000>;
		num-lanes = <0x02>;
		phys = <0x125>;
		phy-names = "pcie-phy";
		power-domains = <0x26 0x0f>;
		reg = <0x03 0xc0800000 0x00 0x400000 0x00 0xfe280000 0x00 0x10000 0x00 0xf0000000 0x00 0x100000>;
		reg-names = "pcie-dbi", "pcie-apb", "config";
		ranges = <0x1000000 0x00 0xf0100000 0x00 0xf0100000 0x00 0x100000 0x2000000 0x00 0xf0200000 0x00 0xf0200000 0x00 0x1e00000 0x3000000 0x03 0x80000000 0x03 0x80000000 0x00 0x40000000>;
		resets = <0x24 0xc1>;
		reset-names = "pipe";
		status = "okay";
		reset-gpios = <0xc2 0x1e 0x00>;
		vpcie3v3-supply = <0x127>;

		legacy-interrupt-controller {
			interrupt-controller;
			#address-cells = <0x00>;
			#interrupt-cells = <0x01>;
			interrupt-parent = <0x01>;
			interrupts = <0x00 0xa2 0x01>;
			phandle = <0x126>;
		};
	};

	uio@fe2a0000 {
		compatible = "rockchip,uio-gmac";
		reg = <0x00 0xfe2a0000 0x00 0x10000>;
		rockchip,ethernet = <0x128>;
		status = "disabled";
	};

	ethernet@fe2a0000 {
		compatible = "rockchip,rk3568-gmac", "snps,dwmac-4.20a";
		reg = <0x00 0xfe2a0000 0x00 0x10000>;
		interrupts = <0x00 0x1b 0x04 0x00 0x18 0x04>;
		interrupt-names = "macirq", "eth_wake_irq";
		clocks = <0x24 0x182 0x24 0x185 0x24 0x185 0x24 0xb8 0x24 0xb4 0x24 0xb5 0x24 0x185 0x24 0xb9 0x24 0xac 0x24 0xab>;
		clock-names = "stmmaceth", "mac_clk_rx", "mac_clk_tx", "clk_mac_refout", "aclk_mac", "pclk_mac", "clk_mac_speed", "ptp_ref", "pclk_xpcs", "clk_xpcs_eee";
		resets = <0x24 0xd7>;
		reset-names = "stmmaceth";
		rockchip,grf = <0x3a>;
		snps,axi-config = <0x129>;
		snps,mixed-burst;
		snps,mtl-rx-config = <0x12a>;
		snps,mtl-tx-config = <0x12b>;
		snps,tso;
		status = "okay";
		phy-mode = "rgmii";
		clock_in_out = "output";
		snps,reset-gpio = <0xc2 0x1b 0x01>;
		snps,reset-active-low;
		snps,reset-delays-us = <0x00 0x4e20 0x186a0>;
		assigned-clocks = <0x24 0x185 0x24 0x182>;
		assigned-clock-parents = <0x24 0x183 0x24 0xb6>;
		assigned-clock-rates = <0x00 0x7735940>;
		pinctrl-names = "default";
		pinctrl-0 = <0x12c 0x12d 0x12e 0x12f 0x130>;
		tx_delay = <0x21>;
		rx_delay = <0x3c>;
		phy-handle = <0x131>;
		phandle = <0x128>;

		mdio {
			compatible = "snps,dwmac-mdio";
			#address-cells = <0x01>;
			#size-cells = <0x00>;

			phy@0 {
				compatible = "ethernet-phy-ieee802.3-c22";
				reg = <0x00>;
				phandle = <0x131>;
			};
		};

		stmmac-axi-config {
			snps,blen = <0x00 0x00 0x00 0x00 0x10 0x08 0x04>;
			snps,rd_osr_lmt = <0x08>;
			snps,wr_osr_lmt = <0x04>;
			phandle = <0x129>;
		};

		rx-queues-config {
			snps,rx-queues-to-use = <0x01>;
			phandle = <0x12a>;

			queue0 {
			};
		};

		tx-queues-config {
			snps,tx-queues-to-use = <0x01>;
			phandle = <0x12b>;

			queue0 {
			};
		};
	};

	phy@fe820000 {
		compatible = "rockchip,rk3568-naneng-combphy";
		reg = <0x00 0xfe820000 0x00 0x100>;
		clocks = <0x39 0x1f 0x24 0x17c 0x24 0x7f>;
		clock-names = "refclk", "apbclk", "pipe_clk";
		assigned-clocks = <0x39 0x1f>;
		assigned-clock-rates = <0x5f5e100>;
		resets = <0x24 0x1c4 0x24 0x1c5>;
		reset-names = "combphy-apb", "combphy";
		rockchip,pipe-grf = <0x10f>;
		rockchip,pipe-phy-grf = <0x132>;
		#phy-cells = <0x01>;
		status = "okay";
		phandle = <0x123>;
	};

	phy@fe8c0000 {
		compatible = "rockchip,rk3568-pcie3-phy";
		reg = <0x00 0xfe8c0000 0x00 0x20000>;
		#phy-cells = <0x00>;
		clocks = <0x39 0x26 0x39 0x27 0x24 0x177>;
		clock-names = "refclk_m", "refclk_n", "pclk";
		resets = <0x24 0x1be>;
		reset-names = "phy";
		rockchip,phy-grf = <0x133>;
		status = "okay";
		phandle = <0x125>;
	};

	adc-keys {
		compatible = "adc-keys";
		io-channels = <0x134 0x00>;
		io-channel-names = "buttons";
		keyup-threshold-microvolt = <0x1b7740>;
		poll-interval = <0x64>;

		vol-up-key {
			label = "volume up";
			linux,code = <0x73>;
			press-threshold-microvolt = <0x6d6>;
		};
	};

	audiopwmout-diff {
		status = "disabled";
		compatible = "simple-audio-card";
		simple-audio-card,format = "i2s";
		simple-audio-card,name = "rockchip,audiopwmout-diff";
		simple-audio-card,mclk-fs = <0x100>;
		simple-audio-card,bitclock-master = <0x135>;
		simple-audio-card,frame-master = <0x135>;

		simple-audio-card,cpu {
			sound-dai = <0x136>;
		};

		simple-audio-card,codec {
			sound-dai = <0x137>;
			phandle = <0x135>;
		};
	};

	dc-12v {
		compatible = "regulator-fixed";
		regulator-name = "dc_12v";
		regulator-always-on;
		regulator-boot-on;
		regulator-min-microvolt = <0xb71b00>;
		regulator-max-microvolt = <0xb71b00>;
		phandle = <0x13d>;
	};

	leds {
		compatible = "gpio-leds";

		work-led {
			gpios = <0x3e 0x1d 0x00>;
			linux,default-trigger = "heartbeat";
		};

		gpio1a4 {
			gpios = <0xbd 0x04 0x00>;
			default-state = "off";
		};

		gpio1b0 {
			gpios = <0xbd 0x08 0x00>;
			default-state = "off";
		};

		gpio1b1 {
			gpios = <0xbd 0x09 0x00>;
			default-state = "off";
		};

		gpio1b2 {
			gpios = <0xbd 0x0a 0x00>;
			default-state = "off";
		};

		gpio4c4 {
			gpios = <0x46 0x14 0x00>;
			default-state = "off";
		};

		gpio3b6 {
			gpios = <0x8d 0x0e 0x00>;
			default-state = "off";
		};

		gpio1d0 {
			gpios = <0xbd 0x18 0x00>;
			default-state = "off";
		};

		gpio1d4 {
			gpios = <0xbd 0x1c 0x00>;
			default-state = "off";
		};

		gpio3b5 {
			gpios = <0x8d 0x0d 0x00>;
			default-state = "off";
		};

		fan {
			gpios = <0x3e 0x1e 0x00>;
			default-state = "on";
		};
	};

	dummy-codec {
		status = "disabled";
		compatible = "rockchip,dummy-codec";
		#sound-dai-cells = <0x00>;
		phandle = <0x139>;
	};

	pdm-mic-array {
		status = "disabled";
		compatible = "simple-audio-card";
		simple-audio-card,name = "rockchip,pdm-mic-array";

		simple-audio-card,cpu {
			sound-dai = <0x138>;
		};

		simple-audio-card,codec {
			sound-dai = <0x139>;
		};
	};

	rk809-sound {
		status = "okay";
		compatible = "rockchip,multicodecs-card";
		rockchip,card-name = "rockchip-rk809";
		rockchip,format = "i2s";
		rockchip,mclk-fs = <0x100>;
		rockchip,cpu = <0xd1>;
		rockchip,codec = <0x13a>;
		spk-det-gpio = <0x46 0x16 0x01>;
		hp-det-gpio = <0xbd 0x1b 0x00>;
		pinctrl-names = "default";
		pinctrl-0 = <0x13b>;
		hp-volume = <0x14>;
		spk-volume = <0x1e>;
	};

	vad-sound {
		status = "disabled";
		compatible = "rockchip,multicodecs-card";
		rockchip,card-name = "rockchip,rk3568-vad";
		rockchip,cpu = <0xd1>;
		rockchip,codec = <0x13a 0x13c>;
	};

	vcc3v3-sys {
		compatible = "regulator-fixed";
		regulator-name = "vcc3v3_sys";
		regulator-always-on;
		regulator-boot-on;
		regulator-min-microvolt = <0x325aa0>;
		regulator-max-microvolt = <0x325aa0>;
		vin-supply = <0x13d>;
		phandle = <0x45>;
	};

	vcc5v0-sys {
		compatible = "regulator-fixed";
		regulator-name = "vcc5v0_sys";
		regulator-always-on;
		regulator-boot-on;
		regulator-min-microvolt = <0x4c4b40>;
		regulator-max-microvolt = <0x4c4b40>;
		vin-supply = <0x13d>;
		phandle = <0x3d>;
	};

	vcc5v0-usb {
		compatible = "regulator-fixed";
		regulator-name = "vcc5v0_usb";
		regulator-always-on;
		regulator-boot-on;
		regulator-min-microvolt = <0x4c4b40>;
		regulator-max-microvolt = <0x4c4b40>;
		vin-supply = <0x13d>;
		phandle = <0x143>;
	};

	sdio-pwrseq {
		compatible = "mmc-pwrseq-simple";
		clocks = <0x13e 0x01>;
		clock-names = "ext_clock";
		pinctrl-names = "default";
		pinctrl-0 = <0x13f>;
		post-power-on-delay-ms = <0xc8>;
		phandle = <0x85>;
	};

	wireless-wlan {
		compatible = "wlan-platdata";
		rockchip,grf = <0x3a>;
		wifi_chip_type = "rtl8822cs";
		WIFI,poweren_gpio = <0x8d 0x1d 0x00>;
		pinctrl-names = "default";
		pinctrl-0 = <0x140>;
		WIFI,host_wake_irq = <0x8d 0x1c 0x00>;
		status = "okay";
	};

	wireless-bluetooth {
		compatible = "bluetooth-platdata";
		clocks = <0x13e 0x01>;
		clock-names = "ext_clock";
		uart_rts_gpios = <0xc2 0x09 0x01>;
		pinctrl-names = "default", "rts_gpio";
		pinctrl-0 = <0x141>;
		pinctrl-1 = <0x142>;
		BT,power_gpio = <0x8d 0x00 0x00>;
		BT,wake_gpio = <0x8d 0x01 0x00>;
		BT,wake_host_irq = <0x8d 0x02 0x00>;
		status = "okay";
	};

	vcc5v0-host-regulator {
		compatible = "regulator-fixed";
		regulator-name = "vcc5v0_host";
		regulator-min-microvolt = <0x4c4b40>;
		regulator-max-microvolt = <0x4c4b40>;
		enable-active-high;
		gpio = <0x3e 0x06 0x00>;
		vin-supply = <0x143>;
		pinctrl-names = "default";
		pinctrl-0 = <0x144>;
		phandle = <0x116>;
	};

	vcc5v0-otg-regulator {
		compatible = "regulator-fixed";
		regulator-name = "vcc5v0_otg";
		regulator-min-microvolt = <0x4c4b40>;
		regulator-max-microvolt = <0x4c4b40>;
		enable-active-high;
		gpio = <0x3e 0x05 0x00>;
		vin-supply = <0x143>;
		pinctrl-names = "default";
		pinctrl-0 = <0x145>;
		phandle = <0x117>;
	};

	pcie30-avdd0v9 {
		compatible = "regulator-fixed";
		regulator-name = "pcie30_avdd0v9";
		regulator-always-on;
		regulator-boot-on;
		regulator-min-microvolt = <0xdbba0>;
		regulator-max-microvolt = <0xdbba0>;
		vin-supply = <0x45>;
	};

	pcie30-avdd1v8 {
		compatible = "regulator-fixed";
		regulator-name = "pcie30_avdd1v8";
		regulator-always-on;
		regulator-boot-on;
		regulator-min-microvolt = <0x1b7740>;
		regulator-max-microvolt = <0x1b7740>;
		vin-supply = <0x45>;
	};

	gpio-regulator {
		compatible = "regulator-fixed";
		regulator-name = "vcc3v3_pcie";
		regulator-min-microvolt = <0x325aa0>;
		regulator-max-microvolt = <0x325aa0>;
		enable-active-high;
		gpio = <0x3e 0x1c 0x00>;
		startup-delay-us = <0x1388>;
		vin-supply = <0x13d>;
		phandle = <0x127>;
	};

	pcie3-regulator {
		compatible = "regulator-fixed";
		regulator-name = "pcie3_power";
		regulator-boot-on;
		regulator-always-on;
		regulator-min-microvolt = <0x325aa0>;
		regulator-max-microvolt = <0x325aa0>;
		enable-active-high;
		gpio = <0x3e 0x1c 0x00>;
		pinctrl-names = "default";
		pinctrl-0 = <0x146>;
	};

	minipcie-regulator {
		compatible = "regulator-fixed";
		regulator-name = "minipcie_power";
		regulator-boot-on;
		regulator-always-on;
		regulator-min-microvolt = <0x325aa0>;
		regulator-max-microvolt = <0x325aa0>;
		enable-active-high;
		gpio = <0x8d 0x13 0x00>;
		pinctrl-names = "default";
		pinctrl-0 = <0x147>;
		phandle = <0xb6>;
	};

	vcc2v5-ddr {
		compatible = "regulator-fixed";
		regulator-name = "vcc2v5-sys";
		regulator-always-on;
		regulator-boot-on;
		regulator-min-microvolt = <0x2625a0>;
		regulator-max-microvolt = <0x2625a0>;
		vin-supply = <0x45>;
	};

	vcc3v3-bu {
		compatible = "regulator-fixed";
		regulator-name = "vcc3v3_bu";
		regulator-always-on;
		regulator-boot-on;
		regulator-min-microvolt = <0x325aa0>;
		regulator-max-microvolt = <0x325aa0>;
		vin-supply = <0x3d>;
	};

	chosen {
		bootargs = "earlycon=uart8250,mmio32,0xfe660000 console=ttyFIQ0 root=PARTUUID=614e0000-0000 rw rootwait";
	};

	fiq-debugger {
		compatible = "rockchip,fiq-debugger";
		rockchip,serial-id = <0x02>;
		rockchip,wake-irq = <0x00>;
		rockchip,irq-mode-enable = <0x01>;
		rockchip,baudrate = <0x16e360>;
		interrupts = <0x00 0xfc 0x08>;
		pinctrl-names = "default";
		pinctrl-0 = <0xee>;
		status = "okay";
	};

	debug@fd904000 {
		compatible = "rockchip,debug";
		reg = <0x00 0xfd904000 0x00 0x1000 0x00 0xfd905000 0x00 0x1000 0x00 0xfd906000 0x00 0x1000 0x00 0xfd907000 0x00 0x1000>;
	};

	cspmu@fd90c000 {
		compatible = "rockchip,cspmu";
		reg = <0x00 0xfd90c000 0x00 0x1000 0x00 0xfd90d000 0x00 0x1000 0x00 0xfd90e000 0x00 0x1000 0x00 0xfd90f000 0x00 0x1000>;
	};
};
